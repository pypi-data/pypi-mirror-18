/* Generated by Cython 0.25.2 */

/* BEGIN: Cython Metadata
{
    "distutils": {
        "depends": [
            "include/allele_ages.hpp", 
            "include/deps.hpp", 
            "include/evolve_regions_sampler.hpp", 
            "include/fwdpy_add_mutations.hpp", 
            "include/fwdpy_fitness.hpp", 
            "include/internal_callbacks.hpp", 
            "include/internal_region_manager.hpp", 
            "include/sample.hpp", 
            "include/sampler_additive_variance.hpp", 
            "include/sampler_base.hpp", 
            "include/sampler_no_sampling.hpp", 
            "include/sampler_pop_properties.hpp", 
            "include/sampler_sample_n.hpp", 
            "include/sampler_selected_mut_tracker.hpp", 
            "include/sampling_wrappers.hpp", 
            "include/types.hpp"
        ], 
        "extra_compile_args": [
            "-std=c++11", 
            "-fopenmp", 
            "-DPACKAGE_VERSION=\"0.0.4\"", 
            "-DHAVE_INLINE"
        ], 
        "include_dirs": [
            ".", 
            "..", 
            "include"
        ], 
        "language": "c++"
    }, 
    "module_name": "fwdpy.fitness"
}
END: Cython Metadata */

#define PY_SSIZE_T_CLEAN
#include "Python.h"
#ifndef Py_PYTHON_H
    #error Python headers needed to compile C extensions, please install development version of Python.
#elif PY_VERSION_HEX < 0x02060000 || (0x03000000 <= PY_VERSION_HEX && PY_VERSION_HEX < 0x03020000)
    #error Cython requires Python 2.6+ or Python 3.2+.
#else
#define CYTHON_ABI "0_25_2"
#include <stddef.h>
#ifndef offsetof
  #define offsetof(type, member) ( (size_t) & ((type*)0) -> member )
#endif
#if !defined(WIN32) && !defined(MS_WINDOWS)
  #ifndef __stdcall
    #define __stdcall
  #endif
  #ifndef __cdecl
    #define __cdecl
  #endif
  #ifndef __fastcall
    #define __fastcall
  #endif
#endif
#ifndef DL_IMPORT
  #define DL_IMPORT(t) t
#endif
#ifndef DL_EXPORT
  #define DL_EXPORT(t) t
#endif
#ifndef HAVE_LONG_LONG
  #if PY_VERSION_HEX >= 0x03030000 || (PY_MAJOR_VERSION == 2 && PY_VERSION_HEX >= 0x02070000)
    #define HAVE_LONG_LONG
  #endif
#endif
#ifndef PY_LONG_LONG
  #define PY_LONG_LONG LONG_LONG
#endif
#ifndef Py_HUGE_VAL
  #define Py_HUGE_VAL HUGE_VAL
#endif
#ifdef PYPY_VERSION
  #define CYTHON_COMPILING_IN_PYPY 1
  #define CYTHON_COMPILING_IN_PYSTON 0
  #define CYTHON_COMPILING_IN_CPYTHON 0
  #undef CYTHON_USE_TYPE_SLOTS
  #define CYTHON_USE_TYPE_SLOTS 0
  #undef CYTHON_USE_ASYNC_SLOTS
  #define CYTHON_USE_ASYNC_SLOTS 0
  #undef CYTHON_USE_PYLIST_INTERNALS
  #define CYTHON_USE_PYLIST_INTERNALS 0
  #undef CYTHON_USE_UNICODE_INTERNALS
  #define CYTHON_USE_UNICODE_INTERNALS 0
  #undef CYTHON_USE_UNICODE_WRITER
  #define CYTHON_USE_UNICODE_WRITER 0
  #undef CYTHON_USE_PYLONG_INTERNALS
  #define CYTHON_USE_PYLONG_INTERNALS 0
  #undef CYTHON_AVOID_BORROWED_REFS
  #define CYTHON_AVOID_BORROWED_REFS 1
  #undef CYTHON_ASSUME_SAFE_MACROS
  #define CYTHON_ASSUME_SAFE_MACROS 0
  #undef CYTHON_UNPACK_METHODS
  #define CYTHON_UNPACK_METHODS 0
  #undef CYTHON_FAST_THREAD_STATE
  #define CYTHON_FAST_THREAD_STATE 0
  #undef CYTHON_FAST_PYCALL
  #define CYTHON_FAST_PYCALL 0
#elif defined(PYSTON_VERSION)
  #define CYTHON_COMPILING_IN_PYPY 0
  #define CYTHON_COMPILING_IN_PYSTON 1
  #define CYTHON_COMPILING_IN_CPYTHON 0
  #ifndef CYTHON_USE_TYPE_SLOTS
    #define CYTHON_USE_TYPE_SLOTS 1
  #endif
  #undef CYTHON_USE_ASYNC_SLOTS
  #define CYTHON_USE_ASYNC_SLOTS 0
  #undef CYTHON_USE_PYLIST_INTERNALS
  #define CYTHON_USE_PYLIST_INTERNALS 0
  #ifndef CYTHON_USE_UNICODE_INTERNALS
    #define CYTHON_USE_UNICODE_INTERNALS 1
  #endif
  #undef CYTHON_USE_UNICODE_WRITER
  #define CYTHON_USE_UNICODE_WRITER 0
  #undef CYTHON_USE_PYLONG_INTERNALS
  #define CYTHON_USE_PYLONG_INTERNALS 0
  #ifndef CYTHON_AVOID_BORROWED_REFS
    #define CYTHON_AVOID_BORROWED_REFS 0
  #endif
  #ifndef CYTHON_ASSUME_SAFE_MACROS
    #define CYTHON_ASSUME_SAFE_MACROS 1
  #endif
  #ifndef CYTHON_UNPACK_METHODS
    #define CYTHON_UNPACK_METHODS 1
  #endif
  #undef CYTHON_FAST_THREAD_STATE
  #define CYTHON_FAST_THREAD_STATE 0
  #undef CYTHON_FAST_PYCALL
  #define CYTHON_FAST_PYCALL 0
#else
  #define CYTHON_COMPILING_IN_PYPY 0
  #define CYTHON_COMPILING_IN_PYSTON 0
  #define CYTHON_COMPILING_IN_CPYTHON 1
  #ifndef CYTHON_USE_TYPE_SLOTS
    #define CYTHON_USE_TYPE_SLOTS 1
  #endif
  #if PY_MAJOR_VERSION < 3
    #undef CYTHON_USE_ASYNC_SLOTS
    #define CYTHON_USE_ASYNC_SLOTS 0
  #elif !defined(CYTHON_USE_ASYNC_SLOTS)
    #define CYTHON_USE_ASYNC_SLOTS 1
  #endif
  #if PY_VERSION_HEX < 0x02070000
    #undef CYTHON_USE_PYLONG_INTERNALS
    #define CYTHON_USE_PYLONG_INTERNALS 0
  #elif !defined(CYTHON_USE_PYLONG_INTERNALS)
    #define CYTHON_USE_PYLONG_INTERNALS 1
  #endif
  #ifndef CYTHON_USE_PYLIST_INTERNALS
    #define CYTHON_USE_PYLIST_INTERNALS 1
  #endif
  #ifndef CYTHON_USE_UNICODE_INTERNALS
    #define CYTHON_USE_UNICODE_INTERNALS 1
  #endif
  #if PY_VERSION_HEX < 0x030300F0
    #undef CYTHON_USE_UNICODE_WRITER
    #define CYTHON_USE_UNICODE_WRITER 0
  #elif !defined(CYTHON_USE_UNICODE_WRITER)
    #define CYTHON_USE_UNICODE_WRITER 1
  #endif
  #ifndef CYTHON_AVOID_BORROWED_REFS
    #define CYTHON_AVOID_BORROWED_REFS 0
  #endif
  #ifndef CYTHON_ASSUME_SAFE_MACROS
    #define CYTHON_ASSUME_SAFE_MACROS 1
  #endif
  #ifndef CYTHON_UNPACK_METHODS
    #define CYTHON_UNPACK_METHODS 1
  #endif
  #ifndef CYTHON_FAST_THREAD_STATE
    #define CYTHON_FAST_THREAD_STATE 1
  #endif
  #ifndef CYTHON_FAST_PYCALL
    #define CYTHON_FAST_PYCALL 1
  #endif
#endif
#if !defined(CYTHON_FAST_PYCCALL)
#define CYTHON_FAST_PYCCALL  (CYTHON_FAST_PYCALL && PY_VERSION_HEX >= 0x030600B1)
#endif
#if CYTHON_USE_PYLONG_INTERNALS
  #include "longintrepr.h"
  #undef SHIFT
  #undef BASE
  #undef MASK
#endif
#if CYTHON_COMPILING_IN_PYPY && PY_VERSION_HEX < 0x02070600 && !defined(Py_OptimizeFlag)
  #define Py_OptimizeFlag 0
#endif
#define __PYX_BUILD_PY_SSIZE_T "n"
#define CYTHON_FORMAT_SSIZE_T "z"
#if PY_MAJOR_VERSION < 3
  #define __Pyx_BUILTIN_MODULE_NAME "__builtin__"
  #define __Pyx_PyCode_New(a, k, l, s, f, code, c, n, v, fv, cell, fn, name, fline, lnos)\
          PyCode_New(a+k, l, s, f, code, c, n, v, fv, cell, fn, name, fline, lnos)
  #define __Pyx_DefaultClassType PyClass_Type
#else
  #define __Pyx_BUILTIN_MODULE_NAME "builtins"
  #define __Pyx_PyCode_New(a, k, l, s, f, code, c, n, v, fv, cell, fn, name, fline, lnos)\
          PyCode_New(a, k, l, s, f, code, c, n, v, fv, cell, fn, name, fline, lnos)
  #define __Pyx_DefaultClassType PyType_Type
#endif
#ifndef Py_TPFLAGS_CHECKTYPES
  #define Py_TPFLAGS_CHECKTYPES 0
#endif
#ifndef Py_TPFLAGS_HAVE_INDEX
  #define Py_TPFLAGS_HAVE_INDEX 0
#endif
#ifndef Py_TPFLAGS_HAVE_NEWBUFFER
  #define Py_TPFLAGS_HAVE_NEWBUFFER 0
#endif
#ifndef Py_TPFLAGS_HAVE_FINALIZE
  #define Py_TPFLAGS_HAVE_FINALIZE 0
#endif
#ifndef METH_FASTCALL
  #define METH_FASTCALL 0x80
  typedef PyObject *(*__Pyx_PyCFunctionFast) (PyObject *self, PyObject **args,
                                              Py_ssize_t nargs, PyObject *kwnames);
#else
  #define __Pyx_PyCFunctionFast _PyCFunctionFast
#endif
#if CYTHON_FAST_PYCCALL
#define __Pyx_PyFastCFunction_Check(func)\
    ((PyCFunction_Check(func) && (METH_FASTCALL == (PyCFunction_GET_FLAGS(func) & ~(METH_CLASS | METH_STATIC | METH_COEXIST)))))
#else
#define __Pyx_PyFastCFunction_Check(func) 0
#endif
#if PY_VERSION_HEX > 0x03030000 && defined(PyUnicode_KIND)
  #define CYTHON_PEP393_ENABLED 1
  #define __Pyx_PyUnicode_READY(op)       (likely(PyUnicode_IS_READY(op)) ?\
                                              0 : _PyUnicode_Ready((PyObject *)(op)))
  #define __Pyx_PyUnicode_GET_LENGTH(u)   PyUnicode_GET_LENGTH(u)
  #define __Pyx_PyUnicode_READ_CHAR(u, i) PyUnicode_READ_CHAR(u, i)
  #define __Pyx_PyUnicode_MAX_CHAR_VALUE(u)   PyUnicode_MAX_CHAR_VALUE(u)
  #define __Pyx_PyUnicode_KIND(u)         PyUnicode_KIND(u)
  #define __Pyx_PyUnicode_DATA(u)         PyUnicode_DATA(u)
  #define __Pyx_PyUnicode_READ(k, d, i)   PyUnicode_READ(k, d, i)
  #define __Pyx_PyUnicode_WRITE(k, d, i, ch)  PyUnicode_WRITE(k, d, i, ch)
  #define __Pyx_PyUnicode_IS_TRUE(u)      (0 != (likely(PyUnicode_IS_READY(u)) ? PyUnicode_GET_LENGTH(u) : PyUnicode_GET_SIZE(u)))
#else
  #define CYTHON_PEP393_ENABLED 0
  #define PyUnicode_1BYTE_KIND  1
  #define PyUnicode_2BYTE_KIND  2
  #define PyUnicode_4BYTE_KIND  4
  #define __Pyx_PyUnicode_READY(op)       (0)
  #define __Pyx_PyUnicode_GET_LENGTH(u)   PyUnicode_GET_SIZE(u)
  #define __Pyx_PyUnicode_READ_CHAR(u, i) ((Py_UCS4)(PyUnicode_AS_UNICODE(u)[i]))
  #define __Pyx_PyUnicode_MAX_CHAR_VALUE(u)   ((sizeof(Py_UNICODE) == 2) ? 65535 : 1114111)
  #define __Pyx_PyUnicode_KIND(u)         (sizeof(Py_UNICODE))
  #define __Pyx_PyUnicode_DATA(u)         ((void*)PyUnicode_AS_UNICODE(u))
  #define __Pyx_PyUnicode_READ(k, d, i)   ((void)(k), (Py_UCS4)(((Py_UNICODE*)d)[i]))
  #define __Pyx_PyUnicode_WRITE(k, d, i, ch)  (((void)(k)), ((Py_UNICODE*)d)[i] = ch)
  #define __Pyx_PyUnicode_IS_TRUE(u)      (0 != PyUnicode_GET_SIZE(u))
#endif
#if CYTHON_COMPILING_IN_PYPY
  #define __Pyx_PyUnicode_Concat(a, b)      PyNumber_Add(a, b)
  #define __Pyx_PyUnicode_ConcatSafe(a, b)  PyNumber_Add(a, b)
#else
  #define __Pyx_PyUnicode_Concat(a, b)      PyUnicode_Concat(a, b)
  #define __Pyx_PyUnicode_ConcatSafe(a, b)  ((unlikely((a) == Py_None) || unlikely((b) == Py_None)) ?\
      PyNumber_Add(a, b) : __Pyx_PyUnicode_Concat(a, b))
#endif
#if CYTHON_COMPILING_IN_PYPY && !defined(PyUnicode_Contains)
  #define PyUnicode_Contains(u, s)  PySequence_Contains(u, s)
#endif
#if CYTHON_COMPILING_IN_PYPY && !defined(PyByteArray_Check)
  #define PyByteArray_Check(obj)  PyObject_TypeCheck(obj, &PyByteArray_Type)
#endif
#if CYTHON_COMPILING_IN_PYPY && !defined(PyObject_Format)
  #define PyObject_Format(obj, fmt)  PyObject_CallMethod(obj, "__format__", "O", fmt)
#endif
#if CYTHON_COMPILING_IN_PYPY && !defined(PyObject_Malloc)
  #define PyObject_Malloc(s)   PyMem_Malloc(s)
  #define PyObject_Free(p)     PyMem_Free(p)
  #define PyObject_Realloc(p)  PyMem_Realloc(p)
#endif
#if CYTHON_COMPILING_IN_PYSTON
  #define __Pyx_PyCode_HasFreeVars(co)  PyCode_HasFreeVars(co)
  #define __Pyx_PyFrame_SetLineNumber(frame, lineno) PyFrame_SetLineNumber(frame, lineno)
#else
  #define __Pyx_PyCode_HasFreeVars(co)  (PyCode_GetNumFree(co) > 0)
  #define __Pyx_PyFrame_SetLineNumber(frame, lineno)  (frame)->f_lineno = (lineno)
#endif
#define __Pyx_PyString_FormatSafe(a, b)   ((unlikely((a) == Py_None)) ? PyNumber_Remainder(a, b) : __Pyx_PyString_Format(a, b))
#define __Pyx_PyUnicode_FormatSafe(a, b)  ((unlikely((a) == Py_None)) ? PyNumber_Remainder(a, b) : PyUnicode_Format(a, b))
#if PY_MAJOR_VERSION >= 3
  #define __Pyx_PyString_Format(a, b)  PyUnicode_Format(a, b)
#else
  #define __Pyx_PyString_Format(a, b)  PyString_Format(a, b)
#endif
#if PY_MAJOR_VERSION < 3 && !defined(PyObject_ASCII)
  #define PyObject_ASCII(o)            PyObject_Repr(o)
#endif
#if PY_MAJOR_VERSION >= 3
  #define PyBaseString_Type            PyUnicode_Type
  #define PyStringObject               PyUnicodeObject
  #define PyString_Type                PyUnicode_Type
  #define PyString_Check               PyUnicode_Check
  #define PyString_CheckExact          PyUnicode_CheckExact
#endif
#if PY_MAJOR_VERSION >= 3
  #define __Pyx_PyBaseString_Check(obj) PyUnicode_Check(obj)
  #define __Pyx_PyBaseString_CheckExact(obj) PyUnicode_CheckExact(obj)
#else
  #define __Pyx_PyBaseString_Check(obj) (PyString_Check(obj) || PyUnicode_Check(obj))
  #define __Pyx_PyBaseString_CheckExact(obj) (PyString_CheckExact(obj) || PyUnicode_CheckExact(obj))
#endif
#ifndef PySet_CheckExact
  #define PySet_CheckExact(obj)        (Py_TYPE(obj) == &PySet_Type)
#endif
#define __Pyx_TypeCheck(obj, type) PyObject_TypeCheck(obj, (PyTypeObject *)type)
#define __Pyx_PyException_Check(obj) __Pyx_TypeCheck(obj, PyExc_Exception)
#if PY_MAJOR_VERSION >= 3
  #define PyIntObject                  PyLongObject
  #define PyInt_Type                   PyLong_Type
  #define PyInt_Check(op)              PyLong_Check(op)
  #define PyInt_CheckExact(op)         PyLong_CheckExact(op)
  #define PyInt_FromString             PyLong_FromString
  #define PyInt_FromUnicode            PyLong_FromUnicode
  #define PyInt_FromLong               PyLong_FromLong
  #define PyInt_FromSize_t             PyLong_FromSize_t
  #define PyInt_FromSsize_t            PyLong_FromSsize_t
  #define PyInt_AsLong                 PyLong_AsLong
  #define PyInt_AS_LONG                PyLong_AS_LONG
  #define PyInt_AsSsize_t              PyLong_AsSsize_t
  #define PyInt_AsUnsignedLongMask     PyLong_AsUnsignedLongMask
  #define PyInt_AsUnsignedLongLongMask PyLong_AsUnsignedLongLongMask
  #define PyNumber_Int                 PyNumber_Long
#endif
#if PY_MAJOR_VERSION >= 3
  #define PyBoolObject                 PyLongObject
#endif
#if PY_MAJOR_VERSION >= 3 && CYTHON_COMPILING_IN_PYPY
  #ifndef PyUnicode_InternFromString
    #define PyUnicode_InternFromString(s) PyUnicode_FromString(s)
  #endif
#endif
#if PY_VERSION_HEX < 0x030200A4
  typedef long Py_hash_t;
  #define __Pyx_PyInt_FromHash_t PyInt_FromLong
  #define __Pyx_PyInt_AsHash_t   PyInt_AsLong
#else
  #define __Pyx_PyInt_FromHash_t PyInt_FromSsize_t
  #define __Pyx_PyInt_AsHash_t   PyInt_AsSsize_t
#endif
#if PY_MAJOR_VERSION >= 3
  #define __Pyx_PyMethod_New(func, self, klass) ((self) ? PyMethod_New(func, self) : PyInstanceMethod_New(func))
#else
  #define __Pyx_PyMethod_New(func, self, klass) PyMethod_New(func, self, klass)
#endif
#if CYTHON_USE_ASYNC_SLOTS
  #if PY_VERSION_HEX >= 0x030500B1
    #define __Pyx_PyAsyncMethodsStruct PyAsyncMethods
    #define __Pyx_PyType_AsAsync(obj) (Py_TYPE(obj)->tp_as_async)
  #else
    typedef struct {
        unaryfunc am_await;
        unaryfunc am_aiter;
        unaryfunc am_anext;
    } __Pyx_PyAsyncMethodsStruct;
    #define __Pyx_PyType_AsAsync(obj) ((__Pyx_PyAsyncMethodsStruct*) (Py_TYPE(obj)->tp_reserved))
  #endif
#else
  #define __Pyx_PyType_AsAsync(obj) NULL
#endif
#ifndef CYTHON_RESTRICT
  #if defined(__GNUC__)
    #define CYTHON_RESTRICT __restrict__
  #elif defined(_MSC_VER) && _MSC_VER >= 1400
    #define CYTHON_RESTRICT __restrict
  #elif defined (__STDC_VERSION__) && __STDC_VERSION__ >= 199901L
    #define CYTHON_RESTRICT restrict
  #else
    #define CYTHON_RESTRICT
  #endif
#endif
#ifndef CYTHON_UNUSED
# if defined(__GNUC__)
#   if !(defined(__cplusplus)) || (__GNUC__ > 3 || (__GNUC__ == 3 && __GNUC_MINOR__ >= 4))
#     define CYTHON_UNUSED __attribute__ ((__unused__))
#   else
#     define CYTHON_UNUSED
#   endif
# elif defined(__ICC) || (defined(__INTEL_COMPILER) && !defined(_MSC_VER))
#   define CYTHON_UNUSED __attribute__ ((__unused__))
# else
#   define CYTHON_UNUSED
# endif
#endif
#ifndef CYTHON_MAYBE_UNUSED_VAR
#  if defined(__cplusplus)
     template<class T> void CYTHON_MAYBE_UNUSED_VAR( const T& ) { }
#  else
#    define CYTHON_MAYBE_UNUSED_VAR(x) (void)(x)
#  endif
#endif
#ifndef CYTHON_NCP_UNUSED
# if CYTHON_COMPILING_IN_CPYTHON
#  define CYTHON_NCP_UNUSED
# else
#  define CYTHON_NCP_UNUSED CYTHON_UNUSED
# endif
#endif
#define __Pyx_void_to_None(void_result) ((void)(void_result), Py_INCREF(Py_None), Py_None)

#ifndef __cplusplus
  #error "Cython files generated with the C++ option must be compiled with a C++ compiler."
#endif
#ifndef CYTHON_INLINE
  #if defined(__clang__)
    #define CYTHON_INLINE __inline__ __attribute__ ((__unused__))
  #else
    #define CYTHON_INLINE inline
  #endif
#endif
template<typename T>
void __Pyx_call_destructor(T& x) {
    x.~T();
}
template<typename T>
class __Pyx_FakeReference {
  public:
    __Pyx_FakeReference() : ptr(NULL) { }
    __Pyx_FakeReference(const T& ref) : ptr(const_cast<T*>(&ref)) { }
    T *operator->() { return ptr; }
    T *operator&() { return ptr; }
    operator T&() { return *ptr; }
    template<typename U> bool operator ==(U other) { return *ptr == other; }
    template<typename U> bool operator !=(U other) { return *ptr != other; }
  private:
    T *ptr;
};

#if defined(WIN32) || defined(MS_WINDOWS)
  #define _USE_MATH_DEFINES
#endif
#include <math.h>
#ifdef NAN
#define __PYX_NAN() ((float) NAN)
#else
static CYTHON_INLINE float __PYX_NAN() {
  float value;
  memset(&value, 0xFF, sizeof(value));
  return value;
}
#endif
#if defined(__CYGWIN__) && defined(_LDBL_EQ_DBL)
#define __Pyx_truncl trunc
#else
#define __Pyx_truncl truncl
#endif


#define __PYX_ERR(f_index, lineno, Ln_error) \
{ \
  __pyx_filename = __pyx_f[f_index]; __pyx_lineno = lineno; __pyx_clineno = __LINE__; goto Ln_error; \
}

#if PY_MAJOR_VERSION >= 3
  #define __Pyx_PyNumber_Divide(x,y)         PyNumber_TrueDivide(x,y)
  #define __Pyx_PyNumber_InPlaceDivide(x,y)  PyNumber_InPlaceTrueDivide(x,y)
#else
  #define __Pyx_PyNumber_Divide(x,y)         PyNumber_Divide(x,y)
  #define __Pyx_PyNumber_InPlaceDivide(x,y)  PyNumber_InPlaceDivide(x,y)
#endif

#ifndef __PYX_EXTERN_C
  #ifdef __cplusplus
    #define __PYX_EXTERN_C extern "C"
  #else
    #define __PYX_EXTERN_C extern
  #endif
#endif

#define __PYX_HAVE__fwdpy__fitness
#define __PYX_HAVE_API__fwdpy__fitness
#include <vector>
#include "ios"
#include "new"
#include "stdexcept"
#include "typeinfo"
#include <utility>
#include <string.h>
#include <string>
#include <memory>
#include <map>
#include <stdint.h>
#include <math.h>
#include <stdio.h>
#include "gsl/gsl_mode.h"
#include "gsl/gsl_math.h"
#include "gsl/gsl_complex.h"
#include "gsl/gsl_complex_math.h"
#include "gsl/gsl_poly.h"
#include "gsl/gsl_sf_result.h"
#include "gsl/gsl_sf_airy.h"
#include "gsl/gsl_sf_bessel.h"
#include "gsl/gsl_sf_clausen.h"
#include "gsl/gsl_sf_coulomb.h"
#include "gsl/gsl_sf_coupling.h"
#include "gsl/gsl_sf_dawson.h"
#include "gsl/gsl_sf_debye.h"
#include "gsl/gsl_sf_dilog.h"
#include "gsl/gsl_sf_elementary.h"
#include "gsl/gsl_sf_ellint.h"
#include "gsl/gsl_sf_elljac.h"
#include "gsl/gsl_sf_erf.h"
#include "gsl/gsl_sf_exp.h"
#include "gsl/gsl_sf_expint.h"
#include "gsl/gsl_sf_fermi_dirac.h"
#include "gsl/gsl_sf_gamma.h"
#include "gsl/gsl_sf_gegenbauer.h"
#include "gsl/gsl_sf_hyperg.h"
#include "gsl/gsl_sf_laguerre.h"
#include "gsl/gsl_sf_lambert.h"
#include "gsl/gsl_sf_legendre.h"
#include "gsl/gsl_sf_log.h"
#include "gsl/gsl_sf_pow_int.h"
#include "gsl/gsl_sf_psi.h"
#include "gsl/gsl_sf_synchrotron.h"
#include "gsl/gsl_sf_transport.h"
#include "gsl/gsl_sf_trig.h"
#include "gsl/gsl_sf_zeta.h"
#include "gsl/gsl_block_double.h"
#include "gsl/gsl_block_complex_double.h"
#include "gsl/gsl_vector.h"
#include "gsl/gsl_vector_complex_double.h"
#include "gsl/gsl_matrix_double.h"
#include "gsl/gsl_matrix_complex_double.h"
#include "gsl/gsl_permutation.h"
#include "gsl/gsl_permute_double.h"
#include "gsl/gsl_permute_vector_double.h"
#include "gsl/gsl_permute_vector_complex_double.h"
#include "gsl/gsl_combination.h"
#include "gsl/gsl_heapsort.h"
#include "gsl/gsl_sort_double.h"
#include "gsl/gsl_sort_vector_double.h"
#include "gsl/gsl_cblas.h"
#include "gsl/gsl_blas_types.h"
#include "gsl/gsl_blas.h"
#include "gsl/gsl_linalg.h"
#include "gsl/gsl_eigen.h"
#include "gsl/gsl_fft.h"
#include "gsl/gsl_fft_complex.h"
#include "gsl/gsl_fft_real.h"
#include "gsl/gsl_fft_halfcomplex.h"
#include "gsl/gsl_integration.h"
#include "gsl/gsl_rng.h"
#include "gsl/gsl_qrng.h"
#include "gsl/gsl_randist.h"
#include "gsl/gsl_cdf.h"
#include "gsl/gsl_statistics_double.h"
#include "gsl/gsl_histogram.h"
#include "gsl/gsl_histogram2d.h"
#include "gsl/gsl_ntuple.h"
#include "gsl/gsl_monte.h"
#include "gsl/gsl_monte_plain.h"
#include "gsl/gsl_monte_miser.h"
#include "gsl/gsl_monte_vegas.h"
#include "gsl/gsl_odeiv.h"
#include "gsl/gsl_odeiv2.h"
#include "gsl/gsl_interp.h"
#include "gsl/gsl_spline.h"
#include "gsl/gsl_diff.h"
#include "gsl/gsl_chebyshev.h"
#include "gsl/gsl_sum.h"
#include "gsl/gsl_roots.h"
#include "gsl/gsl_min.h"
#include "gsl/gsl_fit.h"
#include "fwdpp/forward_types.hpp"
#include "fwdpp/sugar/popgenmut.hpp"
#include "fwdpp/fitness_models.hpp"
#include "fwdpp/fwd_functional.hpp"
#include "fwdpp/debug.hpp"
#include "fwdpp/sugar/generalmut.hpp"
#include "fwdpp/sugar/sampling.hpp"
#include "fwdpp/sugar/change_neutral.hpp"
#include "fwdpp/extensions/callbacks.hpp"
#include "fwdpp/internal/gsl_discrete.hpp"
#include "internal_callbacks.hpp"
#include "internal_region_manager.hpp"
#include <functional>
#include <unordered_set>
#include "sample.hpp"
#include "sampler_selected_mut_tracker.hpp"
#include "sampler_pop_properties.hpp"
#include "sampler_additive_variance.hpp"
#include "allele_ages.hpp"
#include "types.hpp"
#include "sampler_base.hpp"
#include "sampler_no_sampling.hpp"
#include "sampler_sample_n.hpp"
#include "deps.hpp"
#include "evolve_regions_sampler.hpp"
#include "sampling_wrappers.hpp"
#include "fwdpy_add_mutations.hpp"
#include <algorithm>
#include "fwdpy_fitness.hpp"
#ifdef _OPENMP
#include <omp.h>
#endif /* _OPENMP */

#ifdef PYREX_WITHOUT_ASSERTIONS
#define CYTHON_WITHOUT_ASSERTIONS
#endif

typedef struct {PyObject **p; const char *s; const Py_ssize_t n; const char* encoding;
                const char is_unicode; const char is_str; const char intern; } __Pyx_StringTabEntry;

#define __PYX_DEFAULT_STRING_ENCODING_IS_ASCII 0
#define __PYX_DEFAULT_STRING_ENCODING_IS_DEFAULT 0
#define __PYX_DEFAULT_STRING_ENCODING ""
#define __Pyx_PyObject_FromString __Pyx_PyBytes_FromString
#define __Pyx_PyObject_FromStringAndSize __Pyx_PyBytes_FromStringAndSize
#define __Pyx_uchar_cast(c) ((unsigned char)c)
#define __Pyx_long_cast(x) ((long)x)
#define __Pyx_fits_Py_ssize_t(v, type, is_signed)  (\
    (sizeof(type) < sizeof(Py_ssize_t))  ||\
    (sizeof(type) > sizeof(Py_ssize_t) &&\
          likely(v < (type)PY_SSIZE_T_MAX ||\
                 v == (type)PY_SSIZE_T_MAX)  &&\
          (!is_signed || likely(v > (type)PY_SSIZE_T_MIN ||\
                                v == (type)PY_SSIZE_T_MIN)))  ||\
    (sizeof(type) == sizeof(Py_ssize_t) &&\
          (is_signed || likely(v < (type)PY_SSIZE_T_MAX ||\
                               v == (type)PY_SSIZE_T_MAX)))  )
#if defined (__cplusplus) && __cplusplus >= 201103L
    #include <cstdlib>
    #define __Pyx_sst_abs(value) std::abs(value)
#elif SIZEOF_INT >= SIZEOF_SIZE_T
    #define __Pyx_sst_abs(value) abs(value)
#elif SIZEOF_LONG >= SIZEOF_SIZE_T
    #define __Pyx_sst_abs(value) labs(value)
#elif defined (_MSC_VER) && defined (_M_X64)
    #define __Pyx_sst_abs(value) _abs64(value)
#elif defined (__STDC_VERSION__) && __STDC_VERSION__ >= 199901L
    #define __Pyx_sst_abs(value) llabs(value)
#elif defined (__GNUC__)
    #define __Pyx_sst_abs(value) __builtin_llabs(value)
#else
    #define __Pyx_sst_abs(value) ((value<0) ? -value : value)
#endif
static CYTHON_INLINE char* __Pyx_PyObject_AsString(PyObject*);
static CYTHON_INLINE char* __Pyx_PyObject_AsStringAndSize(PyObject*, Py_ssize_t* length);
#define __Pyx_PyByteArray_FromString(s) PyByteArray_FromStringAndSize((const char*)s, strlen((const char*)s))
#define __Pyx_PyByteArray_FromStringAndSize(s, l) PyByteArray_FromStringAndSize((const char*)s, l)
#define __Pyx_PyBytes_FromString        PyBytes_FromString
#define __Pyx_PyBytes_FromStringAndSize PyBytes_FromStringAndSize
static CYTHON_INLINE PyObject* __Pyx_PyUnicode_FromString(const char*);
#if PY_MAJOR_VERSION < 3
    #define __Pyx_PyStr_FromString        __Pyx_PyBytes_FromString
    #define __Pyx_PyStr_FromStringAndSize __Pyx_PyBytes_FromStringAndSize
#else
    #define __Pyx_PyStr_FromString        __Pyx_PyUnicode_FromString
    #define __Pyx_PyStr_FromStringAndSize __Pyx_PyUnicode_FromStringAndSize
#endif
#define __Pyx_PyObject_AsSString(s)    ((signed char*) __Pyx_PyObject_AsString(s))
#define __Pyx_PyObject_AsUString(s)    ((unsigned char*) __Pyx_PyObject_AsString(s))
#define __Pyx_PyObject_FromCString(s)  __Pyx_PyObject_FromString((const char*)s)
#define __Pyx_PyBytes_FromCString(s)   __Pyx_PyBytes_FromString((const char*)s)
#define __Pyx_PyByteArray_FromCString(s)   __Pyx_PyByteArray_FromString((const char*)s)
#define __Pyx_PyStr_FromCString(s)     __Pyx_PyStr_FromString((const char*)s)
#define __Pyx_PyUnicode_FromCString(s) __Pyx_PyUnicode_FromString((const char*)s)
#if PY_MAJOR_VERSION < 3
static CYTHON_INLINE size_t __Pyx_Py_UNICODE_strlen(const Py_UNICODE *u)
{
    const Py_UNICODE *u_end = u;
    while (*u_end++) ;
    return (size_t)(u_end - u - 1);
}
#else
#define __Pyx_Py_UNICODE_strlen Py_UNICODE_strlen
#endif
#define __Pyx_PyUnicode_FromUnicode(u)       PyUnicode_FromUnicode(u, __Pyx_Py_UNICODE_strlen(u))
#define __Pyx_PyUnicode_FromUnicodeAndLength PyUnicode_FromUnicode
#define __Pyx_PyUnicode_AsUnicode            PyUnicode_AsUnicode
#define __Pyx_NewRef(obj) (Py_INCREF(obj), obj)
#define __Pyx_Owned_Py_None(b) __Pyx_NewRef(Py_None)
#define __Pyx_PyBool_FromLong(b) ((b) ? __Pyx_NewRef(Py_True) : __Pyx_NewRef(Py_False))
static CYTHON_INLINE int __Pyx_PyObject_IsTrue(PyObject*);
static CYTHON_INLINE PyObject* __Pyx_PyNumber_IntOrLong(PyObject* x);
static CYTHON_INLINE Py_ssize_t __Pyx_PyIndex_AsSsize_t(PyObject*);
static CYTHON_INLINE PyObject * __Pyx_PyInt_FromSize_t(size_t);
#if CYTHON_ASSUME_SAFE_MACROS
#define __pyx_PyFloat_AsDouble(x) (PyFloat_CheckExact(x) ? PyFloat_AS_DOUBLE(x) : PyFloat_AsDouble(x))
#else
#define __pyx_PyFloat_AsDouble(x) PyFloat_AsDouble(x)
#endif
#define __pyx_PyFloat_AsFloat(x) ((float) __pyx_PyFloat_AsDouble(x))
#if PY_MAJOR_VERSION >= 3
#define __Pyx_PyNumber_Int(x) (PyLong_CheckExact(x) ? __Pyx_NewRef(x) : PyNumber_Long(x))
#else
#define __Pyx_PyNumber_Int(x) (PyInt_CheckExact(x) ? __Pyx_NewRef(x) : PyNumber_Int(x))
#endif
#define __Pyx_PyNumber_Float(x) (PyFloat_CheckExact(x) ? __Pyx_NewRef(x) : PyNumber_Float(x))
#if PY_MAJOR_VERSION < 3 && __PYX_DEFAULT_STRING_ENCODING_IS_ASCII
static int __Pyx_sys_getdefaultencoding_not_ascii;
static int __Pyx_init_sys_getdefaultencoding_params(void) {
    PyObject* sys;
    PyObject* default_encoding = NULL;
    PyObject* ascii_chars_u = NULL;
    PyObject* ascii_chars_b = NULL;
    const char* default_encoding_c;
    sys = PyImport_ImportModule("sys");
    if (!sys) goto bad;
    default_encoding = PyObject_CallMethod(sys, (char*) "getdefaultencoding", NULL);
    Py_DECREF(sys);
    if (!default_encoding) goto bad;
    default_encoding_c = PyBytes_AsString(default_encoding);
    if (!default_encoding_c) goto bad;
    if (strcmp(default_encoding_c, "ascii") == 0) {
        __Pyx_sys_getdefaultencoding_not_ascii = 0;
    } else {
        char ascii_chars[128];
        int c;
        for (c = 0; c < 128; c++) {
            ascii_chars[c] = c;
        }
        __Pyx_sys_getdefaultencoding_not_ascii = 1;
        ascii_chars_u = PyUnicode_DecodeASCII(ascii_chars, 128, NULL);
        if (!ascii_chars_u) goto bad;
        ascii_chars_b = PyUnicode_AsEncodedString(ascii_chars_u, default_encoding_c, NULL);
        if (!ascii_chars_b || !PyBytes_Check(ascii_chars_b) || memcmp(ascii_chars, PyBytes_AS_STRING(ascii_chars_b), 128) != 0) {
            PyErr_Format(
                PyExc_ValueError,
                "This module compiled with c_string_encoding=ascii, but default encoding '%.200s' is not a superset of ascii.",
                default_encoding_c);
            goto bad;
        }
        Py_DECREF(ascii_chars_u);
        Py_DECREF(ascii_chars_b);
    }
    Py_DECREF(default_encoding);
    return 0;
bad:
    Py_XDECREF(default_encoding);
    Py_XDECREF(ascii_chars_u);
    Py_XDECREF(ascii_chars_b);
    return -1;
}
#endif
#if __PYX_DEFAULT_STRING_ENCODING_IS_DEFAULT && PY_MAJOR_VERSION >= 3
#define __Pyx_PyUnicode_FromStringAndSize(c_str, size) PyUnicode_DecodeUTF8(c_str, size, NULL)
#else
#define __Pyx_PyUnicode_FromStringAndSize(c_str, size) PyUnicode_Decode(c_str, size, __PYX_DEFAULT_STRING_ENCODING, NULL)
#if __PYX_DEFAULT_STRING_ENCODING_IS_DEFAULT
static char* __PYX_DEFAULT_STRING_ENCODING;
static int __Pyx_init_sys_getdefaultencoding_params(void) {
    PyObject* sys;
    PyObject* default_encoding = NULL;
    char* default_encoding_c;
    sys = PyImport_ImportModule("sys");
    if (!sys) goto bad;
    default_encoding = PyObject_CallMethod(sys, (char*) (const char*) "getdefaultencoding", NULL);
    Py_DECREF(sys);
    if (!default_encoding) goto bad;
    default_encoding_c = PyBytes_AsString(default_encoding);
    if (!default_encoding_c) goto bad;
    __PYX_DEFAULT_STRING_ENCODING = (char*) malloc(strlen(default_encoding_c));
    if (!__PYX_DEFAULT_STRING_ENCODING) goto bad;
    strcpy(__PYX_DEFAULT_STRING_ENCODING, default_encoding_c);
    Py_DECREF(default_encoding);
    return 0;
bad:
    Py_XDECREF(default_encoding);
    return -1;
}
#endif
#endif


/* Test for GCC > 2.95 */
#if defined(__GNUC__)     && (__GNUC__ > 2 || (__GNUC__ == 2 && (__GNUC_MINOR__ > 95)))
  #define likely(x)   __builtin_expect(!!(x), 1)
  #define unlikely(x) __builtin_expect(!!(x), 0)
#else /* !__GNUC__ or GCC < 2.95 */
  #define likely(x)   (x)
  #define unlikely(x) (x)
#endif /* __GNUC__ */

static PyObject *__pyx_m;
static PyObject *__pyx_d;
static PyObject *__pyx_b;
static PyObject *__pyx_empty_tuple;
static PyObject *__pyx_empty_bytes;
static PyObject *__pyx_empty_unicode;
static int __pyx_lineno;
static int __pyx_clineno = 0;
static const char * __pyx_cfilenm= __FILE__;
static const char *__pyx_filename;


static const char *__pyx_f[] = {
  "fwdpy/fitness.pyx",
  "fwdpy/fitness.pxd",
  "fwdpy/internal/internal.pxd",
  "fwdpy/fwdpy.pxd",
};

/* "cython_gsl/gsl_blas_types.pxd":23
 *     CblasRight=142
 * 
 * ctypedef size_t CBLAS_INDEX             # <<<<<<<<<<<<<<
 * 
 * cdef extern from "gsl/gsl_blas_types.h":
 */
typedef size_t __pyx_t_10cython_gsl_14gsl_blas_types_CBLAS_INDEX;

/* "../../.local/lib/python2.7/site-packages/cython_gsl/__init__.pxd":23
 *   GSL_SUCCESS = 0
 * 
 * ctypedef int size_t             # <<<<<<<<<<<<<<
 * from cython_gsl.gsl_mode cimport *
 * from cython_gsl.gsl_math cimport *
 */
typedef int __pyx_t_10cython_gsl_size_t;

/* "fwdpy/fwdpy.pxd":376
 *     freqTraj merge_trajectories_details( const freqTraj & traj1, const freqTraj & traj2 )
 * 
 * ctypedef unsigned uint             # <<<<<<<<<<<<<<
 * cdef extern from "evolve_regions_sampler.hpp" namespace "fwdpy" nogil:
 *     void evolve_regions_sampler_cpp( GSLrng_t * rng,
 */
typedef unsigned int __pyx_t_5fwdpy_5fwdpy_uint;

/*--- Type declarations ---*/
struct __pyx_obj_5fwdpy_8internal_8internal_shwrappervec;
struct __pyx_obj_5fwdpy_8internal_8internal_region_manager_wrapper;
struct __pyx_obj_5fwdpy_5fwdpy_PopType;
struct __pyx_obj_5fwdpy_5fwdpy_Spop;
struct __pyx_obj_5fwdpy_5fwdpy_MetaPop;
struct __pyx_obj_5fwdpy_5fwdpy_MlocusPop;
struct __pyx_obj_5fwdpy_5fwdpy_SpopGenMut;
struct __pyx_obj_5fwdpy_5fwdpy_PopVec;
struct __pyx_obj_5fwdpy_5fwdpy_SpopVec;
struct __pyx_obj_5fwdpy_5fwdpy_SpopGenMutVec;
struct __pyx_obj_5fwdpy_5fwdpy_MetaPopVec;
struct __pyx_obj_5fwdpy_5fwdpy_MlocusPopVec;
struct __pyx_obj_5fwdpy_5fwdpy_GSLrng;
struct __pyx_obj_5fwdpy_5fwdpy_TemporalSampler;
struct __pyx_obj_5fwdpy_5fwdpy_NothingSampler;
struct __pyx_obj_5fwdpy_5fwdpy_QtraitStatsSampler;
struct __pyx_obj_5fwdpy_5fwdpy_PopSampler;
struct __pyx_obj_5fwdpy_5fwdpy_VASampler;
struct __pyx_obj_5fwdpy_5fwdpy_FreqSampler;
struct __pyx_obj_5fwdpy_7fitness_SpopFitness;
struct __pyx_obj_5fwdpy_7fitness_SpopAdditive;
struct __pyx_obj_5fwdpy_7fitness_SpopMult;
struct __pyx_obj_5fwdpy_7fitness_MlocusFitness;
struct __pyx_obj_5fwdpy_7fitness_MlocusAdditive;
struct __pyx_obj_5fwdpy_7fitness_MlocusMult;

/* "../../.local/lib/python2.7/site-packages/cython_gsl/__init__.pxd":20
 * from libc.stdio cimport *
 * 
 * cdef enum:             # <<<<<<<<<<<<<<
 *   GSL_SUCCESS = 0
 * 
 */
enum  {
  __pyx_e_10cython_gsl_GSL_SUCCESS = 0
};
struct __pyx_t_5fwdpy_5fwdpy_popgen_mut_data;
struct __pyx_t_5fwdpy_5fwdpy_gamete_data;
struct __pyx_t_5fwdpy_5fwdpy_diploid_data;
struct __pyx_t_5fwdpy_5fwdpy_diploid_mloc_data;

/* "fwdpy/fwdpy.pxd":17
 * 
 * ##Create hooks to C++ types
 * ctypedef vector[unsigned] ucont_t             # <<<<<<<<<<<<<<
 * 
 * #Wrap the classes:
 */
typedef std::vector<unsigned int>  __pyx_t_5fwdpy_5fwdpy_ucont_t;

/* "fwdpy/fwdpy.pxd":263
 *         vector[VAcum] final()
 * 
 * ctypedef vector[pair[sep_sample_t,popsample_details]] popSampleData             # <<<<<<<<<<<<<<
 * 
 * cdef extern from "sampler_sample_n.hpp" namespace "fwdpy" nogil:
 */
typedef std::vector<std::pair<KTfwd::sep_sample_t,struct fwdpy::popsample_details> >  __pyx_t_5fwdpy_5fwdpy_popSampleData;

/* "fwdpy/fwdpy.pxd":276
 * #The following typedefs help us with the
 * #frequency tracker API.
 * ctypedef pair[uint,double] genfreqPair             # <<<<<<<<<<<<<<
 * ctypedef vector[pair[selected_mut_data,vector[genfreqPair]]] freqTraj
 * 
 */
typedef std::pair<unsigned int,double>  __pyx_t_5fwdpy_5fwdpy_genfreqPair;

/* "fwdpy/fwdpy.pxd":277
 * #frequency tracker API.
 * ctypedef pair[uint,double] genfreqPair
 * ctypedef vector[pair[selected_mut_data,vector[genfreqPair]]] freqTraj             # <<<<<<<<<<<<<<
 * 
 * cdef extern from "sampler_selected_mut_tracker.hpp" namespace "fwdpy" nogil:
 */
typedef std::vector<std::pair<struct fwdpy::selected_mut_data,std::vector<__pyx_t_5fwdpy_5fwdpy_genfreqPair> > >  __pyx_t_5fwdpy_5fwdpy_freqTraj;

/* "fwdpy/fwdpy.pxd":313
 * 
 * #Typedefs for convenience
 * ctypedef vector[popgenmut].iterator mcont_t_itr             # <<<<<<<<<<<<<<
 * ctypedef vector[mcont_t_itr] mut_container_t
 * ctypedef vector[gamete_t].iterator gcont_t_itr
 */
typedef std::vector<KTfwd::popgenmut> ::iterator __pyx_t_5fwdpy_5fwdpy_mcont_t_itr;

/* "fwdpy/fwdpy.pxd":314
 * #Typedefs for convenience
 * ctypedef vector[popgenmut].iterator mcont_t_itr
 * ctypedef vector[mcont_t_itr] mut_container_t             # <<<<<<<<<<<<<<
 * ctypedef vector[gamete_t].iterator gcont_t_itr
 * ctypedef vector[diploid_t].iterator dipvector_t_itr
 */
typedef std::vector<__pyx_t_5fwdpy_5fwdpy_mcont_t_itr>  __pyx_t_5fwdpy_5fwdpy_mut_container_t;

/* "fwdpy/fwdpy.pxd":315
 * ctypedef vector[popgenmut].iterator mcont_t_itr
 * ctypedef vector[mcont_t_itr] mut_container_t
 * ctypedef vector[gamete_t].iterator gcont_t_itr             # <<<<<<<<<<<<<<
 * ctypedef vector[diploid_t].iterator dipvector_t_itr
 * #vector of mutation counts (replaces KTfwd::mutation_base::n in fwdpp >= 0.4.4)
 */
typedef std::vector<fwdpy::gamete_t> ::iterator __pyx_t_5fwdpy_5fwdpy_gcont_t_itr;

/* "fwdpy/fwdpy.pxd":316
 * ctypedef vector[mcont_t_itr] mut_container_t
 * ctypedef vector[gamete_t].iterator gcont_t_itr
 * ctypedef vector[diploid_t].iterator dipvector_t_itr             # <<<<<<<<<<<<<<
 * #vector of mutation counts (replaces KTfwd::mutation_base::n in fwdpp >= 0.4.4)
 * ctypedef ucont_t mcounts_cont_t
 */
typedef std::vector<fwdpy::diploid_t> ::iterator __pyx_t_5fwdpy_5fwdpy_dipvector_t_itr;

/* "fwdpy/fwdpy.pxd":318
 * ctypedef vector[diploid_t].iterator dipvector_t_itr
 * #vector of mutation counts (replaces KTfwd::mutation_base::n in fwdpp >= 0.4.4)
 * ctypedef ucont_t mcounts_cont_t             # <<<<<<<<<<<<<<
 * 
 * ##Define some low-level functions that may be useful for others
 */
typedef __pyx_t_5fwdpy_5fwdpy_ucont_t __pyx_t_5fwdpy_5fwdpy_mcounts_cont_t;

/* "fwdpy/fwdpy.pxd":321
 * 
 * ##Define some low-level functions that may be useful for others
 * cdef struct popgen_mut_data:             # <<<<<<<<<<<<<<
 *     double pos,s,h
 *     unsigned n,g,ftime
 */
struct __pyx_t_5fwdpy_5fwdpy_popgen_mut_data {
  double pos;
  double s;
  double h;
  unsigned int n;
  unsigned int g;
  unsigned int ftime;
  int neutral;
  uint16_t label;
};

/* "fwdpy/fwdpy.pxd":327
 *     uint16_t label
 * 
 * cdef struct gamete_data:             # <<<<<<<<<<<<<<
 *     vector[popgen_mut_data] neutral,selected
 *     unsigned n
 */
struct __pyx_t_5fwdpy_5fwdpy_gamete_data {
  std::vector<struct __pyx_t_5fwdpy_5fwdpy_popgen_mut_data>  neutral;
  std::vector<struct __pyx_t_5fwdpy_5fwdpy_popgen_mut_data>  selected;
  unsigned int n;
};

/* "fwdpy/fwdpy.pxd":331
 *     unsigned n
 * 
 * cdef struct diploid_data:             # <<<<<<<<<<<<<<
 *     gamete_data chrom0,chrom1
 *     double g,e,w,sh0,sh1
 */
struct __pyx_t_5fwdpy_5fwdpy_diploid_data {
  struct __pyx_t_5fwdpy_5fwdpy_gamete_data chrom0;
  struct __pyx_t_5fwdpy_5fwdpy_gamete_data chrom1;
  double g;
  double e;
  double w;
  double sh0;
  double sh1;
  int n0;
  int n1;
};

/* "fwdpy/fwdpy.pxd":336
 *     int n0,n1
 * 
 * cdef struct diploid_mloc_data:             # <<<<<<<<<<<<<<
 *     vector[gamete_data] chrom0,chrom1
 *     double g,e,w
 */
struct __pyx_t_5fwdpy_5fwdpy_diploid_mloc_data {
  std::vector<struct __pyx_t_5fwdpy_5fwdpy_gamete_data>  chrom0;
  std::vector<struct __pyx_t_5fwdpy_5fwdpy_gamete_data>  chrom1;
  double g;
  double e;
  double w;
  std::vector<double>  sh0;
  std::vector<double>  sh1;
  std::vector<int>  n0;
  std::vector<int>  n1;
};

/* "fwdpy/fitness.pxd":10
 *     T max[T](T,T)
 * 
 * ctypedef gamete_base[void] gamete_t             # <<<<<<<<<<<<<<
 * ctypedef vector[gamete_t] gcont_t
 * ctypedef vector[popgenmut] mcont_t
 */
typedef KTfwd::gamete_base<void>  __pyx_t_5fwdpy_7fitness_gamete_t;

/* "fwdpy/fitness.pxd":11
 * 
 * ctypedef gamete_base[void] gamete_t
 * ctypedef vector[gamete_t] gcont_t             # <<<<<<<<<<<<<<
 * ctypedef vector[popgenmut] mcont_t
 * 
 */
typedef std::vector<__pyx_t_5fwdpy_7fitness_gamete_t>  __pyx_t_5fwdpy_7fitness_gcont_t;

/* "fwdpy/fitness.pxd":12
 * ctypedef gamete_base[void] gamete_t
 * ctypedef vector[gamete_t] gcont_t
 * ctypedef vector[popgenmut] mcont_t             # <<<<<<<<<<<<<<
 * 
 * cdef extern from "fwdpy_fitness.hpp" namespace "fwdpy" nogil:
 */
typedef std::vector<KTfwd::popgenmut>  __pyx_t_5fwdpy_7fitness_mcont_t;

/* "fwdpy/internal/internal.pxd":7
 * 
 * ##These are the callback wrappers from fwdpp
 * cdef class shwrappervec:             # <<<<<<<<<<<<<<
 *     """
 *     Wrapper for a vector of callback objects from fwdpp's extension library.
 */
struct __pyx_obj_5fwdpy_8internal_8internal_shwrappervec {
  PyObject_HEAD
  std::vector<KTfwd::extensions::shmodel>  vec;
};


/* "fwdpy/internal/internal.pxd":17
 * 
 * ##Quick wrapper for region_manager
 * cdef class region_manager_wrapper:             # <<<<<<<<<<<<<<
 *     cdef region_manager * thisptr
 * 
 */
struct __pyx_obj_5fwdpy_8internal_8internal_region_manager_wrapper {
  PyObject_HEAD
  fwdpy::internal::region_manager *thisptr;
};


/* "fwdpy/fwdpy.pxd":124
 * 
 * #Now, provide definitions for classes in classes.pyx
 * cdef class PopType(object):             # <<<<<<<<<<<<<<
 *     """
 *     Empty base class for a population object.
 */
struct __pyx_obj_5fwdpy_5fwdpy_PopType {
  PyObject_HEAD
};


/* "fwdpy/fwdpy.pxd":132
 *     pass
 * 
 * cdef class Spop(PopType):             # <<<<<<<<<<<<<<
 *     cdef shared_ptr[singlepop_t] pop
 *     cpdef gen(self)
 */
struct __pyx_obj_5fwdpy_5fwdpy_Spop {
  struct __pyx_obj_5fwdpy_5fwdpy_PopType __pyx_base;
  struct __pyx_vtabstruct_5fwdpy_5fwdpy_Spop *__pyx_vtab;
  std::shared_ptr<fwdpy::singlepop_t>  pop;
};


/* "fwdpy/fwdpy.pxd":138
 *     cpdef sane(self)
 * 
 * cdef class MetaPop(PopType):             # <<<<<<<<<<<<<<
 *     cdef shared_ptr[metapop_t] mpop
 *     cpdef gen(self)
 */
struct __pyx_obj_5fwdpy_5fwdpy_MetaPop {
  struct __pyx_obj_5fwdpy_5fwdpy_PopType __pyx_base;
  struct __pyx_vtabstruct_5fwdpy_5fwdpy_MetaPop *__pyx_vtab;
  std::shared_ptr<fwdpy::metapop_t>  mpop;
};


/* "fwdpy/fwdpy.pxd":145
 *     cpdef from_Spop(self,Spop p)
 * 
 * cdef class MlocusPop(PopType):             # <<<<<<<<<<<<<<
 *     cdef shared_ptr[multilocus_t] pop
 *     cpdef gen(self)
 */
struct __pyx_obj_5fwdpy_5fwdpy_MlocusPop {
  struct __pyx_obj_5fwdpy_5fwdpy_PopType __pyx_base;
  struct __pyx_vtabstruct_5fwdpy_5fwdpy_MlocusPop *__pyx_vtab;
  std::shared_ptr<fwdpy::multilocus_t>  pop;
};


/* "fwdpy/fwdpy.pxd":151
 *     cpdef sane(self)
 * 
 * cdef class SpopGenMut(PopType):             # <<<<<<<<<<<<<<
 *     cdef shared_ptr[singlepop_gm_vec_t] pop
 *     cpdef gen(self)
 */
struct __pyx_obj_5fwdpy_5fwdpy_SpopGenMut {
  struct __pyx_obj_5fwdpy_5fwdpy_PopType __pyx_base;
  struct __pyx_vtabstruct_5fwdpy_5fwdpy_SpopGenMut *__pyx_vtab;
  std::shared_ptr<fwdpy::singlepop_gm_vec_t>  pop;
};


/* "fwdpy/fwdpy.pxd":157
 *     cpdef sane(self)
 * 
 * cdef class PopVec(object):             # <<<<<<<<<<<<<<
 *     """
 *     Empty base class for containers of population objects.
 */
struct __pyx_obj_5fwdpy_5fwdpy_PopVec {
  PyObject_HEAD
};


/* "fwdpy/fwdpy.pxd":165
 *     pass
 * 
 * cdef class SpopVec(PopVec):             # <<<<<<<<<<<<<<
 *     cdef vector[shared_ptr[singlepop_t]] pops
 *     cpdef size(self)
 */
struct __pyx_obj_5fwdpy_5fwdpy_SpopVec {
  struct __pyx_obj_5fwdpy_5fwdpy_PopVec __pyx_base;
  struct __pyx_vtabstruct_5fwdpy_5fwdpy_SpopVec *__pyx_vtab;
  std::vector<std::shared_ptr<fwdpy::singlepop_t> >  pops;
};


/* "fwdpy/fwdpy.pxd":171
 *     cpdef append(self,SpopVec p)
 * 
 * cdef class SpopGenMutVec(PopVec):             # <<<<<<<<<<<<<<
 *     cdef vector[shared_ptr[singlepop_gm_vec_t]] pops
 *     cpdef size(self)
 */
struct __pyx_obj_5fwdpy_5fwdpy_SpopGenMutVec {
  struct __pyx_obj_5fwdpy_5fwdpy_PopVec __pyx_base;
  struct __pyx_vtabstruct_5fwdpy_5fwdpy_SpopGenMutVec *__pyx_vtab;
  std::vector<std::shared_ptr<fwdpy::singlepop_gm_vec_t> >  pops;
};


/* "fwdpy/fwdpy.pxd":176
 *     cdef reset(self,const vector[shared_ptr[singlepop_gm_vec_t]] newpops)
 * 
 * cdef class MetaPopVec(PopVec):             # <<<<<<<<<<<<<<
 *     cdef vector[shared_ptr[metapop_t]] mpops
 *     cpdef size(self)
 */
struct __pyx_obj_5fwdpy_5fwdpy_MetaPopVec {
  struct __pyx_obj_5fwdpy_5fwdpy_PopVec __pyx_base;
  struct __pyx_vtabstruct_5fwdpy_5fwdpy_MetaPopVec *__pyx_vtab;
  std::vector<std::shared_ptr<fwdpy::metapop_t> >  mpops;
};


/* "fwdpy/fwdpy.pxd":182
 *     cpdef append(self,MetaPopVec p)
 * 
 * cdef class MlocusPopVec(PopVec):             # <<<<<<<<<<<<<<
 *     cdef vector[shared_ptr[multilocus_t]] pops
 *     cpdef size(self)
 */
struct __pyx_obj_5fwdpy_5fwdpy_MlocusPopVec {
  struct __pyx_obj_5fwdpy_5fwdpy_PopVec __pyx_base;
  struct __pyx_vtabstruct_5fwdpy_5fwdpy_MlocusPopVec *__pyx_vtab;
  std::vector<std::shared_ptr<fwdpy::multilocus_t> >  pops;
};


/* "fwdpy/fwdpy.pxd":189
 * 
 * 
 * cdef class GSLrng:             # <<<<<<<<<<<<<<
 *     cdef GSLrng_t * thisptr
 * 
 */
struct __pyx_obj_5fwdpy_5fwdpy_GSLrng {
  PyObject_HEAD
  fwdpy::GSLrng_t *thisptr;
};


/* "fwdpy/fwdpy.pxd":285
 * 
 * #Extension classes for temporal sampling
 * cdef class TemporalSampler:             # <<<<<<<<<<<<<<
 *     """
 *     Base class representing containers of functions
 */
struct __pyx_obj_5fwdpy_5fwdpy_TemporalSampler {
  PyObject_HEAD
  struct __pyx_vtabstruct_5fwdpy_5fwdpy_TemporalSampler *__pyx_vtab;
  std::vector<std::unique_ptr<fwdpy::sampler_base> >  vec;
};


/* "fwdpy/fwdpy.pxd":293
 *     cpdef size_t size(self)
 * 
 * cdef class NothingSampler(TemporalSampler):             # <<<<<<<<<<<<<<
 *     pass
 * 
 */
struct __pyx_obj_5fwdpy_5fwdpy_NothingSampler {
  struct __pyx_obj_5fwdpy_5fwdpy_TemporalSampler __pyx_base;
};


/* "fwdpy/fwdpy.pxd":296
 *     pass
 * 
 * cdef class QtraitStatsSampler(TemporalSampler):             # <<<<<<<<<<<<<<
 *     pass
 * 
 */
struct __pyx_obj_5fwdpy_5fwdpy_QtraitStatsSampler {
  struct __pyx_obj_5fwdpy_5fwdpy_TemporalSampler __pyx_base;
};


/* "fwdpy/fwdpy.pxd":299
 *     pass
 * 
 * cdef class PopSampler(TemporalSampler):             # <<<<<<<<<<<<<<
 *     pass
 * 
 */
struct __pyx_obj_5fwdpy_5fwdpy_PopSampler {
  struct __pyx_obj_5fwdpy_5fwdpy_TemporalSampler __pyx_base;
};


/* "fwdpy/fwdpy.pxd":302
 *     pass
 * 
 * cdef class VASampler(TemporalSampler):             # <<<<<<<<<<<<<<
 *     pass
 * 
 */
struct __pyx_obj_5fwdpy_5fwdpy_VASampler {
  struct __pyx_obj_5fwdpy_5fwdpy_TemporalSampler __pyx_base;
};


/* "fwdpy/fwdpy.pxd":305
 *     pass
 * 
 * cdef class FreqSampler(TemporalSampler):             # <<<<<<<<<<<<<<
 *     pass
 * 
 */
struct __pyx_obj_5fwdpy_5fwdpy_FreqSampler {
  struct __pyx_obj_5fwdpy_5fwdpy_TemporalSampler __pyx_base;
};


/* "fwdpy/fitness.pxd":108
 *     return rv
 * 
 * cdef class SpopFitness(object):             # <<<<<<<<<<<<<<
 *     """
 *     Base object for single-deme fitness functions
 */
struct __pyx_obj_5fwdpy_7fitness_SpopFitness {
  PyObject_HEAD
  std::unique_ptr<fwdpy::singlepop_fitness>  wfxn;
};


/* "fwdpy/fitness.pxd":114
 *     cdef unique_ptr[singlepop_fitness] wfxn
 * 
 * cdef class SpopAdditive(SpopFitness):             # <<<<<<<<<<<<<<
 *     pass
 * 
 */
struct __pyx_obj_5fwdpy_7fitness_SpopAdditive {
  struct __pyx_obj_5fwdpy_7fitness_SpopFitness __pyx_base;
};


/* "fwdpy/fitness.pxd":117
 *     pass
 * 
 * cdef class SpopMult(SpopFitness):             # <<<<<<<<<<<<<<
 *     pass
 * 
 */
struct __pyx_obj_5fwdpy_7fitness_SpopMult {
  struct __pyx_obj_5fwdpy_7fitness_SpopFitness __pyx_base;
};


/* "fwdpy/fitness.pxd":120
 *     pass
 * 
 * cdef class MlocusFitness(object):             # <<<<<<<<<<<<<<
 *     """
 *     Base object for multi-locus fitness functions
 */
struct __pyx_obj_5fwdpy_7fitness_MlocusFitness {
  PyObject_HEAD
  fwdpy::multilocus_fitness wfxn;
};


/* "fwdpy/fitness.pxd":126
 *     cdef multilocus_fitness wfxn
 * 
 * cdef class MlocusAdditive(MlocusFitness):             # <<<<<<<<<<<<<<
 *     pass
 * 
 */
struct __pyx_obj_5fwdpy_7fitness_MlocusAdditive {
  struct __pyx_obj_5fwdpy_7fitness_MlocusFitness __pyx_base;
};


/* "fwdpy/fitness.pxd":129
 *     pass
 * 
 * cdef class MlocusMult(MlocusFitness):             # <<<<<<<<<<<<<<
 *     pass
 * 
 */
struct __pyx_obj_5fwdpy_7fitness_MlocusMult {
  struct __pyx_obj_5fwdpy_7fitness_MlocusFitness __pyx_base;
};



/* "fwdpy/fwdpy.pxd":132
 *     pass
 * 
 * cdef class Spop(PopType):             # <<<<<<<<<<<<<<
 *     cdef shared_ptr[singlepop_t] pop
 *     cpdef gen(self)
 */

struct __pyx_vtabstruct_5fwdpy_5fwdpy_Spop {
  PyObject *(*gen)(struct __pyx_obj_5fwdpy_5fwdpy_Spop *, int __pyx_skip_dispatch);
  PyObject *(*popsize)(struct __pyx_obj_5fwdpy_5fwdpy_Spop *, int __pyx_skip_dispatch);
  PyObject *(*sane)(struct __pyx_obj_5fwdpy_5fwdpy_Spop *, int __pyx_skip_dispatch);
};
static struct __pyx_vtabstruct_5fwdpy_5fwdpy_Spop *__pyx_vtabptr_5fwdpy_5fwdpy_Spop;


/* "fwdpy/fwdpy.pxd":138
 *     cpdef sane(self)
 * 
 * cdef class MetaPop(PopType):             # <<<<<<<<<<<<<<
 *     cdef shared_ptr[metapop_t] mpop
 *     cpdef gen(self)
 */

struct __pyx_vtabstruct_5fwdpy_5fwdpy_MetaPop {
  PyObject *(*gen)(struct __pyx_obj_5fwdpy_5fwdpy_MetaPop *, int __pyx_skip_dispatch);
  PyObject *(*popsizes)(struct __pyx_obj_5fwdpy_5fwdpy_MetaPop *, int __pyx_skip_dispatch);
  PyObject *(*sane)(struct __pyx_obj_5fwdpy_5fwdpy_MetaPop *, int __pyx_skip_dispatch);
  PyObject *(*from_Spop)(struct __pyx_obj_5fwdpy_5fwdpy_MetaPop *, struct __pyx_obj_5fwdpy_5fwdpy_Spop *, int __pyx_skip_dispatch);
};
static struct __pyx_vtabstruct_5fwdpy_5fwdpy_MetaPop *__pyx_vtabptr_5fwdpy_5fwdpy_MetaPop;


/* "fwdpy/fwdpy.pxd":145
 *     cpdef from_Spop(self,Spop p)
 * 
 * cdef class MlocusPop(PopType):             # <<<<<<<<<<<<<<
 *     cdef shared_ptr[multilocus_t] pop
 *     cpdef gen(self)
 */

struct __pyx_vtabstruct_5fwdpy_5fwdpy_MlocusPop {
  PyObject *(*gen)(struct __pyx_obj_5fwdpy_5fwdpy_MlocusPop *, int __pyx_skip_dispatch);
  PyObject *(*popsize)(struct __pyx_obj_5fwdpy_5fwdpy_MlocusPop *, int __pyx_skip_dispatch);
  PyObject *(*sane)(struct __pyx_obj_5fwdpy_5fwdpy_MlocusPop *, int __pyx_skip_dispatch);
};
static struct __pyx_vtabstruct_5fwdpy_5fwdpy_MlocusPop *__pyx_vtabptr_5fwdpy_5fwdpy_MlocusPop;


/* "fwdpy/fwdpy.pxd":151
 *     cpdef sane(self)
 * 
 * cdef class SpopGenMut(PopType):             # <<<<<<<<<<<<<<
 *     cdef shared_ptr[singlepop_gm_vec_t] pop
 *     cpdef gen(self)
 */

struct __pyx_vtabstruct_5fwdpy_5fwdpy_SpopGenMut {
  PyObject *(*gen)(struct __pyx_obj_5fwdpy_5fwdpy_SpopGenMut *, int __pyx_skip_dispatch);
  PyObject *(*popsize)(struct __pyx_obj_5fwdpy_5fwdpy_SpopGenMut *, int __pyx_skip_dispatch);
  PyObject *(*sane)(struct __pyx_obj_5fwdpy_5fwdpy_SpopGenMut *, int __pyx_skip_dispatch);
};
static struct __pyx_vtabstruct_5fwdpy_5fwdpy_SpopGenMut *__pyx_vtabptr_5fwdpy_5fwdpy_SpopGenMut;


/* "fwdpy/fwdpy.pxd":165
 *     pass
 * 
 * cdef class SpopVec(PopVec):             # <<<<<<<<<<<<<<
 *     cdef vector[shared_ptr[singlepop_t]] pops
 *     cpdef size(self)
 */

struct __pyx_vtabstruct_5fwdpy_5fwdpy_SpopVec {
  PyObject *(*size)(struct __pyx_obj_5fwdpy_5fwdpy_SpopVec *, int __pyx_skip_dispatch);
  PyObject *(*reset)(struct __pyx_obj_5fwdpy_5fwdpy_SpopVec *, std::vector<std::shared_ptr<fwdpy::singlepop_t> >  const );
  PyObject *(*append)(struct __pyx_obj_5fwdpy_5fwdpy_SpopVec *, struct __pyx_obj_5fwdpy_5fwdpy_SpopVec *, int __pyx_skip_dispatch);
};
static struct __pyx_vtabstruct_5fwdpy_5fwdpy_SpopVec *__pyx_vtabptr_5fwdpy_5fwdpy_SpopVec;


/* "fwdpy/fwdpy.pxd":171
 *     cpdef append(self,SpopVec p)
 * 
 * cdef class SpopGenMutVec(PopVec):             # <<<<<<<<<<<<<<
 *     cdef vector[shared_ptr[singlepop_gm_vec_t]] pops
 *     cpdef size(self)
 */

struct __pyx_vtabstruct_5fwdpy_5fwdpy_SpopGenMutVec {
  PyObject *(*size)(struct __pyx_obj_5fwdpy_5fwdpy_SpopGenMutVec *, int __pyx_skip_dispatch);
  PyObject *(*reset)(struct __pyx_obj_5fwdpy_5fwdpy_SpopGenMutVec *, std::vector<std::shared_ptr<fwdpy::singlepop_gm_vec_t> >  const );
};
static struct __pyx_vtabstruct_5fwdpy_5fwdpy_SpopGenMutVec *__pyx_vtabptr_5fwdpy_5fwdpy_SpopGenMutVec;


/* "fwdpy/fwdpy.pxd":176
 *     cdef reset(self,const vector[shared_ptr[singlepop_gm_vec_t]] newpops)
 * 
 * cdef class MetaPopVec(PopVec):             # <<<<<<<<<<<<<<
 *     cdef vector[shared_ptr[metapop_t]] mpops
 *     cpdef size(self)
 */

struct __pyx_vtabstruct_5fwdpy_5fwdpy_MetaPopVec {
  PyObject *(*size)(struct __pyx_obj_5fwdpy_5fwdpy_MetaPopVec *, int __pyx_skip_dispatch);
  PyObject *(*reset)(struct __pyx_obj_5fwdpy_5fwdpy_MetaPopVec *, std::vector<std::shared_ptr<fwdpy::metapop_t> >  const &);
  PyObject *(*append)(struct __pyx_obj_5fwdpy_5fwdpy_MetaPopVec *, struct __pyx_obj_5fwdpy_5fwdpy_MetaPopVec *, int __pyx_skip_dispatch);
};
static struct __pyx_vtabstruct_5fwdpy_5fwdpy_MetaPopVec *__pyx_vtabptr_5fwdpy_5fwdpy_MetaPopVec;


/* "fwdpy/fwdpy.pxd":182
 *     cpdef append(self,MetaPopVec p)
 * 
 * cdef class MlocusPopVec(PopVec):             # <<<<<<<<<<<<<<
 *     cdef vector[shared_ptr[multilocus_t]] pops
 *     cpdef size(self)
 */

struct __pyx_vtabstruct_5fwdpy_5fwdpy_MlocusPopVec {
  PyObject *(*size)(struct __pyx_obj_5fwdpy_5fwdpy_MlocusPopVec *, int __pyx_skip_dispatch);
  PyObject *(*reset)(struct __pyx_obj_5fwdpy_5fwdpy_MlocusPopVec *, std::vector<std::shared_ptr<fwdpy::multilocus_t> >  const );
  PyObject *(*append)(struct __pyx_obj_5fwdpy_5fwdpy_MlocusPopVec *, struct __pyx_obj_5fwdpy_5fwdpy_MlocusPopVec *, int __pyx_skip_dispatch);
};
static struct __pyx_vtabstruct_5fwdpy_5fwdpy_MlocusPopVec *__pyx_vtabptr_5fwdpy_5fwdpy_MlocusPopVec;


/* "fwdpy/fwdpy.pxd":285
 * 
 * #Extension classes for temporal sampling
 * cdef class TemporalSampler:             # <<<<<<<<<<<<<<
 *     """
 *     Base class representing containers of functions
 */

struct __pyx_vtabstruct_5fwdpy_5fwdpy_TemporalSampler {
  size_t (*size)(struct __pyx_obj_5fwdpy_5fwdpy_TemporalSampler *, int __pyx_skip_dispatch);
};
static struct __pyx_vtabstruct_5fwdpy_5fwdpy_TemporalSampler *__pyx_vtabptr_5fwdpy_5fwdpy_TemporalSampler;


/* "fwdpy/fwdpy.pxd":293
 *     cpdef size_t size(self)
 * 
 * cdef class NothingSampler(TemporalSampler):             # <<<<<<<<<<<<<<
 *     pass
 * 
 */

struct __pyx_vtabstruct_5fwdpy_5fwdpy_NothingSampler {
  struct __pyx_vtabstruct_5fwdpy_5fwdpy_TemporalSampler __pyx_base;
};
static struct __pyx_vtabstruct_5fwdpy_5fwdpy_NothingSampler *__pyx_vtabptr_5fwdpy_5fwdpy_NothingSampler;


/* "fwdpy/fwdpy.pxd":296
 *     pass
 * 
 * cdef class QtraitStatsSampler(TemporalSampler):             # <<<<<<<<<<<<<<
 *     pass
 * 
 */

struct __pyx_vtabstruct_5fwdpy_5fwdpy_QtraitStatsSampler {
  struct __pyx_vtabstruct_5fwdpy_5fwdpy_TemporalSampler __pyx_base;
};
static struct __pyx_vtabstruct_5fwdpy_5fwdpy_QtraitStatsSampler *__pyx_vtabptr_5fwdpy_5fwdpy_QtraitStatsSampler;


/* "fwdpy/fwdpy.pxd":299
 *     pass
 * 
 * cdef class PopSampler(TemporalSampler):             # <<<<<<<<<<<<<<
 *     pass
 * 
 */

struct __pyx_vtabstruct_5fwdpy_5fwdpy_PopSampler {
  struct __pyx_vtabstruct_5fwdpy_5fwdpy_TemporalSampler __pyx_base;
};
static struct __pyx_vtabstruct_5fwdpy_5fwdpy_PopSampler *__pyx_vtabptr_5fwdpy_5fwdpy_PopSampler;


/* "fwdpy/fwdpy.pxd":302
 *     pass
 * 
 * cdef class VASampler(TemporalSampler):             # <<<<<<<<<<<<<<
 *     pass
 * 
 */

struct __pyx_vtabstruct_5fwdpy_5fwdpy_VASampler {
  struct __pyx_vtabstruct_5fwdpy_5fwdpy_TemporalSampler __pyx_base;
};
static struct __pyx_vtabstruct_5fwdpy_5fwdpy_VASampler *__pyx_vtabptr_5fwdpy_5fwdpy_VASampler;


/* "fwdpy/fwdpy.pxd":305
 *     pass
 * 
 * cdef class FreqSampler(TemporalSampler):             # <<<<<<<<<<<<<<
 *     pass
 * 
 */

struct __pyx_vtabstruct_5fwdpy_5fwdpy_FreqSampler {
  struct __pyx_vtabstruct_5fwdpy_5fwdpy_TemporalSampler __pyx_base;
};
static struct __pyx_vtabstruct_5fwdpy_5fwdpy_FreqSampler *__pyx_vtabptr_5fwdpy_5fwdpy_FreqSampler;

/* --- Runtime support code (head) --- */
/* Refnanny.proto */
#ifndef CYTHON_REFNANNY
  #define CYTHON_REFNANNY 0
#endif
#if CYTHON_REFNANNY
  typedef struct {
    void (*INCREF)(void*, PyObject*, int);
    void (*DECREF)(void*, PyObject*, int);
    void (*GOTREF)(void*, PyObject*, int);
    void (*GIVEREF)(void*, PyObject*, int);
    void* (*SetupContext)(const char*, int, const char*);
    void (*FinishContext)(void**);
  } __Pyx_RefNannyAPIStruct;
  static __Pyx_RefNannyAPIStruct *__Pyx_RefNanny = NULL;
  static __Pyx_RefNannyAPIStruct *__Pyx_RefNannyImportAPI(const char *modname);
  #define __Pyx_RefNannyDeclarations void *__pyx_refnanny = NULL;
#ifdef WITH_THREAD
  #define __Pyx_RefNannySetupContext(name, acquire_gil)\
          if (acquire_gil) {\
              PyGILState_STATE __pyx_gilstate_save = PyGILState_Ensure();\
              __pyx_refnanny = __Pyx_RefNanny->SetupContext((name), __LINE__, __FILE__);\
              PyGILState_Release(__pyx_gilstate_save);\
          } else {\
              __pyx_refnanny = __Pyx_RefNanny->SetupContext((name), __LINE__, __FILE__);\
          }
#else
  #define __Pyx_RefNannySetupContext(name, acquire_gil)\
          __pyx_refnanny = __Pyx_RefNanny->SetupContext((name), __LINE__, __FILE__)
#endif
  #define __Pyx_RefNannyFinishContext()\
          __Pyx_RefNanny->FinishContext(&__pyx_refnanny)
  #define __Pyx_INCREF(r)  __Pyx_RefNanny->INCREF(__pyx_refnanny, (PyObject *)(r), __LINE__)
  #define __Pyx_DECREF(r)  __Pyx_RefNanny->DECREF(__pyx_refnanny, (PyObject *)(r), __LINE__)
  #define __Pyx_GOTREF(r)  __Pyx_RefNanny->GOTREF(__pyx_refnanny, (PyObject *)(r), __LINE__)
  #define __Pyx_GIVEREF(r) __Pyx_RefNanny->GIVEREF(__pyx_refnanny, (PyObject *)(r), __LINE__)
  #define __Pyx_XINCREF(r)  do { if((r) != NULL) {__Pyx_INCREF(r); }} while(0)
  #define __Pyx_XDECREF(r)  do { if((r) != NULL) {__Pyx_DECREF(r); }} while(0)
  #define __Pyx_XGOTREF(r)  do { if((r) != NULL) {__Pyx_GOTREF(r); }} while(0)
  #define __Pyx_XGIVEREF(r) do { if((r) != NULL) {__Pyx_GIVEREF(r);}} while(0)
#else
  #define __Pyx_RefNannyDeclarations
  #define __Pyx_RefNannySetupContext(name, acquire_gil)
  #define __Pyx_RefNannyFinishContext()
  #define __Pyx_INCREF(r) Py_INCREF(r)
  #define __Pyx_DECREF(r) Py_DECREF(r)
  #define __Pyx_GOTREF(r)
  #define __Pyx_GIVEREF(r)
  #define __Pyx_XINCREF(r) Py_XINCREF(r)
  #define __Pyx_XDECREF(r) Py_XDECREF(r)
  #define __Pyx_XGOTREF(r)
  #define __Pyx_XGIVEREF(r)
#endif
#define __Pyx_XDECREF_SET(r, v) do {\
        PyObject *tmp = (PyObject *) r;\
        r = v; __Pyx_XDECREF(tmp);\
    } while (0)
#define __Pyx_DECREF_SET(r, v) do {\
        PyObject *tmp = (PyObject *) r;\
        r = v; __Pyx_DECREF(tmp);\
    } while (0)
#define __Pyx_CLEAR(r)    do { PyObject* tmp = ((PyObject*)(r)); r = NULL; __Pyx_DECREF(tmp);} while(0)
#define __Pyx_XCLEAR(r)   do { if((r) != NULL) {PyObject* tmp = ((PyObject*)(r)); r = NULL; __Pyx_DECREF(tmp);}} while(0)

/* RaiseDoubleKeywords.proto */
static void __Pyx_RaiseDoubleKeywordsError(const char* func_name, PyObject* kw_name);

/* ParseKeywords.proto */
static int __Pyx_ParseOptionalKeywords(PyObject *kwds, PyObject **argnames[],\
    PyObject *kwds2, PyObject *values[], Py_ssize_t num_pos_args,\
    const char* function_name);

/* RaiseArgTupleInvalid.proto */
static void __Pyx_RaiseArgtupleInvalid(const char* func_name, int exact,
    Py_ssize_t num_min, Py_ssize_t num_max, Py_ssize_t num_found);

/* GetVTable.proto */
static void* __Pyx_GetVtable(PyObject *dict);

/* CodeObjectCache.proto */
typedef struct {
    PyCodeObject* code_object;
    int code_line;
} __Pyx_CodeObjectCacheEntry;
struct __Pyx_CodeObjectCache {
    int count;
    int max_count;
    __Pyx_CodeObjectCacheEntry* entries;
};
static struct __Pyx_CodeObjectCache __pyx_code_cache = {0,0,NULL};
static int __pyx_bisect_code_objects(__Pyx_CodeObjectCacheEntry* entries, int count, int code_line);
static PyCodeObject *__pyx_find_code_object(int code_line);
static void __pyx_insert_code_object(int code_line, PyCodeObject* code_object);

/* AddTraceback.proto */
static void __Pyx_AddTraceback(const char *funcname, int c_line,
                               int py_line, const char *filename);

/* None.proto */
#include <new>

/* CIntFromPy.proto */
static CYTHON_INLINE int __Pyx_PyInt_As_int(PyObject *);

/* CIntToPy.proto */
static CYTHON_INLINE PyObject* __Pyx_PyInt_From_long(long value);

/* CIntFromPy.proto */
static CYTHON_INLINE long __Pyx_PyInt_As_long(PyObject *);

/* CheckBinaryVersion.proto */
static int __Pyx_check_binary_version(void);

/* PyIdentifierFromString.proto */
#if !defined(__Pyx_PyIdentifier_FromString)
#if PY_MAJOR_VERSION < 3
  #define __Pyx_PyIdentifier_FromString(s) PyString_FromString(s)
#else
  #define __Pyx_PyIdentifier_FromString(s) PyUnicode_FromString(s)
#endif
#endif

/* ModuleImport.proto */
static PyObject *__Pyx_ImportModule(const char *name);

/* TypeImport.proto */
static PyTypeObject *__Pyx_ImportType(const char *module_name, const char *class_name, size_t size, int strict);

/* InitStrings.proto */
static int __Pyx_InitStrings(__Pyx_StringTabEntry *t);


/* Module declarations from 'libcpp.vector' */

/* Module declarations from 'libcpp.utility' */

/* Module declarations from 'libc.string' */

/* Module declarations from 'libcpp.string' */

/* Module declarations from 'libcpp' */

/* Module declarations from 'libcpp.memory' */

/* Module declarations from 'libcpp.map' */

/* Module declarations from 'libc.stdint' */

/* Module declarations from 'libc.math' */

/* Module declarations from 'libc.stdio' */

/* Module declarations from 'cython_gsl.gsl_mode' */

/* Module declarations from 'cython_gsl.gsl_math' */

/* Module declarations from 'cython_gsl.gsl_complex' */

/* Module declarations from 'cython_gsl.gsl_poly' */

/* Module declarations from 'cython_gsl.gsl_sf_result' */

/* Module declarations from 'cython_gsl.gsl_airy' */

/* Module declarations from 'cython_gsl.gsl_bessel' */

/* Module declarations from 'cython_gsl.gsl_clausen' */

/* Module declarations from 'cython_gsl.gsl_coulomb' */

/* Module declarations from 'cython_gsl.gsl_coupling' */

/* Module declarations from 'cython_gsl.gsl_dawson' */

/* Module declarations from 'cython_gsl.gsl_debye' */

/* Module declarations from 'cython_gsl.gsl_dilog' */

/* Module declarations from 'cython_gsl.gsl_elementary' */

/* Module declarations from 'cython_gsl.gsl_ellint' */

/* Module declarations from 'cython_gsl.gsl_elljac' */

/* Module declarations from 'cython_gsl.gsl_erf' */

/* Module declarations from 'cython_gsl.gsl_exp' */

/* Module declarations from 'cython_gsl.gsl_expint' */

/* Module declarations from 'cython_gsl.gsl_fermi_dirac' */

/* Module declarations from 'cython_gsl.gsl_gamma' */

/* Module declarations from 'cython_gsl.gsl_gegenbauer' */

/* Module declarations from 'cython_gsl.gsl_hyperg' */

/* Module declarations from 'cython_gsl.gsl_laguerre' */

/* Module declarations from 'cython_gsl.gsl_lambert' */

/* Module declarations from 'cython_gsl.gsl_legendre' */

/* Module declarations from 'cython_gsl.gsl_log' */

/* Module declarations from 'cython_gsl.gsl_pow_int' */

/* Module declarations from 'cython_gsl.gsl_psi' */

/* Module declarations from 'cython_gsl.gsl_synchrotron' */

/* Module declarations from 'cython_gsl.gsl_transport' */

/* Module declarations from 'cython_gsl.gsl_trig' */

/* Module declarations from 'cython_gsl.gsl_zeta' */

/* Module declarations from 'cython_gsl.gsl_block' */

/* Module declarations from 'cython_gsl.gsl_vector' */

/* Module declarations from 'cython_gsl.gsl_vector_complex' */

/* Module declarations from 'cython_gsl.gsl_matrix' */

/* Module declarations from 'cython_gsl.gsl_matrix_complex' */

/* Module declarations from 'cython_gsl.gsl_permutation' */

/* Module declarations from 'cython_gsl.gsl_combination' */

/* Module declarations from 'cython_gsl.gsl_sort' */

/* Module declarations from 'cython_gsl.gsl_blas_types' */

/* Module declarations from 'cython_gsl.gsl_blas' */

/* Module declarations from 'cython_gsl.gsl_linalg' */

/* Module declarations from 'cython_gsl.gsl_eigen' */

/* Module declarations from 'cython_gsl.gsl_fft' */

/* Module declarations from 'cython_gsl.gsl_integration' */

/* Module declarations from 'cython_gsl.gsl_rng' */

/* Module declarations from 'cython_gsl.gsl_qrng' */

/* Module declarations from 'cython_gsl.gsl_random' */

/* Module declarations from 'cython_gsl.gsl_statistics' */

/* Module declarations from 'cython_gsl.gsl_histogram' */

/* Module declarations from 'cython_gsl.gsl_ntuple' */

/* Module declarations from 'cython_gsl.gsl_monte' */

/* Module declarations from 'cython_gsl.gsl_odeiv' */

/* Module declarations from 'cython_gsl.gsl_odeiv2' */

/* Module declarations from 'cython_gsl.gsl_interp' */

/* Module declarations from 'cython_gsl.gsl_diff' */

/* Module declarations from 'cython_gsl.gsl_chebyshev' */

/* Module declarations from 'cython_gsl.gsl_sum' */

/* Module declarations from 'cython_gsl.gsl_roots' */

/* Module declarations from 'cython_gsl.gsl_min' */

/* Module declarations from 'cython_gsl.gsl_fit' */

/* Module declarations from 'cython_gsl' */

/* Module declarations from 'fwdpy.fwdpp' */

/* Module declarations from 'fwdpy.internal.internal' */
static PyTypeObject *__pyx_ptype_5fwdpy_8internal_8internal_shwrappervec = 0;
static PyTypeObject *__pyx_ptype_5fwdpy_8internal_8internal_region_manager_wrapper = 0;

/* Module declarations from 'fwdpy.cpp' */

/* Module declarations from 'libcpp.unordered_set' */

/* Module declarations from 'fwdpy.structs' */

/* Module declarations from 'fwdpy.fwdpy' */
static PyTypeObject *__pyx_ptype_5fwdpy_5fwdpy_PopType = 0;
static PyTypeObject *__pyx_ptype_5fwdpy_5fwdpy_Spop = 0;
static PyTypeObject *__pyx_ptype_5fwdpy_5fwdpy_MetaPop = 0;
static PyTypeObject *__pyx_ptype_5fwdpy_5fwdpy_MlocusPop = 0;
static PyTypeObject *__pyx_ptype_5fwdpy_5fwdpy_SpopGenMut = 0;
static PyTypeObject *__pyx_ptype_5fwdpy_5fwdpy_PopVec = 0;
static PyTypeObject *__pyx_ptype_5fwdpy_5fwdpy_SpopVec = 0;
static PyTypeObject *__pyx_ptype_5fwdpy_5fwdpy_SpopGenMutVec = 0;
static PyTypeObject *__pyx_ptype_5fwdpy_5fwdpy_MetaPopVec = 0;
static PyTypeObject *__pyx_ptype_5fwdpy_5fwdpy_MlocusPopVec = 0;
static PyTypeObject *__pyx_ptype_5fwdpy_5fwdpy_GSLrng = 0;
static PyTypeObject *__pyx_ptype_5fwdpy_5fwdpy_TemporalSampler = 0;
static PyTypeObject *__pyx_ptype_5fwdpy_5fwdpy_NothingSampler = 0;
static PyTypeObject *__pyx_ptype_5fwdpy_5fwdpy_QtraitStatsSampler = 0;
static PyTypeObject *__pyx_ptype_5fwdpy_5fwdpy_PopSampler = 0;
static PyTypeObject *__pyx_ptype_5fwdpy_5fwdpy_VASampler = 0;
static PyTypeObject *__pyx_ptype_5fwdpy_5fwdpy_FreqSampler = 0;

/* Module declarations from 'fwdpy.fitness' */
static PyTypeObject *__pyx_ptype_5fwdpy_7fitness_SpopFitness = 0;
static PyTypeObject *__pyx_ptype_5fwdpy_7fitness_SpopAdditive = 0;
static PyTypeObject *__pyx_ptype_5fwdpy_7fitness_SpopMult = 0;
static PyTypeObject *__pyx_ptype_5fwdpy_7fitness_MlocusFitness = 0;
static PyTypeObject *__pyx_ptype_5fwdpy_7fitness_MlocusAdditive = 0;
static PyTypeObject *__pyx_ptype_5fwdpy_7fitness_MlocusMult = 0;
static CYTHON_INLINE double __pyx_f_5fwdpy_7fitness_return_w(double); /*proto*/
static CYTHON_INLINE double __pyx_f_5fwdpy_7fitness_return_w_plus1(double); /*proto*/
static CYTHON_INLINE void __pyx_f_5fwdpy_7fitness_het_additive_update(double &, KTfwd::popgenmut const &); /*proto*/
static CYTHON_INLINE void __pyx_f_5fwdpy_7fitness_hom_additive_update_2(double &, KTfwd::popgenmut const &); /*proto*/
static CYTHON_INLINE void __pyx_f_5fwdpy_7fitness_hom_additive_update_1(double &, KTfwd::popgenmut const &); /*proto*/
static CYTHON_INLINE fwdpy::genotype_fitness_updater __pyx_f_5fwdpy_7fitness_choose_additive_hom_updater(int); /*proto*/
static CYTHON_INLINE void __pyx_f_5fwdpy_7fitness_het_mult_update(double &, KTfwd::popgenmut const &); /*proto*/
static CYTHON_INLINE fwdpy::genotype_fitness_updater __pyx_f_5fwdpy_7fitness_choose_mult_hom_updater(int); /*proto*/
#define __Pyx_MODULE_NAME "fwdpy.fitness"
int __pyx_module_is_main_fwdpy__fitness = 0;

/* Implementation of 'fwdpy.fitness' */
static const char __pyx_k_main[] = "__main__";
static const char __pyx_k_test[] = "__test__";
static const char __pyx_k_scaling[] = "scaling";
static const char __pyx_k_pyx_vtable[] = "__pyx_vtable__";
static PyObject *__pyx_n_s_main;
static PyObject *__pyx_n_s_pyx_vtable;
static PyObject *__pyx_n_s_scaling;
static PyObject *__pyx_n_s_test;
static int __pyx_pf_5fwdpy_7fitness_12SpopAdditive___cinit__(struct __pyx_obj_5fwdpy_7fitness_SpopAdditive *__pyx_v_self, int __pyx_v_scaling); /* proto */
static int __pyx_pf_5fwdpy_7fitness_8SpopMult___cinit__(struct __pyx_obj_5fwdpy_7fitness_SpopMult *__pyx_v_self, int __pyx_v_scaling); /* proto */
static int __pyx_pf_5fwdpy_7fitness_14MlocusAdditive___cinit__(struct __pyx_obj_5fwdpy_7fitness_MlocusAdditive *__pyx_v_self, double __pyx_v_scaling); /* proto */
static int __pyx_pf_5fwdpy_7fitness_10MlocusMult___cinit__(struct __pyx_obj_5fwdpy_7fitness_MlocusMult *__pyx_v_self, double __pyx_v_scaling); /* proto */
static PyObject *__pyx_tp_new_5fwdpy_7fitness_SpopFitness(PyTypeObject *t, PyObject *a, PyObject *k); /*proto*/
static PyObject *__pyx_tp_new_5fwdpy_7fitness_SpopAdditive(PyTypeObject *t, PyObject *a, PyObject *k); /*proto*/
static PyObject *__pyx_tp_new_5fwdpy_7fitness_SpopMult(PyTypeObject *t, PyObject *a, PyObject *k); /*proto*/
static PyObject *__pyx_tp_new_5fwdpy_7fitness_MlocusFitness(PyTypeObject *t, PyObject *a, PyObject *k); /*proto*/
static PyObject *__pyx_tp_new_5fwdpy_7fitness_MlocusAdditive(PyTypeObject *t, PyObject *a, PyObject *k); /*proto*/
static PyObject *__pyx_tp_new_5fwdpy_7fitness_MlocusMult(PyTypeObject *t, PyObject *a, PyObject *k); /*proto*/

/* "fwdpy/fitness.pyx":5
 *     Additive fitness model for a single deme.
 *     """
 *     def __cinit__(self,int scaling = 2):             # <<<<<<<<<<<<<<
 *         """
 *         Constructor
 */

/* Python wrapper */
static int __pyx_pw_5fwdpy_7fitness_12SpopAdditive_1__cinit__(PyObject *__pyx_v_self, PyObject *__pyx_args, PyObject *__pyx_kwds); /*proto*/
static int __pyx_pw_5fwdpy_7fitness_12SpopAdditive_1__cinit__(PyObject *__pyx_v_self, PyObject *__pyx_args, PyObject *__pyx_kwds) {
  int __pyx_v_scaling;
  int __pyx_r;
  __Pyx_RefNannyDeclarations
  __Pyx_RefNannySetupContext("__cinit__ (wrapper)", 0);
  {
    static PyObject **__pyx_pyargnames[] = {&__pyx_n_s_scaling,0};
    PyObject* values[1] = {0};
    if (unlikely(__pyx_kwds)) {
      Py_ssize_t kw_args;
      const Py_ssize_t pos_args = PyTuple_GET_SIZE(__pyx_args);
      switch (pos_args) {
        case  1: values[0] = PyTuple_GET_ITEM(__pyx_args, 0);
        case  0: break;
        default: goto __pyx_L5_argtuple_error;
      }
      kw_args = PyDict_Size(__pyx_kwds);
      switch (pos_args) {
        case  0:
        if (kw_args > 0) {
          PyObject* value = PyDict_GetItem(__pyx_kwds, __pyx_n_s_scaling);
          if (value) { values[0] = value; kw_args--; }
        }
      }
      if (unlikely(kw_args > 0)) {
        if (unlikely(__Pyx_ParseOptionalKeywords(__pyx_kwds, __pyx_pyargnames, 0, values, pos_args, "__cinit__") < 0)) __PYX_ERR(0, 5, __pyx_L3_error)
      }
    } else {
      switch (PyTuple_GET_SIZE(__pyx_args)) {
        case  1: values[0] = PyTuple_GET_ITEM(__pyx_args, 0);
        case  0: break;
        default: goto __pyx_L5_argtuple_error;
      }
    }
    if (values[0]) {
      __pyx_v_scaling = __Pyx_PyInt_As_int(values[0]); if (unlikely((__pyx_v_scaling == (int)-1) && PyErr_Occurred())) __PYX_ERR(0, 5, __pyx_L3_error)
    } else {
      __pyx_v_scaling = ((int)2);
    }
  }
  goto __pyx_L4_argument_unpacking_done;
  __pyx_L5_argtuple_error:;
  __Pyx_RaiseArgtupleInvalid("__cinit__", 0, 0, 1, PyTuple_GET_SIZE(__pyx_args)); __PYX_ERR(0, 5, __pyx_L3_error)
  __pyx_L3_error:;
  __Pyx_AddTraceback("fwdpy.fitness.SpopAdditive.__cinit__", __pyx_clineno, __pyx_lineno, __pyx_filename);
  __Pyx_RefNannyFinishContext();
  return -1;
  __pyx_L4_argument_unpacking_done:;
  __pyx_r = __pyx_pf_5fwdpy_7fitness_12SpopAdditive___cinit__(((struct __pyx_obj_5fwdpy_7fitness_SpopAdditive *)__pyx_v_self), __pyx_v_scaling);

  /* function exit code */
  __Pyx_RefNannyFinishContext();
  return __pyx_r;
}

static int __pyx_pf_5fwdpy_7fitness_12SpopAdditive___cinit__(struct __pyx_obj_5fwdpy_7fitness_SpopAdditive *__pyx_v_self, int __pyx_v_scaling) {
  int __pyx_r;
  __Pyx_RefNannyDeclarations
  __Pyx_RefNannySetupContext("__cinit__", 0);

  /* "fwdpy/fitness.pyx":11
 *         :param scaling: For a single mutation, fitness is calculated as 1, 1+sh, and 1+scaling*s for genotypes AA, Aa, and aa, respectively
 *         """
 *         self.wfxn = unique_ptr[singlepop_fitness](new singlepop_fitness(het_additive_update,             # <<<<<<<<<<<<<<
 *                                                                         choose_additive_hom_updater(scaling),
 *                                                                         return_w_plus1,
 */
  __pyx_v_self->__pyx_base.wfxn = std::unique_ptr<fwdpy::singlepop_fitness> (new fwdpy::singlepop_fitness(__pyx_f_5fwdpy_7fitness_het_additive_update, __pyx_f_5fwdpy_7fitness_choose_additive_hom_updater(__pyx_v_scaling), __pyx_f_5fwdpy_7fitness_return_w_plus1, 0.0));

  /* "fwdpy/fitness.pyx":5
 *     Additive fitness model for a single deme.
 *     """
 *     def __cinit__(self,int scaling = 2):             # <<<<<<<<<<<<<<
 *         """
 *         Constructor
 */

  /* function exit code */
  __pyx_r = 0;
  __Pyx_RefNannyFinishContext();
  return __pyx_r;
}

/* "fwdpy/fitness.pyx":20
 *     Multiplicative fitness model for a single deme.
 *     """
 *     def __cinit__(self,int scaling = 1):             # <<<<<<<<<<<<<<
 *         """
 *         Constructor
 */

/* Python wrapper */
static int __pyx_pw_5fwdpy_7fitness_8SpopMult_1__cinit__(PyObject *__pyx_v_self, PyObject *__pyx_args, PyObject *__pyx_kwds); /*proto*/
static int __pyx_pw_5fwdpy_7fitness_8SpopMult_1__cinit__(PyObject *__pyx_v_self, PyObject *__pyx_args, PyObject *__pyx_kwds) {
  int __pyx_v_scaling;
  int __pyx_r;
  __Pyx_RefNannyDeclarations
  __Pyx_RefNannySetupContext("__cinit__ (wrapper)", 0);
  {
    static PyObject **__pyx_pyargnames[] = {&__pyx_n_s_scaling,0};
    PyObject* values[1] = {0};
    if (unlikely(__pyx_kwds)) {
      Py_ssize_t kw_args;
      const Py_ssize_t pos_args = PyTuple_GET_SIZE(__pyx_args);
      switch (pos_args) {
        case  1: values[0] = PyTuple_GET_ITEM(__pyx_args, 0);
        case  0: break;
        default: goto __pyx_L5_argtuple_error;
      }
      kw_args = PyDict_Size(__pyx_kwds);
      switch (pos_args) {
        case  0:
        if (kw_args > 0) {
          PyObject* value = PyDict_GetItem(__pyx_kwds, __pyx_n_s_scaling);
          if (value) { values[0] = value; kw_args--; }
        }
      }
      if (unlikely(kw_args > 0)) {
        if (unlikely(__Pyx_ParseOptionalKeywords(__pyx_kwds, __pyx_pyargnames, 0, values, pos_args, "__cinit__") < 0)) __PYX_ERR(0, 20, __pyx_L3_error)
      }
    } else {
      switch (PyTuple_GET_SIZE(__pyx_args)) {
        case  1: values[0] = PyTuple_GET_ITEM(__pyx_args, 0);
        case  0: break;
        default: goto __pyx_L5_argtuple_error;
      }
    }
    if (values[0]) {
      __pyx_v_scaling = __Pyx_PyInt_As_int(values[0]); if (unlikely((__pyx_v_scaling == (int)-1) && PyErr_Occurred())) __PYX_ERR(0, 20, __pyx_L3_error)
    } else {
      __pyx_v_scaling = ((int)1);
    }
  }
  goto __pyx_L4_argument_unpacking_done;
  __pyx_L5_argtuple_error:;
  __Pyx_RaiseArgtupleInvalid("__cinit__", 0, 0, 1, PyTuple_GET_SIZE(__pyx_args)); __PYX_ERR(0, 20, __pyx_L3_error)
  __pyx_L3_error:;
  __Pyx_AddTraceback("fwdpy.fitness.SpopMult.__cinit__", __pyx_clineno, __pyx_lineno, __pyx_filename);
  __Pyx_RefNannyFinishContext();
  return -1;
  __pyx_L4_argument_unpacking_done:;
  __pyx_r = __pyx_pf_5fwdpy_7fitness_8SpopMult___cinit__(((struct __pyx_obj_5fwdpy_7fitness_SpopMult *)__pyx_v_self), __pyx_v_scaling);

  /* function exit code */
  __Pyx_RefNannyFinishContext();
  return __pyx_r;
}

static int __pyx_pf_5fwdpy_7fitness_8SpopMult___cinit__(struct __pyx_obj_5fwdpy_7fitness_SpopMult *__pyx_v_self, int __pyx_v_scaling) {
  int __pyx_r;
  __Pyx_RefNannyDeclarations
  __Pyx_RefNannySetupContext("__cinit__", 0);

  /* "fwdpy/fitness.pyx":26
 *         :param scaling: For a single mutation, fitness is calculated as 1, 1+sh, and 1+scaling*s for genotypes AA, Aa, and aa, respectively
 *         """
 *         self.wfxn = unique_ptr[singlepop_fitness](new singlepop_fitness(het_mult_update,             # <<<<<<<<<<<<<<
 *                                                                         choose_mult_hom_updater(scaling),
 *                                                                         return_w,
 */
  __pyx_v_self->__pyx_base.wfxn = std::unique_ptr<fwdpy::singlepop_fitness> (new fwdpy::singlepop_fitness(__pyx_f_5fwdpy_7fitness_het_mult_update, __pyx_f_5fwdpy_7fitness_choose_mult_hom_updater(__pyx_v_scaling), __pyx_f_5fwdpy_7fitness_return_w, 1.0));

  /* "fwdpy/fitness.pyx":20
 *     Multiplicative fitness model for a single deme.
 *     """
 *     def __cinit__(self,int scaling = 1):             # <<<<<<<<<<<<<<
 *         """
 *         Constructor
 */

  /* function exit code */
  __pyx_r = 0;
  __Pyx_RefNannyFinishContext();
  return __pyx_r;
}

/* "fwdpy/fitness.pyx":38
 *     then strictly additive across regions.
 *     """
 *     def __cinit__(self,double scaling = 2.0):             # <<<<<<<<<<<<<<
 *         """
 *         Constructor
 */

/* Python wrapper */
static int __pyx_pw_5fwdpy_7fitness_14MlocusAdditive_1__cinit__(PyObject *__pyx_v_self, PyObject *__pyx_args, PyObject *__pyx_kwds); /*proto*/
static int __pyx_pw_5fwdpy_7fitness_14MlocusAdditive_1__cinit__(PyObject *__pyx_v_self, PyObject *__pyx_args, PyObject *__pyx_kwds) {
  double __pyx_v_scaling;
  int __pyx_r;
  __Pyx_RefNannyDeclarations
  __Pyx_RefNannySetupContext("__cinit__ (wrapper)", 0);
  {
    static PyObject **__pyx_pyargnames[] = {&__pyx_n_s_scaling,0};
    PyObject* values[1] = {0};
    if (unlikely(__pyx_kwds)) {
      Py_ssize_t kw_args;
      const Py_ssize_t pos_args = PyTuple_GET_SIZE(__pyx_args);
      switch (pos_args) {
        case  1: values[0] = PyTuple_GET_ITEM(__pyx_args, 0);
        case  0: break;
        default: goto __pyx_L5_argtuple_error;
      }
      kw_args = PyDict_Size(__pyx_kwds);
      switch (pos_args) {
        case  0:
        if (kw_args > 0) {
          PyObject* value = PyDict_GetItem(__pyx_kwds, __pyx_n_s_scaling);
          if (value) { values[0] = value; kw_args--; }
        }
      }
      if (unlikely(kw_args > 0)) {
        if (unlikely(__Pyx_ParseOptionalKeywords(__pyx_kwds, __pyx_pyargnames, 0, values, pos_args, "__cinit__") < 0)) __PYX_ERR(0, 38, __pyx_L3_error)
      }
    } else {
      switch (PyTuple_GET_SIZE(__pyx_args)) {
        case  1: values[0] = PyTuple_GET_ITEM(__pyx_args, 0);
        case  0: break;
        default: goto __pyx_L5_argtuple_error;
      }
    }
    if (values[0]) {
      __pyx_v_scaling = __pyx_PyFloat_AsDouble(values[0]); if (unlikely((__pyx_v_scaling == (double)-1) && PyErr_Occurred())) __PYX_ERR(0, 38, __pyx_L3_error)
    } else {
      __pyx_v_scaling = ((double)2.0);
    }
  }
  goto __pyx_L4_argument_unpacking_done;
  __pyx_L5_argtuple_error:;
  __Pyx_RaiseArgtupleInvalid("__cinit__", 0, 0, 1, PyTuple_GET_SIZE(__pyx_args)); __PYX_ERR(0, 38, __pyx_L3_error)
  __pyx_L3_error:;
  __Pyx_AddTraceback("fwdpy.fitness.MlocusAdditive.__cinit__", __pyx_clineno, __pyx_lineno, __pyx_filename);
  __Pyx_RefNannyFinishContext();
  return -1;
  __pyx_L4_argument_unpacking_done:;
  __pyx_r = __pyx_pf_5fwdpy_7fitness_14MlocusAdditive___cinit__(((struct __pyx_obj_5fwdpy_7fitness_MlocusAdditive *)__pyx_v_self), __pyx_v_scaling);

  /* function exit code */
  __Pyx_RefNannyFinishContext();
  return __pyx_r;
}

static int __pyx_pf_5fwdpy_7fitness_14MlocusAdditive___cinit__(struct __pyx_obj_5fwdpy_7fitness_MlocusAdditive *__pyx_v_self, double __pyx_v_scaling) {
  int __pyx_r;
  __Pyx_RefNannyDeclarations
  __Pyx_RefNannySetupContext("__cinit__", 0);

  /* "fwdpy/fitness.pyx":44
 *         :param scaling: For a single mutation, fitness is calculated as 1, 1+sh, and 1+scaling*s for genotypes AA, Aa, and aa, respectively
 *         """
 *         self.wfxn=make_mloc_additive_fitness(scaling)             # <<<<<<<<<<<<<<
 * 
 * cdef class MlocusMult(MlocusFitness):
 */
  __pyx_v_self->__pyx_base.wfxn = fwdpy::make_mloc_additive_fitness(__pyx_v_scaling);

  /* "fwdpy/fitness.pyx":38
 *     then strictly additive across regions.
 *     """
 *     def __cinit__(self,double scaling = 2.0):             # <<<<<<<<<<<<<<
 *         """
 *         Constructor
 */

  /* function exit code */
  __pyx_r = 0;
  __Pyx_RefNannyFinishContext();
  return __pyx_r;
}

/* "fwdpy/fitness.pyx":53
 *     then strictly additive across regions.
 *     """
 *     def __cinit__(self,double scaling = 2.0):             # <<<<<<<<<<<<<<
 *         """
 *         Constructor
 */

/* Python wrapper */
static int __pyx_pw_5fwdpy_7fitness_10MlocusMult_1__cinit__(PyObject *__pyx_v_self, PyObject *__pyx_args, PyObject *__pyx_kwds); /*proto*/
static int __pyx_pw_5fwdpy_7fitness_10MlocusMult_1__cinit__(PyObject *__pyx_v_self, PyObject *__pyx_args, PyObject *__pyx_kwds) {
  double __pyx_v_scaling;
  int __pyx_r;
  __Pyx_RefNannyDeclarations
  __Pyx_RefNannySetupContext("__cinit__ (wrapper)", 0);
  {
    static PyObject **__pyx_pyargnames[] = {&__pyx_n_s_scaling,0};
    PyObject* values[1] = {0};
    if (unlikely(__pyx_kwds)) {
      Py_ssize_t kw_args;
      const Py_ssize_t pos_args = PyTuple_GET_SIZE(__pyx_args);
      switch (pos_args) {
        case  1: values[0] = PyTuple_GET_ITEM(__pyx_args, 0);
        case  0: break;
        default: goto __pyx_L5_argtuple_error;
      }
      kw_args = PyDict_Size(__pyx_kwds);
      switch (pos_args) {
        case  0:
        if (kw_args > 0) {
          PyObject* value = PyDict_GetItem(__pyx_kwds, __pyx_n_s_scaling);
          if (value) { values[0] = value; kw_args--; }
        }
      }
      if (unlikely(kw_args > 0)) {
        if (unlikely(__Pyx_ParseOptionalKeywords(__pyx_kwds, __pyx_pyargnames, 0, values, pos_args, "__cinit__") < 0)) __PYX_ERR(0, 53, __pyx_L3_error)
      }
    } else {
      switch (PyTuple_GET_SIZE(__pyx_args)) {
        case  1: values[0] = PyTuple_GET_ITEM(__pyx_args, 0);
        case  0: break;
        default: goto __pyx_L5_argtuple_error;
      }
    }
    if (values[0]) {
      __pyx_v_scaling = __pyx_PyFloat_AsDouble(values[0]); if (unlikely((__pyx_v_scaling == (double)-1) && PyErr_Occurred())) __PYX_ERR(0, 53, __pyx_L3_error)
    } else {
      __pyx_v_scaling = ((double)2.0);
    }
  }
  goto __pyx_L4_argument_unpacking_done;
  __pyx_L5_argtuple_error:;
  __Pyx_RaiseArgtupleInvalid("__cinit__", 0, 0, 1, PyTuple_GET_SIZE(__pyx_args)); __PYX_ERR(0, 53, __pyx_L3_error)
  __pyx_L3_error:;
  __Pyx_AddTraceback("fwdpy.fitness.MlocusMult.__cinit__", __pyx_clineno, __pyx_lineno, __pyx_filename);
  __Pyx_RefNannyFinishContext();
  return -1;
  __pyx_L4_argument_unpacking_done:;
  __pyx_r = __pyx_pf_5fwdpy_7fitness_10MlocusMult___cinit__(((struct __pyx_obj_5fwdpy_7fitness_MlocusMult *)__pyx_v_self), __pyx_v_scaling);

  /* function exit code */
  __Pyx_RefNannyFinishContext();
  return __pyx_r;
}

static int __pyx_pf_5fwdpy_7fitness_10MlocusMult___cinit__(struct __pyx_obj_5fwdpy_7fitness_MlocusMult *__pyx_v_self, double __pyx_v_scaling) {
  int __pyx_r;
  __Pyx_RefNannyDeclarations
  __Pyx_RefNannySetupContext("__cinit__", 0);

  /* "fwdpy/fitness.pyx":59
 *         :param scaling: For a single mutation, fitness is calculated as 1, 1+sh, and 1+scaling*s for genotypes AA, Aa, and aa, respectively
 *         """
 *         self.wfxn=make_mloc_multiplicative_fitness(scaling)             # <<<<<<<<<<<<<<
 */
  __pyx_v_self->__pyx_base.wfxn = fwdpy::make_mloc_multiplicative_fitness(__pyx_v_scaling);

  /* "fwdpy/fitness.pyx":53
 *     then strictly additive across regions.
 *     """
 *     def __cinit__(self,double scaling = 2.0):             # <<<<<<<<<<<<<<
 *         """
 *         Constructor
 */

  /* function exit code */
  __pyx_r = 0;
  __Pyx_RefNannyFinishContext();
  return __pyx_r;
}

/* "fwdpy/fitness.pxd":58
 * 
 * #Helper functions for making custom fitness functions
 * cdef inline double return_w(double w) nogil:             # <<<<<<<<<<<<<<
 *     return max[double](0.0,w)
 * 
 */

static CYTHON_INLINE double __pyx_f_5fwdpy_7fitness_return_w(double __pyx_v_w) {
  double __pyx_r;

  /* "fwdpy/fitness.pxd":59
 * #Helper functions for making custom fitness functions
 * cdef inline double return_w(double w) nogil:
 *     return max[double](0.0,w)             # <<<<<<<<<<<<<<
 * 
 * cdef inline double return_w_plus1(double w) nogil:
 */
  __pyx_r = std::max<double>(0.0, __pyx_v_w);
  goto __pyx_L0;

  /* "fwdpy/fitness.pxd":58
 * 
 * #Helper functions for making custom fitness functions
 * cdef inline double return_w(double w) nogil:             # <<<<<<<<<<<<<<
 *     return max[double](0.0,w)
 * 
 */

  /* function exit code */
  __pyx_L0:;
  return __pyx_r;
}

/* "fwdpy/fitness.pxd":61
 *     return max[double](0.0,w)
 * 
 * cdef inline double return_w_plus1(double w) nogil:             # <<<<<<<<<<<<<<
 *     return max[double](0.0,1.0+w)
 * 
 */

static CYTHON_INLINE double __pyx_f_5fwdpy_7fitness_return_w_plus1(double __pyx_v_w) {
  double __pyx_r;

  /* "fwdpy/fitness.pxd":62
 * 
 * cdef inline double return_w_plus1(double w) nogil:
 *     return max[double](0.0,1.0+w)             # <<<<<<<<<<<<<<
 * 
 * cdef inline double return_trait_value(double w) nogil:
 */
  __pyx_r = std::max<double>(0.0, (1.0 + __pyx_v_w));
  goto __pyx_L0;

  /* "fwdpy/fitness.pxd":61
 *     return max[double](0.0,w)
 * 
 * cdef inline double return_w_plus1(double w) nogil:             # <<<<<<<<<<<<<<
 *     return max[double](0.0,1.0+w)
 * 
 */

  /* function exit code */
  __pyx_L0:;
  return __pyx_r;
}

/* "fwdpy/fitness.pxd":64
 *     return max[double](0.0,1.0+w)
 * 
 * cdef inline double return_trait_value(double w) nogil:             # <<<<<<<<<<<<<<
 *     return w
 * 
 */

static CYTHON_INLINE double __pyx_f_5fwdpy_7fitness_return_trait_value(double __pyx_v_w) {
  double __pyx_r;

  /* "fwdpy/fitness.pxd":65
 * 
 * cdef inline double return_trait_value(double w) nogil:
 *     return w             # <<<<<<<<<<<<<<
 * 
 * cdef inline double return_trait_value_minus1(double w) nogil:
 */
  __pyx_r = __pyx_v_w;
  goto __pyx_L0;

  /* "fwdpy/fitness.pxd":64
 *     return max[double](0.0,1.0+w)
 * 
 * cdef inline double return_trait_value(double w) nogil:             # <<<<<<<<<<<<<<
 *     return w
 * 
 */

  /* function exit code */
  __pyx_L0:;
  return __pyx_r;
}

/* "fwdpy/fitness.pxd":67
 *     return w
 * 
 * cdef inline double return_trait_value_minus1(double w) nogil:             # <<<<<<<<<<<<<<
 *     return w-1.0
 * 
 */

static CYTHON_INLINE double __pyx_f_5fwdpy_7fitness_return_trait_value_minus1(double __pyx_v_w) {
  double __pyx_r;

  /* "fwdpy/fitness.pxd":68
 * 
 * cdef inline double return_trait_value_minus1(double w) nogil:
 *     return w-1.0             # <<<<<<<<<<<<<<
 * 
 * cdef inline void het_additive_update(double & w, const popgenmut & m) nogil:
 */
  __pyx_r = (__pyx_v_w - 1.0);
  goto __pyx_L0;

  /* "fwdpy/fitness.pxd":67
 *     return w
 * 
 * cdef inline double return_trait_value_minus1(double w) nogil:             # <<<<<<<<<<<<<<
 *     return w-1.0
 * 
 */

  /* function exit code */
  __pyx_L0:;
  return __pyx_r;
}

/* "fwdpy/fitness.pxd":70
 *     return w-1.0
 * 
 * cdef inline void het_additive_update(double & w, const popgenmut & m) nogil:             # <<<<<<<<<<<<<<
 *     (&w)[0] += m.s*m.h
 * 
 */

static CYTHON_INLINE void __pyx_f_5fwdpy_7fitness_het_additive_update(double &__pyx_v_w, KTfwd::popgenmut const &__pyx_v_m) {
  double *__pyx_t_1;
  long __pyx_t_2;

  /* "fwdpy/fitness.pxd":71
 * 
 * cdef inline void het_additive_update(double & w, const popgenmut & m) nogil:
 *     (&w)[0] += m.s*m.h             # <<<<<<<<<<<<<<
 * 
 * cdef inline void hom_additive_update_2(double & w, const popgenmut & m) nogil:
 */
  __pyx_t_1 = (&__pyx_v_w);
  __pyx_t_2 = 0;
  (__pyx_t_1[__pyx_t_2]) = ((__pyx_t_1[__pyx_t_2]) + (__pyx_v_m.s * __pyx_v_m.h));

  /* "fwdpy/fitness.pxd":70
 *     return w-1.0
 * 
 * cdef inline void het_additive_update(double & w, const popgenmut & m) nogil:             # <<<<<<<<<<<<<<
 *     (&w)[0] += m.s*m.h
 * 
 */

  /* function exit code */
}

/* "fwdpy/fitness.pxd":73
 *     (&w)[0] += m.s*m.h
 * 
 * cdef inline void hom_additive_update_2(double & w, const popgenmut & m) nogil:             # <<<<<<<<<<<<<<
 *     (&w)[0] += 2.0*m.s
 * 
 */

static CYTHON_INLINE void __pyx_f_5fwdpy_7fitness_hom_additive_update_2(double &__pyx_v_w, KTfwd::popgenmut const &__pyx_v_m) {
  double *__pyx_t_1;
  long __pyx_t_2;

  /* "fwdpy/fitness.pxd":74
 * 
 * cdef inline void hom_additive_update_2(double & w, const popgenmut & m) nogil:
 *     (&w)[0] += 2.0*m.s             # <<<<<<<<<<<<<<
 * 
 * cdef inline void hom_additive_update_1(double & w, const popgenmut & m) nogil:
 */
  __pyx_t_1 = (&__pyx_v_w);
  __pyx_t_2 = 0;
  (__pyx_t_1[__pyx_t_2]) = ((__pyx_t_1[__pyx_t_2]) + (2.0 * __pyx_v_m.s));

  /* "fwdpy/fitness.pxd":73
 *     (&w)[0] += m.s*m.h
 * 
 * cdef inline void hom_additive_update_2(double & w, const popgenmut & m) nogil:             # <<<<<<<<<<<<<<
 *     (&w)[0] += 2.0*m.s
 * 
 */

  /* function exit code */
}

/* "fwdpy/fitness.pxd":76
 *     (&w)[0] += 2.0*m.s
 * 
 * cdef inline void hom_additive_update_1(double & w, const popgenmut & m) nogil:             # <<<<<<<<<<<<<<
 *     (&w)[0] += m.s
 * 
 */

static CYTHON_INLINE void __pyx_f_5fwdpy_7fitness_hom_additive_update_1(double &__pyx_v_w, KTfwd::popgenmut const &__pyx_v_m) {
  double *__pyx_t_1;
  long __pyx_t_2;

  /* "fwdpy/fitness.pxd":77
 * 
 * cdef inline void hom_additive_update_1(double & w, const popgenmut & m) nogil:
 *     (&w)[0] += m.s             # <<<<<<<<<<<<<<
 * 
 * cdef inline genotype_fitness_updater choose_additive_hom_updater(int scaling) nogil:
 */
  __pyx_t_1 = (&__pyx_v_w);
  __pyx_t_2 = 0;
  (__pyx_t_1[__pyx_t_2]) = ((__pyx_t_1[__pyx_t_2]) + __pyx_v_m.s);

  /* "fwdpy/fitness.pxd":76
 *     (&w)[0] += 2.0*m.s
 * 
 * cdef inline void hom_additive_update_1(double & w, const popgenmut & m) nogil:             # <<<<<<<<<<<<<<
 *     (&w)[0] += m.s
 * 
 */

  /* function exit code */
}

/* "fwdpy/fitness.pxd":79
 *     (&w)[0] += m.s
 * 
 * cdef inline genotype_fitness_updater choose_additive_hom_updater(int scaling) nogil:             # <<<<<<<<<<<<<<
 *     #Defaults to using a scaling of 2
 *     if scaling==1:
 */

static CYTHON_INLINE fwdpy::genotype_fitness_updater __pyx_f_5fwdpy_7fitness_choose_additive_hom_updater(int __pyx_v_scaling) {
  fwdpy::genotype_fitness_updater __pyx_r;
  int __pyx_t_1;

  /* "fwdpy/fitness.pxd":81
 * cdef inline genotype_fitness_updater choose_additive_hom_updater(int scaling) nogil:
 *     #Defaults to using a scaling of 2
 *     if scaling==1:             # <<<<<<<<<<<<<<
 *         return <genotype_fitness_updater>hom_additive_update_1
 *     return <genotype_fitness_updater>hom_additive_update_2
 */
  __pyx_t_1 = ((__pyx_v_scaling == 1) != 0);
  if (__pyx_t_1) {

    /* "fwdpy/fitness.pxd":82
 *     #Defaults to using a scaling of 2
 *     if scaling==1:
 *         return <genotype_fitness_updater>hom_additive_update_1             # <<<<<<<<<<<<<<
 *     return <genotype_fitness_updater>hom_additive_update_2
 * 
 */
    __pyx_r = ((fwdpy::genotype_fitness_updater)__pyx_f_5fwdpy_7fitness_hom_additive_update_1);
    goto __pyx_L0;

    /* "fwdpy/fitness.pxd":81
 * cdef inline genotype_fitness_updater choose_additive_hom_updater(int scaling) nogil:
 *     #Defaults to using a scaling of 2
 *     if scaling==1:             # <<<<<<<<<<<<<<
 *         return <genotype_fitness_updater>hom_additive_update_1
 *     return <genotype_fitness_updater>hom_additive_update_2
 */
  }

  /* "fwdpy/fitness.pxd":83
 *     if scaling==1:
 *         return <genotype_fitness_updater>hom_additive_update_1
 *     return <genotype_fitness_updater>hom_additive_update_2             # <<<<<<<<<<<<<<
 * 
 * cdef inline void het_mult_update(double & w, const popgenmut & m) nogil:
 */
  __pyx_r = ((fwdpy::genotype_fitness_updater)__pyx_f_5fwdpy_7fitness_hom_additive_update_2);
  goto __pyx_L0;

  /* "fwdpy/fitness.pxd":79
 *     (&w)[0] += m.s
 * 
 * cdef inline genotype_fitness_updater choose_additive_hom_updater(int scaling) nogil:             # <<<<<<<<<<<<<<
 *     #Defaults to using a scaling of 2
 *     if scaling==1:
 */

  /* function exit code */
  __pyx_L0:;
  return __pyx_r;
}

/* "fwdpy/fitness.pxd":85
 *     return <genotype_fitness_updater>hom_additive_update_2
 * 
 * cdef inline void het_mult_update(double & w, const popgenmut & m) nogil:             # <<<<<<<<<<<<<<
 *     (&w)[0] *= (1.0+m.s*m.h)
 * 
 */

static CYTHON_INLINE void __pyx_f_5fwdpy_7fitness_het_mult_update(double &__pyx_v_w, KTfwd::popgenmut const &__pyx_v_m) {
  double *__pyx_t_1;
  long __pyx_t_2;

  /* "fwdpy/fitness.pxd":86
 * 
 * cdef inline void het_mult_update(double & w, const popgenmut & m) nogil:
 *     (&w)[0] *= (1.0+m.s*m.h)             # <<<<<<<<<<<<<<
 * 
 * cdef inline void hom_mult_update_2(double & w, const popgenmut & m) nogil:
 */
  __pyx_t_1 = (&__pyx_v_w);
  __pyx_t_2 = 0;
  (__pyx_t_1[__pyx_t_2]) = ((__pyx_t_1[__pyx_t_2]) * (1.0 + (__pyx_v_m.s * __pyx_v_m.h)));

  /* "fwdpy/fitness.pxd":85
 *     return <genotype_fitness_updater>hom_additive_update_2
 * 
 * cdef inline void het_mult_update(double & w, const popgenmut & m) nogil:             # <<<<<<<<<<<<<<
 *     (&w)[0] *= (1.0+m.s*m.h)
 * 
 */

  /* function exit code */
}

/* "fwdpy/fitness.pxd":88
 *     (&w)[0] *= (1.0+m.s*m.h)
 * 
 * cdef inline void hom_mult_update_2(double & w, const popgenmut & m) nogil:             # <<<<<<<<<<<<<<
 *     (&w)[0] *= (1.0+2.0*m.s)
 * 
 */

static CYTHON_INLINE void __pyx_f_5fwdpy_7fitness_hom_mult_update_2(double &__pyx_v_w, KTfwd::popgenmut const &__pyx_v_m) {
  double *__pyx_t_1;
  long __pyx_t_2;

  /* "fwdpy/fitness.pxd":89
 * 
 * cdef inline void hom_mult_update_2(double & w, const popgenmut & m) nogil:
 *     (&w)[0] *= (1.0+2.0*m.s)             # <<<<<<<<<<<<<<
 * 
 * cdef inline void hom_mult_update_1(double & w, const popgenmut & m) nogil:
 */
  __pyx_t_1 = (&__pyx_v_w);
  __pyx_t_2 = 0;
  (__pyx_t_1[__pyx_t_2]) = ((__pyx_t_1[__pyx_t_2]) * (1.0 + (2.0 * __pyx_v_m.s)));

  /* "fwdpy/fitness.pxd":88
 *     (&w)[0] *= (1.0+m.s*m.h)
 * 
 * cdef inline void hom_mult_update_2(double & w, const popgenmut & m) nogil:             # <<<<<<<<<<<<<<
 *     (&w)[0] *= (1.0+2.0*m.s)
 * 
 */

  /* function exit code */
}

/* "fwdpy/fitness.pxd":91
 *     (&w)[0] *= (1.0+2.0*m.s)
 * 
 * cdef inline void hom_mult_update_1(double & w, const popgenmut & m) nogil:             # <<<<<<<<<<<<<<
 *     (&w)[0] *= (1.0+m.s)
 * 
 */

static CYTHON_INLINE void __pyx_f_5fwdpy_7fitness_hom_mult_update_1(double &__pyx_v_w, KTfwd::popgenmut const &__pyx_v_m) {
  double *__pyx_t_1;
  long __pyx_t_2;

  /* "fwdpy/fitness.pxd":92
 * 
 * cdef inline void hom_mult_update_1(double & w, const popgenmut & m) nogil:
 *     (&w)[0] *= (1.0+m.s)             # <<<<<<<<<<<<<<
 * 
 * cdef inline genotype_fitness_updater choose_mult_hom_updater(int scaling) nogil:
 */
  __pyx_t_1 = (&__pyx_v_w);
  __pyx_t_2 = 0;
  (__pyx_t_1[__pyx_t_2]) = ((__pyx_t_1[__pyx_t_2]) * (1.0 + __pyx_v_m.s));

  /* "fwdpy/fitness.pxd":91
 *     (&w)[0] *= (1.0+2.0*m.s)
 * 
 * cdef inline void hom_mult_update_1(double & w, const popgenmut & m) nogil:             # <<<<<<<<<<<<<<
 *     (&w)[0] *= (1.0+m.s)
 * 
 */

  /* function exit code */
}

/* "fwdpy/fitness.pxd":94
 *     (&w)[0] *= (1.0+m.s)
 * 
 * cdef inline genotype_fitness_updater choose_mult_hom_updater(int scaling) nogil:             # <<<<<<<<<<<<<<
 *     #Defaults to using a scaling of 2
 *     if scaling==1:
 */

static CYTHON_INLINE fwdpy::genotype_fitness_updater __pyx_f_5fwdpy_7fitness_choose_mult_hom_updater(int __pyx_v_scaling) {
  fwdpy::genotype_fitness_updater __pyx_r;
  int __pyx_t_1;

  /* "fwdpy/fitness.pxd":96
 * cdef inline genotype_fitness_updater choose_mult_hom_updater(int scaling) nogil:
 *     #Defaults to using a scaling of 2
 *     if scaling==1:             # <<<<<<<<<<<<<<
 *         return <genotype_fitness_updater>hom_additive_update_1
 *     return <genotype_fitness_updater>hom_additive_update_2
 */
  __pyx_t_1 = ((__pyx_v_scaling == 1) != 0);
  if (__pyx_t_1) {

    /* "fwdpy/fitness.pxd":97
 *     #Defaults to using a scaling of 2
 *     if scaling==1:
 *         return <genotype_fitness_updater>hom_additive_update_1             # <<<<<<<<<<<<<<
 *     return <genotype_fitness_updater>hom_additive_update_2
 * 
 */
    __pyx_r = ((fwdpy::genotype_fitness_updater)__pyx_f_5fwdpy_7fitness_hom_additive_update_1);
    goto __pyx_L0;

    /* "fwdpy/fitness.pxd":96
 * cdef inline genotype_fitness_updater choose_mult_hom_updater(int scaling) nogil:
 *     #Defaults to using a scaling of 2
 *     if scaling==1:             # <<<<<<<<<<<<<<
 *         return <genotype_fitness_updater>hom_additive_update_1
 *     return <genotype_fitness_updater>hom_additive_update_2
 */
  }

  /* "fwdpy/fitness.pxd":98
 *     if scaling==1:
 *         return <genotype_fitness_updater>hom_additive_update_1
 *     return <genotype_fitness_updater>hom_additive_update_2             # <<<<<<<<<<<<<<
 * 
 * cdef inline double sum_haplotype_effects(const gamete_t & g, const mcont_t & m) nogil:
 */
  __pyx_r = ((fwdpy::genotype_fitness_updater)__pyx_f_5fwdpy_7fitness_hom_additive_update_2);
  goto __pyx_L0;

  /* "fwdpy/fitness.pxd":94
 *     (&w)[0] *= (1.0+m.s)
 * 
 * cdef inline genotype_fitness_updater choose_mult_hom_updater(int scaling) nogil:             # <<<<<<<<<<<<<<
 *     #Defaults to using a scaling of 2
 *     if scaling==1:
 */

  /* function exit code */
  __pyx_L0:;
  return __pyx_r;
}

/* "fwdpy/fitness.pxd":100
 *     return <genotype_fitness_updater>hom_additive_update_2
 * 
 * cdef inline double sum_haplotype_effects(const gamete_t & g, const mcont_t & m) nogil:             # <<<<<<<<<<<<<<
 *     cdef size_t i=0,n=g.smutations.size()
 *     cdef double rv = 0.0
 */

static CYTHON_INLINE double __pyx_f_5fwdpy_7fitness_sum_haplotype_effects(__pyx_t_5fwdpy_7fitness_gamete_t const &__pyx_v_g, __pyx_t_5fwdpy_7fitness_mcont_t const &__pyx_v_m) {
  size_t __pyx_v_i;
  size_t __pyx_v_n;
  double __pyx_v_rv;
  double __pyx_r;
  int __pyx_t_1;

  /* "fwdpy/fitness.pxd":101
 * 
 * cdef inline double sum_haplotype_effects(const gamete_t & g, const mcont_t & m) nogil:
 *     cdef size_t i=0,n=g.smutations.size()             # <<<<<<<<<<<<<<
 *     cdef double rv = 0.0
 *     while i<n:
 */
  __pyx_v_i = 0;
  __pyx_v_n = __pyx_v_g.smutations.size();

  /* "fwdpy/fitness.pxd":102
 * cdef inline double sum_haplotype_effects(const gamete_t & g, const mcont_t & m) nogil:
 *     cdef size_t i=0,n=g.smutations.size()
 *     cdef double rv = 0.0             # <<<<<<<<<<<<<<
 *     while i<n:
 *         rv+=m[g.smutations[i]].s
 */
  __pyx_v_rv = 0.0;

  /* "fwdpy/fitness.pxd":103
 *     cdef size_t i=0,n=g.smutations.size()
 *     cdef double rv = 0.0
 *     while i<n:             # <<<<<<<<<<<<<<
 *         rv+=m[g.smutations[i]].s
 *         i+=1
 */
  while (1) {
    __pyx_t_1 = ((__pyx_v_i < __pyx_v_n) != 0);
    if (!__pyx_t_1) break;

    /* "fwdpy/fitness.pxd":104
 *     cdef double rv = 0.0
 *     while i<n:
 *         rv+=m[g.smutations[i]].s             # <<<<<<<<<<<<<<
 *         i+=1
 *     return rv
 */
    __pyx_v_rv = (__pyx_v_rv + (__pyx_v_m[(__pyx_v_g.smutations[__pyx_v_i])]).s);

    /* "fwdpy/fitness.pxd":105
 *     while i<n:
 *         rv+=m[g.smutations[i]].s
 *         i+=1             # <<<<<<<<<<<<<<
 *     return rv
 * 
 */
    __pyx_v_i = (__pyx_v_i + 1);
  }

  /* "fwdpy/fitness.pxd":106
 *         rv+=m[g.smutations[i]].s
 *         i+=1
 *     return rv             # <<<<<<<<<<<<<<
 * 
 * cdef class SpopFitness(object):
 */
  __pyx_r = __pyx_v_rv;
  goto __pyx_L0;

  /* "fwdpy/fitness.pxd":100
 *     return <genotype_fitness_updater>hom_additive_update_2
 * 
 * cdef inline double sum_haplotype_effects(const gamete_t & g, const mcont_t & m) nogil:             # <<<<<<<<<<<<<<
 *     cdef size_t i=0,n=g.smutations.size()
 *     cdef double rv = 0.0
 */

  /* function exit code */
  __pyx_L0:;
  return __pyx_r;
}

static PyObject *__pyx_tp_new_5fwdpy_7fitness_SpopFitness(PyTypeObject *t, CYTHON_UNUSED PyObject *a, CYTHON_UNUSED PyObject *k) {
  struct __pyx_obj_5fwdpy_7fitness_SpopFitness *p;
  PyObject *o;
  if (likely((t->tp_flags & Py_TPFLAGS_IS_ABSTRACT) == 0)) {
    o = (*t->tp_alloc)(t, 0);
  } else {
    o = (PyObject *) PyBaseObject_Type.tp_new(t, __pyx_empty_tuple, 0);
  }
  if (unlikely(!o)) return 0;
  p = ((struct __pyx_obj_5fwdpy_7fitness_SpopFitness *)o);
  new((void*)&(p->wfxn)) std::unique_ptr<fwdpy::singlepop_fitness> ();
  return o;
}

static void __pyx_tp_dealloc_5fwdpy_7fitness_SpopFitness(PyObject *o) {
  struct __pyx_obj_5fwdpy_7fitness_SpopFitness *p = (struct __pyx_obj_5fwdpy_7fitness_SpopFitness *)o;
  #if PY_VERSION_HEX >= 0x030400a1
  if (unlikely(Py_TYPE(o)->tp_finalize) && (!PyType_IS_GC(Py_TYPE(o)) || !_PyGC_FINALIZED(o))) {
    if (PyObject_CallFinalizerFromDealloc(o)) return;
  }
  #endif
  __Pyx_call_destructor(p->wfxn);
  (*Py_TYPE(o)->tp_free)(o);
}

static PyTypeObject __pyx_type_5fwdpy_7fitness_SpopFitness = {
  PyVarObject_HEAD_INIT(0, 0)
  "fwdpy.fitness.SpopFitness", /*tp_name*/
  sizeof(struct __pyx_obj_5fwdpy_7fitness_SpopFitness), /*tp_basicsize*/
  0, /*tp_itemsize*/
  __pyx_tp_dealloc_5fwdpy_7fitness_SpopFitness, /*tp_dealloc*/
  0, /*tp_print*/
  0, /*tp_getattr*/
  0, /*tp_setattr*/
  #if PY_MAJOR_VERSION < 3
  0, /*tp_compare*/
  #endif
  #if PY_MAJOR_VERSION >= 3
  0, /*tp_as_async*/
  #endif
  0, /*tp_repr*/
  0, /*tp_as_number*/
  0, /*tp_as_sequence*/
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  0, /*tp_as_buffer*/
  Py_TPFLAGS_DEFAULT|Py_TPFLAGS_HAVE_VERSION_TAG|Py_TPFLAGS_CHECKTYPES|Py_TPFLAGS_HAVE_NEWBUFFER|Py_TPFLAGS_BASETYPE, /*tp_flags*/
  "\n    Base object for single-deme fitness functions\n    ", /*tp_doc*/
  0, /*tp_traverse*/
  0, /*tp_clear*/
  0, /*tp_richcompare*/
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  0, /*tp_alloc*/
  __pyx_tp_new_5fwdpy_7fitness_SpopFitness, /*tp_new*/
  0, /*tp_free*/
  0, /*tp_is_gc*/
  0, /*tp_bases*/
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  0, /*tp_version_tag*/
  #if PY_VERSION_HEX >= 0x030400a1
  0, /*tp_finalize*/
  #endif
};

static PyObject *__pyx_tp_new_5fwdpy_7fitness_SpopAdditive(PyTypeObject *t, PyObject *a, PyObject *k) {
  PyObject *o = __pyx_tp_new_5fwdpy_7fitness_SpopFitness(t, a, k);
  if (unlikely(!o)) return 0;
  if (unlikely(__pyx_pw_5fwdpy_7fitness_12SpopAdditive_1__cinit__(o, a, k) < 0)) goto bad;
  return o;
  bad:
  Py_DECREF(o); o = 0;
  return NULL;
}

static PyMethodDef __pyx_methods_5fwdpy_7fitness_SpopAdditive[] = {
  {0, 0, 0, 0}
};

static PyTypeObject __pyx_type_5fwdpy_7fitness_SpopAdditive = {
  PyVarObject_HEAD_INIT(0, 0)
  "fwdpy.fitness.SpopAdditive", /*tp_name*/
  sizeof(struct __pyx_obj_5fwdpy_7fitness_SpopAdditive), /*tp_basicsize*/
  0, /*tp_itemsize*/
  __pyx_tp_dealloc_5fwdpy_7fitness_SpopFitness, /*tp_dealloc*/
  0, /*tp_print*/
  0, /*tp_getattr*/
  0, /*tp_setattr*/
  #if PY_MAJOR_VERSION < 3
  0, /*tp_compare*/
  #endif
  #if PY_MAJOR_VERSION >= 3
  0, /*tp_as_async*/
  #endif
  0, /*tp_repr*/
  0, /*tp_as_number*/
  0, /*tp_as_sequence*/
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  0, /*tp_as_buffer*/
  Py_TPFLAGS_DEFAULT|Py_TPFLAGS_HAVE_VERSION_TAG|Py_TPFLAGS_CHECKTYPES|Py_TPFLAGS_HAVE_NEWBUFFER|Py_TPFLAGS_BASETYPE, /*tp_flags*/
  "\n    Additive fitness model for a single deme.\n    ", /*tp_doc*/
  0, /*tp_traverse*/
  0, /*tp_clear*/
  0, /*tp_richcompare*/
  0, /*tp_weaklistoffset*/
  0, /*tp_iter*/
  0, /*tp_iternext*/
  __pyx_methods_5fwdpy_7fitness_SpopAdditive, /*tp_methods*/
  0, /*tp_members*/
  0, /*tp_getset*/
  0, /*tp_base*/
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  0, /*tp_alloc*/
  __pyx_tp_new_5fwdpy_7fitness_SpopAdditive, /*tp_new*/
  0, /*tp_free*/
  0, /*tp_is_gc*/
  0, /*tp_bases*/
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  0, /*tp_version_tag*/
  #if PY_VERSION_HEX >= 0x030400a1
  0, /*tp_finalize*/
  #endif
};

static PyObject *__pyx_tp_new_5fwdpy_7fitness_SpopMult(PyTypeObject *t, PyObject *a, PyObject *k) {
  PyObject *o = __pyx_tp_new_5fwdpy_7fitness_SpopFitness(t, a, k);
  if (unlikely(!o)) return 0;
  if (unlikely(__pyx_pw_5fwdpy_7fitness_8SpopMult_1__cinit__(o, a, k) < 0)) goto bad;
  return o;
  bad:
  Py_DECREF(o); o = 0;
  return NULL;
}

static PyMethodDef __pyx_methods_5fwdpy_7fitness_SpopMult[] = {
  {0, 0, 0, 0}
};

static PyTypeObject __pyx_type_5fwdpy_7fitness_SpopMult = {
  PyVarObject_HEAD_INIT(0, 0)
  "fwdpy.fitness.SpopMult", /*tp_name*/
  sizeof(struct __pyx_obj_5fwdpy_7fitness_SpopMult), /*tp_basicsize*/
  0, /*tp_itemsize*/
  __pyx_tp_dealloc_5fwdpy_7fitness_SpopFitness, /*tp_dealloc*/
  0, /*tp_print*/
  0, /*tp_getattr*/
  0, /*tp_setattr*/
  #if PY_MAJOR_VERSION < 3
  0, /*tp_compare*/
  #endif
  #if PY_MAJOR_VERSION >= 3
  0, /*tp_as_async*/
  #endif
  0, /*tp_repr*/
  0, /*tp_as_number*/
  0, /*tp_as_sequence*/
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  0, /*tp_as_buffer*/
  Py_TPFLAGS_DEFAULT|Py_TPFLAGS_HAVE_VERSION_TAG|Py_TPFLAGS_CHECKTYPES|Py_TPFLAGS_HAVE_NEWBUFFER|Py_TPFLAGS_BASETYPE, /*tp_flags*/
  "\n    Multiplicative fitness model for a single deme.\n    ", /*tp_doc*/
  0, /*tp_traverse*/
  0, /*tp_clear*/
  0, /*tp_richcompare*/
  0, /*tp_weaklistoffset*/
  0, /*tp_iter*/
  0, /*tp_iternext*/
  __pyx_methods_5fwdpy_7fitness_SpopMult, /*tp_methods*/
  0, /*tp_members*/
  0, /*tp_getset*/
  0, /*tp_base*/
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  0, /*tp_alloc*/
  __pyx_tp_new_5fwdpy_7fitness_SpopMult, /*tp_new*/
  0, /*tp_free*/
  0, /*tp_is_gc*/
  0, /*tp_bases*/
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  0, /*tp_version_tag*/
  #if PY_VERSION_HEX >= 0x030400a1
  0, /*tp_finalize*/
  #endif
};

static PyObject *__pyx_tp_new_5fwdpy_7fitness_MlocusFitness(PyTypeObject *t, CYTHON_UNUSED PyObject *a, CYTHON_UNUSED PyObject *k) {
  struct __pyx_obj_5fwdpy_7fitness_MlocusFitness *p;
  PyObject *o;
  if (likely((t->tp_flags & Py_TPFLAGS_IS_ABSTRACT) == 0)) {
    o = (*t->tp_alloc)(t, 0);
  } else {
    o = (PyObject *) PyBaseObject_Type.tp_new(t, __pyx_empty_tuple, 0);
  }
  if (unlikely(!o)) return 0;
  p = ((struct __pyx_obj_5fwdpy_7fitness_MlocusFitness *)o);
  new((void*)&(p->wfxn)) fwdpy::multilocus_fitness();
  return o;
}

static void __pyx_tp_dealloc_5fwdpy_7fitness_MlocusFitness(PyObject *o) {
  struct __pyx_obj_5fwdpy_7fitness_MlocusFitness *p = (struct __pyx_obj_5fwdpy_7fitness_MlocusFitness *)o;
  #if PY_VERSION_HEX >= 0x030400a1
  if (unlikely(Py_TYPE(o)->tp_finalize) && (!PyType_IS_GC(Py_TYPE(o)) || !_PyGC_FINALIZED(o))) {
    if (PyObject_CallFinalizerFromDealloc(o)) return;
  }
  #endif
  __Pyx_call_destructor(p->wfxn);
  (*Py_TYPE(o)->tp_free)(o);
}

static PyTypeObject __pyx_type_5fwdpy_7fitness_MlocusFitness = {
  PyVarObject_HEAD_INIT(0, 0)
  "fwdpy.fitness.MlocusFitness", /*tp_name*/
  sizeof(struct __pyx_obj_5fwdpy_7fitness_MlocusFitness), /*tp_basicsize*/
  0, /*tp_itemsize*/
  __pyx_tp_dealloc_5fwdpy_7fitness_MlocusFitness, /*tp_dealloc*/
  0, /*tp_print*/
  0, /*tp_getattr*/
  0, /*tp_setattr*/
  #if PY_MAJOR_VERSION < 3
  0, /*tp_compare*/
  #endif
  #if PY_MAJOR_VERSION >= 3
  0, /*tp_as_async*/
  #endif
  0, /*tp_repr*/
  0, /*tp_as_number*/
  0, /*tp_as_sequence*/
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  0, /*tp_as_buffer*/
  Py_TPFLAGS_DEFAULT|Py_TPFLAGS_HAVE_VERSION_TAG|Py_TPFLAGS_CHECKTYPES|Py_TPFLAGS_HAVE_NEWBUFFER|Py_TPFLAGS_BASETYPE, /*tp_flags*/
  "\n    Base object for multi-locus fitness functions\n    ", /*tp_doc*/
  0, /*tp_traverse*/
  0, /*tp_clear*/
  0, /*tp_richcompare*/
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  0, /*tp_alloc*/
  __pyx_tp_new_5fwdpy_7fitness_MlocusFitness, /*tp_new*/
  0, /*tp_free*/
  0, /*tp_is_gc*/
  0, /*tp_bases*/
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  0, /*tp_version_tag*/
  #if PY_VERSION_HEX >= 0x030400a1
  0, /*tp_finalize*/
  #endif
};

static PyObject *__pyx_tp_new_5fwdpy_7fitness_MlocusAdditive(PyTypeObject *t, PyObject *a, PyObject *k) {
  PyObject *o = __pyx_tp_new_5fwdpy_7fitness_MlocusFitness(t, a, k);
  if (unlikely(!o)) return 0;
  if (unlikely(__pyx_pw_5fwdpy_7fitness_14MlocusAdditive_1__cinit__(o, a, k) < 0)) goto bad;
  return o;
  bad:
  Py_DECREF(o); o = 0;
  return NULL;
}

static PyMethodDef __pyx_methods_5fwdpy_7fitness_MlocusAdditive[] = {
  {0, 0, 0, 0}
};

static PyTypeObject __pyx_type_5fwdpy_7fitness_MlocusAdditive = {
  PyVarObject_HEAD_INIT(0, 0)
  "fwdpy.fitness.MlocusAdditive", /*tp_name*/
  sizeof(struct __pyx_obj_5fwdpy_7fitness_MlocusAdditive), /*tp_basicsize*/
  0, /*tp_itemsize*/
  __pyx_tp_dealloc_5fwdpy_7fitness_MlocusFitness, /*tp_dealloc*/
  0, /*tp_print*/
  0, /*tp_getattr*/
  0, /*tp_setattr*/
  #if PY_MAJOR_VERSION < 3
  0, /*tp_compare*/
  #endif
  #if PY_MAJOR_VERSION >= 3
  0, /*tp_as_async*/
  #endif
  0, /*tp_repr*/
  0, /*tp_as_number*/
  0, /*tp_as_sequence*/
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  0, /*tp_as_buffer*/
  Py_TPFLAGS_DEFAULT|Py_TPFLAGS_HAVE_VERSION_TAG|Py_TPFLAGS_CHECKTYPES|Py_TPFLAGS_HAVE_NEWBUFFER|Py_TPFLAGS_BASETYPE, /*tp_flags*/
  "\n    Additive fitness for a multi-region model.\n\n    Fitness is additive with dominance within regions,\n    then strictly additive across regions.\n    ", /*tp_doc*/
  0, /*tp_traverse*/
  0, /*tp_clear*/
  0, /*tp_richcompare*/
  0, /*tp_weaklistoffset*/
  0, /*tp_iter*/
  0, /*tp_iternext*/
  __pyx_methods_5fwdpy_7fitness_MlocusAdditive, /*tp_methods*/
  0, /*tp_members*/
  0, /*tp_getset*/
  0, /*tp_base*/
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  0, /*tp_alloc*/
  __pyx_tp_new_5fwdpy_7fitness_MlocusAdditive, /*tp_new*/
  0, /*tp_free*/
  0, /*tp_is_gc*/
  0, /*tp_bases*/
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  0, /*tp_version_tag*/
  #if PY_VERSION_HEX >= 0x030400a1
  0, /*tp_finalize*/
  #endif
};

static PyObject *__pyx_tp_new_5fwdpy_7fitness_MlocusMult(PyTypeObject *t, PyObject *a, PyObject *k) {
  PyObject *o = __pyx_tp_new_5fwdpy_7fitness_MlocusFitness(t, a, k);
  if (unlikely(!o)) return 0;
  if (unlikely(__pyx_pw_5fwdpy_7fitness_10MlocusMult_1__cinit__(o, a, k) < 0)) goto bad;
  return o;
  bad:
  Py_DECREF(o); o = 0;
  return NULL;
}

static PyMethodDef __pyx_methods_5fwdpy_7fitness_MlocusMult[] = {
  {0, 0, 0, 0}
};

static PyTypeObject __pyx_type_5fwdpy_7fitness_MlocusMult = {
  PyVarObject_HEAD_INIT(0, 0)
  "fwdpy.fitness.MlocusMult", /*tp_name*/
  sizeof(struct __pyx_obj_5fwdpy_7fitness_MlocusMult), /*tp_basicsize*/
  0, /*tp_itemsize*/
  __pyx_tp_dealloc_5fwdpy_7fitness_MlocusFitness, /*tp_dealloc*/
  0, /*tp_print*/
  0, /*tp_getattr*/
  0, /*tp_setattr*/
  #if PY_MAJOR_VERSION < 3
  0, /*tp_compare*/
  #endif
  #if PY_MAJOR_VERSION >= 3
  0, /*tp_as_async*/
  #endif
  0, /*tp_repr*/
  0, /*tp_as_number*/
  0, /*tp_as_sequence*/
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  0, /*tp_as_buffer*/
  Py_TPFLAGS_DEFAULT|Py_TPFLAGS_HAVE_VERSION_TAG|Py_TPFLAGS_CHECKTYPES|Py_TPFLAGS_HAVE_NEWBUFFER|Py_TPFLAGS_BASETYPE, /*tp_flags*/
  "\n    Multiplicative fitness for a multi-region model.\n\n    Fitness is multiplicative with dominance within regions,\n    then strictly additive across regions.\n    ", /*tp_doc*/
  0, /*tp_traverse*/
  0, /*tp_clear*/
  0, /*tp_richcompare*/
  0, /*tp_weaklistoffset*/
  0, /*tp_iter*/
  0, /*tp_iternext*/
  __pyx_methods_5fwdpy_7fitness_MlocusMult, /*tp_methods*/
  0, /*tp_members*/
  0, /*tp_getset*/
  0, /*tp_base*/
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  0, /*tp_alloc*/
  __pyx_tp_new_5fwdpy_7fitness_MlocusMult, /*tp_new*/
  0, /*tp_free*/
  0, /*tp_is_gc*/
  0, /*tp_bases*/
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  0, /*tp_version_tag*/
  #if PY_VERSION_HEX >= 0x030400a1
  0, /*tp_finalize*/
  #endif
};

static PyMethodDef __pyx_methods[] = {
  {0, 0, 0, 0}
};

#if PY_MAJOR_VERSION >= 3
static struct PyModuleDef __pyx_moduledef = {
  #if PY_VERSION_HEX < 0x03020000
    { PyObject_HEAD_INIT(NULL) NULL, 0, NULL },
  #else
    PyModuleDef_HEAD_INIT,
  #endif
    "fitness",
    0, /* m_doc */
    -1, /* m_size */
    __pyx_methods /* m_methods */,
    NULL, /* m_reload */
    NULL, /* m_traverse */
    NULL, /* m_clear */
    NULL /* m_free */
};
#endif

static __Pyx_StringTabEntry __pyx_string_tab[] = {
  {&__pyx_n_s_main, __pyx_k_main, sizeof(__pyx_k_main), 0, 0, 1, 1},
  {&__pyx_n_s_pyx_vtable, __pyx_k_pyx_vtable, sizeof(__pyx_k_pyx_vtable), 0, 0, 1, 1},
  {&__pyx_n_s_scaling, __pyx_k_scaling, sizeof(__pyx_k_scaling), 0, 0, 1, 1},
  {&__pyx_n_s_test, __pyx_k_test, sizeof(__pyx_k_test), 0, 0, 1, 1},
  {0, 0, 0, 0, 0, 0, 0}
};
static int __Pyx_InitCachedBuiltins(void) {
  return 0;
}

static int __Pyx_InitCachedConstants(void) {
  __Pyx_RefNannyDeclarations
  __Pyx_RefNannySetupContext("__Pyx_InitCachedConstants", 0);
  __Pyx_RefNannyFinishContext();
  return 0;
}

static int __Pyx_InitGlobals(void) {
  if (__Pyx_InitStrings(__pyx_string_tab) < 0) __PYX_ERR(0, 1, __pyx_L1_error);
  return 0;
  __pyx_L1_error:;
  return -1;
}

#if PY_MAJOR_VERSION < 3
PyMODINIT_FUNC initfitness(void); /*proto*/
PyMODINIT_FUNC initfitness(void)
#else
PyMODINIT_FUNC PyInit_fitness(void); /*proto*/
PyMODINIT_FUNC PyInit_fitness(void)
#endif
{
  PyObject *__pyx_t_1 = NULL;
  __Pyx_RefNannyDeclarations
  #if CYTHON_REFNANNY
  __Pyx_RefNanny = __Pyx_RefNannyImportAPI("refnanny");
  if (!__Pyx_RefNanny) {
      PyErr_Clear();
      __Pyx_RefNanny = __Pyx_RefNannyImportAPI("Cython.Runtime.refnanny");
      if (!__Pyx_RefNanny)
          Py_FatalError("failed to import 'refnanny' module");
  }
  #endif
  __Pyx_RefNannySetupContext("PyMODINIT_FUNC PyInit_fitness(void)", 0);
  if (__Pyx_check_binary_version() < 0) __PYX_ERR(0, 1, __pyx_L1_error)
  __pyx_empty_tuple = PyTuple_New(0); if (unlikely(!__pyx_empty_tuple)) __PYX_ERR(0, 1, __pyx_L1_error)
  __pyx_empty_bytes = PyBytes_FromStringAndSize("", 0); if (unlikely(!__pyx_empty_bytes)) __PYX_ERR(0, 1, __pyx_L1_error)
  __pyx_empty_unicode = PyUnicode_FromStringAndSize("", 0); if (unlikely(!__pyx_empty_unicode)) __PYX_ERR(0, 1, __pyx_L1_error)
  #ifdef __Pyx_CyFunction_USED
  if (__pyx_CyFunction_init() < 0) __PYX_ERR(0, 1, __pyx_L1_error)
  #endif
  #ifdef __Pyx_FusedFunction_USED
  if (__pyx_FusedFunction_init() < 0) __PYX_ERR(0, 1, __pyx_L1_error)
  #endif
  #ifdef __Pyx_Coroutine_USED
  if (__pyx_Coroutine_init() < 0) __PYX_ERR(0, 1, __pyx_L1_error)
  #endif
  #ifdef __Pyx_Generator_USED
  if (__pyx_Generator_init() < 0) __PYX_ERR(0, 1, __pyx_L1_error)
  #endif
  #ifdef __Pyx_StopAsyncIteration_USED
  if (__pyx_StopAsyncIteration_init() < 0) __PYX_ERR(0, 1, __pyx_L1_error)
  #endif
  /*--- Library function declarations ---*/
  /*--- Threads initialization code ---*/
  #if defined(__PYX_FORCE_INIT_THREADS) && __PYX_FORCE_INIT_THREADS
  #ifdef WITH_THREAD /* Python build with threading support? */
  PyEval_InitThreads();
  #endif
  #endif
  /*--- Module creation code ---*/
  #if PY_MAJOR_VERSION < 3
  __pyx_m = Py_InitModule4("fitness", __pyx_methods, 0, 0, PYTHON_API_VERSION); Py_XINCREF(__pyx_m);
  #else
  __pyx_m = PyModule_Create(&__pyx_moduledef);
  #endif
  if (unlikely(!__pyx_m)) __PYX_ERR(0, 1, __pyx_L1_error)
  __pyx_d = PyModule_GetDict(__pyx_m); if (unlikely(!__pyx_d)) __PYX_ERR(0, 1, __pyx_L1_error)
  Py_INCREF(__pyx_d);
  __pyx_b = PyImport_AddModule(__Pyx_BUILTIN_MODULE_NAME); if (unlikely(!__pyx_b)) __PYX_ERR(0, 1, __pyx_L1_error)
  #if CYTHON_COMPILING_IN_PYPY
  Py_INCREF(__pyx_b);
  #endif
  if (PyObject_SetAttrString(__pyx_m, "__builtins__", __pyx_b) < 0) __PYX_ERR(0, 1, __pyx_L1_error);
  /*--- Initialize various global constants etc. ---*/
  if (__Pyx_InitGlobals() < 0) __PYX_ERR(0, 1, __pyx_L1_error)
  #if PY_MAJOR_VERSION < 3 && (__PYX_DEFAULT_STRING_ENCODING_IS_ASCII || __PYX_DEFAULT_STRING_ENCODING_IS_DEFAULT)
  if (__Pyx_init_sys_getdefaultencoding_params() < 0) __PYX_ERR(0, 1, __pyx_L1_error)
  #endif
  if (__pyx_module_is_main_fwdpy__fitness) {
    if (PyObject_SetAttrString(__pyx_m, "__name__", __pyx_n_s_main) < 0) __PYX_ERR(0, 1, __pyx_L1_error)
  }
  #if PY_MAJOR_VERSION >= 3
  {
    PyObject *modules = PyImport_GetModuleDict(); if (unlikely(!modules)) __PYX_ERR(0, 1, __pyx_L1_error)
    if (!PyDict_GetItemString(modules, "fwdpy.fitness")) {
      if (unlikely(PyDict_SetItemString(modules, "fwdpy.fitness", __pyx_m) < 0)) __PYX_ERR(0, 1, __pyx_L1_error)
    }
  }
  #endif
  /*--- Builtin init code ---*/
  if (__Pyx_InitCachedBuiltins() < 0) __PYX_ERR(0, 1, __pyx_L1_error)
  /*--- Constants init code ---*/
  if (__Pyx_InitCachedConstants() < 0) __PYX_ERR(0, 1, __pyx_L1_error)
  /*--- Global init code ---*/
  /*--- Variable export code ---*/
  /*--- Function export code ---*/
  /*--- Type init code ---*/
  if (PyType_Ready(&__pyx_type_5fwdpy_7fitness_SpopFitness) < 0) __PYX_ERR(1, 108, __pyx_L1_error)
  __pyx_type_5fwdpy_7fitness_SpopFitness.tp_print = 0;
  if (PyObject_SetAttrString(__pyx_m, "SpopFitness", (PyObject *)&__pyx_type_5fwdpy_7fitness_SpopFitness) < 0) __PYX_ERR(1, 108, __pyx_L1_error)
  __pyx_ptype_5fwdpy_7fitness_SpopFitness = &__pyx_type_5fwdpy_7fitness_SpopFitness;
  __pyx_type_5fwdpy_7fitness_SpopAdditive.tp_base = __pyx_ptype_5fwdpy_7fitness_SpopFitness;
  if (PyType_Ready(&__pyx_type_5fwdpy_7fitness_SpopAdditive) < 0) __PYX_ERR(0, 1, __pyx_L1_error)
  __pyx_type_5fwdpy_7fitness_SpopAdditive.tp_print = 0;
  if (PyObject_SetAttrString(__pyx_m, "SpopAdditive", (PyObject *)&__pyx_type_5fwdpy_7fitness_SpopAdditive) < 0) __PYX_ERR(0, 1, __pyx_L1_error)
  __pyx_ptype_5fwdpy_7fitness_SpopAdditive = &__pyx_type_5fwdpy_7fitness_SpopAdditive;
  __pyx_type_5fwdpy_7fitness_SpopMult.tp_base = __pyx_ptype_5fwdpy_7fitness_SpopFitness;
  if (PyType_Ready(&__pyx_type_5fwdpy_7fitness_SpopMult) < 0) __PYX_ERR(0, 16, __pyx_L1_error)
  __pyx_type_5fwdpy_7fitness_SpopMult.tp_print = 0;
  if (PyObject_SetAttrString(__pyx_m, "SpopMult", (PyObject *)&__pyx_type_5fwdpy_7fitness_SpopMult) < 0) __PYX_ERR(0, 16, __pyx_L1_error)
  __pyx_ptype_5fwdpy_7fitness_SpopMult = &__pyx_type_5fwdpy_7fitness_SpopMult;
  if (PyType_Ready(&__pyx_type_5fwdpy_7fitness_MlocusFitness) < 0) __PYX_ERR(1, 120, __pyx_L1_error)
  __pyx_type_5fwdpy_7fitness_MlocusFitness.tp_print = 0;
  if (PyObject_SetAttrString(__pyx_m, "MlocusFitness", (PyObject *)&__pyx_type_5fwdpy_7fitness_MlocusFitness) < 0) __PYX_ERR(1, 120, __pyx_L1_error)
  __pyx_ptype_5fwdpy_7fitness_MlocusFitness = &__pyx_type_5fwdpy_7fitness_MlocusFitness;
  __pyx_type_5fwdpy_7fitness_MlocusAdditive.tp_base = __pyx_ptype_5fwdpy_7fitness_MlocusFitness;
  if (PyType_Ready(&__pyx_type_5fwdpy_7fitness_MlocusAdditive) < 0) __PYX_ERR(0, 31, __pyx_L1_error)
  __pyx_type_5fwdpy_7fitness_MlocusAdditive.tp_print = 0;
  if (PyObject_SetAttrString(__pyx_m, "MlocusAdditive", (PyObject *)&__pyx_type_5fwdpy_7fitness_MlocusAdditive) < 0) __PYX_ERR(0, 31, __pyx_L1_error)
  __pyx_ptype_5fwdpy_7fitness_MlocusAdditive = &__pyx_type_5fwdpy_7fitness_MlocusAdditive;
  __pyx_type_5fwdpy_7fitness_MlocusMult.tp_base = __pyx_ptype_5fwdpy_7fitness_MlocusFitness;
  if (PyType_Ready(&__pyx_type_5fwdpy_7fitness_MlocusMult) < 0) __PYX_ERR(0, 46, __pyx_L1_error)
  __pyx_type_5fwdpy_7fitness_MlocusMult.tp_print = 0;
  if (PyObject_SetAttrString(__pyx_m, "MlocusMult", (PyObject *)&__pyx_type_5fwdpy_7fitness_MlocusMult) < 0) __PYX_ERR(0, 46, __pyx_L1_error)
  __pyx_ptype_5fwdpy_7fitness_MlocusMult = &__pyx_type_5fwdpy_7fitness_MlocusMult;
  /*--- Type import code ---*/
  __pyx_ptype_5fwdpy_8internal_8internal_shwrappervec = __Pyx_ImportType("fwdpy.internal.internal", "shwrappervec", sizeof(struct __pyx_obj_5fwdpy_8internal_8internal_shwrappervec), 1); if (unlikely(!__pyx_ptype_5fwdpy_8internal_8internal_shwrappervec)) __PYX_ERR(2, 7, __pyx_L1_error)
  __pyx_ptype_5fwdpy_8internal_8internal_region_manager_wrapper = __Pyx_ImportType("fwdpy.internal.internal", "region_manager_wrapper", sizeof(struct __pyx_obj_5fwdpy_8internal_8internal_region_manager_wrapper), 1); if (unlikely(!__pyx_ptype_5fwdpy_8internal_8internal_region_manager_wrapper)) __PYX_ERR(2, 17, __pyx_L1_error)
  __pyx_ptype_5fwdpy_5fwdpy_PopType = __Pyx_ImportType("fwdpy.fwdpy", "PopType", sizeof(struct __pyx_obj_5fwdpy_5fwdpy_PopType), 1); if (unlikely(!__pyx_ptype_5fwdpy_5fwdpy_PopType)) __PYX_ERR(3, 124, __pyx_L1_error)
  __pyx_ptype_5fwdpy_5fwdpy_Spop = __Pyx_ImportType("fwdpy.fwdpy", "Spop", sizeof(struct __pyx_obj_5fwdpy_5fwdpy_Spop), 1); if (unlikely(!__pyx_ptype_5fwdpy_5fwdpy_Spop)) __PYX_ERR(3, 132, __pyx_L1_error)
  __pyx_vtabptr_5fwdpy_5fwdpy_Spop = (struct __pyx_vtabstruct_5fwdpy_5fwdpy_Spop*)__Pyx_GetVtable(__pyx_ptype_5fwdpy_5fwdpy_Spop->tp_dict); if (unlikely(!__pyx_vtabptr_5fwdpy_5fwdpy_Spop)) __PYX_ERR(3, 132, __pyx_L1_error)
  __pyx_ptype_5fwdpy_5fwdpy_MetaPop = __Pyx_ImportType("fwdpy.fwdpy", "MetaPop", sizeof(struct __pyx_obj_5fwdpy_5fwdpy_MetaPop), 1); if (unlikely(!__pyx_ptype_5fwdpy_5fwdpy_MetaPop)) __PYX_ERR(3, 138, __pyx_L1_error)
  __pyx_vtabptr_5fwdpy_5fwdpy_MetaPop = (struct __pyx_vtabstruct_5fwdpy_5fwdpy_MetaPop*)__Pyx_GetVtable(__pyx_ptype_5fwdpy_5fwdpy_MetaPop->tp_dict); if (unlikely(!__pyx_vtabptr_5fwdpy_5fwdpy_MetaPop)) __PYX_ERR(3, 138, __pyx_L1_error)
  __pyx_ptype_5fwdpy_5fwdpy_MlocusPop = __Pyx_ImportType("fwdpy.fwdpy", "MlocusPop", sizeof(struct __pyx_obj_5fwdpy_5fwdpy_MlocusPop), 1); if (unlikely(!__pyx_ptype_5fwdpy_5fwdpy_MlocusPop)) __PYX_ERR(3, 145, __pyx_L1_error)
  __pyx_vtabptr_5fwdpy_5fwdpy_MlocusPop = (struct __pyx_vtabstruct_5fwdpy_5fwdpy_MlocusPop*)__Pyx_GetVtable(__pyx_ptype_5fwdpy_5fwdpy_MlocusPop->tp_dict); if (unlikely(!__pyx_vtabptr_5fwdpy_5fwdpy_MlocusPop)) __PYX_ERR(3, 145, __pyx_L1_error)
  __pyx_ptype_5fwdpy_5fwdpy_SpopGenMut = __Pyx_ImportType("fwdpy.fwdpy", "SpopGenMut", sizeof(struct __pyx_obj_5fwdpy_5fwdpy_SpopGenMut), 1); if (unlikely(!__pyx_ptype_5fwdpy_5fwdpy_SpopGenMut)) __PYX_ERR(3, 151, __pyx_L1_error)
  __pyx_vtabptr_5fwdpy_5fwdpy_SpopGenMut = (struct __pyx_vtabstruct_5fwdpy_5fwdpy_SpopGenMut*)__Pyx_GetVtable(__pyx_ptype_5fwdpy_5fwdpy_SpopGenMut->tp_dict); if (unlikely(!__pyx_vtabptr_5fwdpy_5fwdpy_SpopGenMut)) __PYX_ERR(3, 151, __pyx_L1_error)
  __pyx_ptype_5fwdpy_5fwdpy_PopVec = __Pyx_ImportType("fwdpy.fwdpy", "PopVec", sizeof(struct __pyx_obj_5fwdpy_5fwdpy_PopVec), 1); if (unlikely(!__pyx_ptype_5fwdpy_5fwdpy_PopVec)) __PYX_ERR(3, 157, __pyx_L1_error)
  __pyx_ptype_5fwdpy_5fwdpy_SpopVec = __Pyx_ImportType("fwdpy.fwdpy", "SpopVec", sizeof(struct __pyx_obj_5fwdpy_5fwdpy_SpopVec), 1); if (unlikely(!__pyx_ptype_5fwdpy_5fwdpy_SpopVec)) __PYX_ERR(3, 165, __pyx_L1_error)
  __pyx_vtabptr_5fwdpy_5fwdpy_SpopVec = (struct __pyx_vtabstruct_5fwdpy_5fwdpy_SpopVec*)__Pyx_GetVtable(__pyx_ptype_5fwdpy_5fwdpy_SpopVec->tp_dict); if (unlikely(!__pyx_vtabptr_5fwdpy_5fwdpy_SpopVec)) __PYX_ERR(3, 165, __pyx_L1_error)
  __pyx_ptype_5fwdpy_5fwdpy_SpopGenMutVec = __Pyx_ImportType("fwdpy.fwdpy", "SpopGenMutVec", sizeof(struct __pyx_obj_5fwdpy_5fwdpy_SpopGenMutVec), 1); if (unlikely(!__pyx_ptype_5fwdpy_5fwdpy_SpopGenMutVec)) __PYX_ERR(3, 171, __pyx_L1_error)
  __pyx_vtabptr_5fwdpy_5fwdpy_SpopGenMutVec = (struct __pyx_vtabstruct_5fwdpy_5fwdpy_SpopGenMutVec*)__Pyx_GetVtable(__pyx_ptype_5fwdpy_5fwdpy_SpopGenMutVec->tp_dict); if (unlikely(!__pyx_vtabptr_5fwdpy_5fwdpy_SpopGenMutVec)) __PYX_ERR(3, 171, __pyx_L1_error)
  __pyx_ptype_5fwdpy_5fwdpy_MetaPopVec = __Pyx_ImportType("fwdpy.fwdpy", "MetaPopVec", sizeof(struct __pyx_obj_5fwdpy_5fwdpy_MetaPopVec), 1); if (unlikely(!__pyx_ptype_5fwdpy_5fwdpy_MetaPopVec)) __PYX_ERR(3, 176, __pyx_L1_error)
  __pyx_vtabptr_5fwdpy_5fwdpy_MetaPopVec = (struct __pyx_vtabstruct_5fwdpy_5fwdpy_MetaPopVec*)__Pyx_GetVtable(__pyx_ptype_5fwdpy_5fwdpy_MetaPopVec->tp_dict); if (unlikely(!__pyx_vtabptr_5fwdpy_5fwdpy_MetaPopVec)) __PYX_ERR(3, 176, __pyx_L1_error)
  __pyx_ptype_5fwdpy_5fwdpy_MlocusPopVec = __Pyx_ImportType("fwdpy.fwdpy", "MlocusPopVec", sizeof(struct __pyx_obj_5fwdpy_5fwdpy_MlocusPopVec), 1); if (unlikely(!__pyx_ptype_5fwdpy_5fwdpy_MlocusPopVec)) __PYX_ERR(3, 182, __pyx_L1_error)
  __pyx_vtabptr_5fwdpy_5fwdpy_MlocusPopVec = (struct __pyx_vtabstruct_5fwdpy_5fwdpy_MlocusPopVec*)__Pyx_GetVtable(__pyx_ptype_5fwdpy_5fwdpy_MlocusPopVec->tp_dict); if (unlikely(!__pyx_vtabptr_5fwdpy_5fwdpy_MlocusPopVec)) __PYX_ERR(3, 182, __pyx_L1_error)
  __pyx_ptype_5fwdpy_5fwdpy_GSLrng = __Pyx_ImportType("fwdpy.fwdpy", "GSLrng", sizeof(struct __pyx_obj_5fwdpy_5fwdpy_GSLrng), 1); if (unlikely(!__pyx_ptype_5fwdpy_5fwdpy_GSLrng)) __PYX_ERR(3, 189, __pyx_L1_error)
  __pyx_ptype_5fwdpy_5fwdpy_TemporalSampler = __Pyx_ImportType("fwdpy.fwdpy", "TemporalSampler", sizeof(struct __pyx_obj_5fwdpy_5fwdpy_TemporalSampler), 1); if (unlikely(!__pyx_ptype_5fwdpy_5fwdpy_TemporalSampler)) __PYX_ERR(3, 285, __pyx_L1_error)
  __pyx_vtabptr_5fwdpy_5fwdpy_TemporalSampler = (struct __pyx_vtabstruct_5fwdpy_5fwdpy_TemporalSampler*)__Pyx_GetVtable(__pyx_ptype_5fwdpy_5fwdpy_TemporalSampler->tp_dict); if (unlikely(!__pyx_vtabptr_5fwdpy_5fwdpy_TemporalSampler)) __PYX_ERR(3, 285, __pyx_L1_error)
  __pyx_ptype_5fwdpy_5fwdpy_NothingSampler = __Pyx_ImportType("fwdpy.fwdpy", "NothingSampler", sizeof(struct __pyx_obj_5fwdpy_5fwdpy_NothingSampler), 1); if (unlikely(!__pyx_ptype_5fwdpy_5fwdpy_NothingSampler)) __PYX_ERR(3, 293, __pyx_L1_error)
  __pyx_vtabptr_5fwdpy_5fwdpy_NothingSampler = (struct __pyx_vtabstruct_5fwdpy_5fwdpy_NothingSampler*)__Pyx_GetVtable(__pyx_ptype_5fwdpy_5fwdpy_NothingSampler->tp_dict); if (unlikely(!__pyx_vtabptr_5fwdpy_5fwdpy_NothingSampler)) __PYX_ERR(3, 293, __pyx_L1_error)
  __pyx_ptype_5fwdpy_5fwdpy_QtraitStatsSampler = __Pyx_ImportType("fwdpy.fwdpy", "QtraitStatsSampler", sizeof(struct __pyx_obj_5fwdpy_5fwdpy_QtraitStatsSampler), 1); if (unlikely(!__pyx_ptype_5fwdpy_5fwdpy_QtraitStatsSampler)) __PYX_ERR(3, 296, __pyx_L1_error)
  __pyx_vtabptr_5fwdpy_5fwdpy_QtraitStatsSampler = (struct __pyx_vtabstruct_5fwdpy_5fwdpy_QtraitStatsSampler*)__Pyx_GetVtable(__pyx_ptype_5fwdpy_5fwdpy_QtraitStatsSampler->tp_dict); if (unlikely(!__pyx_vtabptr_5fwdpy_5fwdpy_QtraitStatsSampler)) __PYX_ERR(3, 296, __pyx_L1_error)
  __pyx_ptype_5fwdpy_5fwdpy_PopSampler = __Pyx_ImportType("fwdpy.fwdpy", "PopSampler", sizeof(struct __pyx_obj_5fwdpy_5fwdpy_PopSampler), 1); if (unlikely(!__pyx_ptype_5fwdpy_5fwdpy_PopSampler)) __PYX_ERR(3, 299, __pyx_L1_error)
  __pyx_vtabptr_5fwdpy_5fwdpy_PopSampler = (struct __pyx_vtabstruct_5fwdpy_5fwdpy_PopSampler*)__Pyx_GetVtable(__pyx_ptype_5fwdpy_5fwdpy_PopSampler->tp_dict); if (unlikely(!__pyx_vtabptr_5fwdpy_5fwdpy_PopSampler)) __PYX_ERR(3, 299, __pyx_L1_error)
  __pyx_ptype_5fwdpy_5fwdpy_VASampler = __Pyx_ImportType("fwdpy.fwdpy", "VASampler", sizeof(struct __pyx_obj_5fwdpy_5fwdpy_VASampler), 1); if (unlikely(!__pyx_ptype_5fwdpy_5fwdpy_VASampler)) __PYX_ERR(3, 302, __pyx_L1_error)
  __pyx_vtabptr_5fwdpy_5fwdpy_VASampler = (struct __pyx_vtabstruct_5fwdpy_5fwdpy_VASampler*)__Pyx_GetVtable(__pyx_ptype_5fwdpy_5fwdpy_VASampler->tp_dict); if (unlikely(!__pyx_vtabptr_5fwdpy_5fwdpy_VASampler)) __PYX_ERR(3, 302, __pyx_L1_error)
  __pyx_ptype_5fwdpy_5fwdpy_FreqSampler = __Pyx_ImportType("fwdpy.fwdpy", "FreqSampler", sizeof(struct __pyx_obj_5fwdpy_5fwdpy_FreqSampler), 1); if (unlikely(!__pyx_ptype_5fwdpy_5fwdpy_FreqSampler)) __PYX_ERR(3, 305, __pyx_L1_error)
  __pyx_vtabptr_5fwdpy_5fwdpy_FreqSampler = (struct __pyx_vtabstruct_5fwdpy_5fwdpy_FreqSampler*)__Pyx_GetVtable(__pyx_ptype_5fwdpy_5fwdpy_FreqSampler->tp_dict); if (unlikely(!__pyx_vtabptr_5fwdpy_5fwdpy_FreqSampler)) __PYX_ERR(3, 305, __pyx_L1_error)
  /*--- Variable import code ---*/
  /*--- Function import code ---*/
  /*--- Execution code ---*/
  #if defined(__Pyx_Generator_USED) || defined(__Pyx_Coroutine_USED)
  if (__Pyx_patch_abc() < 0) __PYX_ERR(0, 1, __pyx_L1_error)
  #endif

  /* "fwdpy/fitness.pyx":1
 * cdef class SpopAdditive(SpopFitness):             # <<<<<<<<<<<<<<
 *     """
 *     Additive fitness model for a single deme.
 */
  __pyx_t_1 = PyDict_New(); if (unlikely(!__pyx_t_1)) __PYX_ERR(0, 1, __pyx_L1_error)
  __Pyx_GOTREF(__pyx_t_1);
  if (PyDict_SetItem(__pyx_d, __pyx_n_s_test, __pyx_t_1) < 0) __PYX_ERR(0, 1, __pyx_L1_error)
  __Pyx_DECREF(__pyx_t_1); __pyx_t_1 = 0;

  /* "fwdpy/fitness.pxd":100
 *     return <genotype_fitness_updater>hom_additive_update_2
 * 
 * cdef inline double sum_haplotype_effects(const gamete_t & g, const mcont_t & m) nogil:             # <<<<<<<<<<<<<<
 *     cdef size_t i=0,n=g.smutations.size()
 *     cdef double rv = 0.0
 */

  /*--- Wrapped vars code ---*/

  goto __pyx_L0;
  __pyx_L1_error:;
  __Pyx_XDECREF(__pyx_t_1);
  if (__pyx_m) {
    if (__pyx_d) {
      __Pyx_AddTraceback("init fwdpy.fitness", __pyx_clineno, __pyx_lineno, __pyx_filename);
    }
    Py_DECREF(__pyx_m); __pyx_m = 0;
  } else if (!PyErr_Occurred()) {
    PyErr_SetString(PyExc_ImportError, "init fwdpy.fitness");
  }
  __pyx_L0:;
  __Pyx_RefNannyFinishContext();
  #if PY_MAJOR_VERSION < 3
  return;
  #else
  return __pyx_m;
  #endif
}

/* --- Runtime support code --- */
/* Refnanny */
#if CYTHON_REFNANNY
static __Pyx_RefNannyAPIStruct *__Pyx_RefNannyImportAPI(const char *modname) {
    PyObject *m = NULL, *p = NULL;
    void *r = NULL;
    m = PyImport_ImportModule((char *)modname);
    if (!m) goto end;
    p = PyObject_GetAttrString(m, (char *)"RefNannyAPI");
    if (!p) goto end;
    r = PyLong_AsVoidPtr(p);
end:
    Py_XDECREF(p);
    Py_XDECREF(m);
    return (__Pyx_RefNannyAPIStruct *)r;
}
#endif

/* RaiseDoubleKeywords */
static void __Pyx_RaiseDoubleKeywordsError(
    const char* func_name,
    PyObject* kw_name)
{
    PyErr_Format(PyExc_TypeError,
        #if PY_MAJOR_VERSION >= 3
        "%s() got multiple values for keyword argument '%U'", func_name, kw_name);
        #else
        "%s() got multiple values for keyword argument '%s'", func_name,
        PyString_AsString(kw_name));
        #endif
}

/* ParseKeywords */
static int __Pyx_ParseOptionalKeywords(
    PyObject *kwds,
    PyObject **argnames[],
    PyObject *kwds2,
    PyObject *values[],
    Py_ssize_t num_pos_args,
    const char* function_name)
{
    PyObject *key = 0, *value = 0;
    Py_ssize_t pos = 0;
    PyObject*** name;
    PyObject*** first_kw_arg = argnames + num_pos_args;
    while (PyDict_Next(kwds, &pos, &key, &value)) {
        name = first_kw_arg;
        while (*name && (**name != key)) name++;
        if (*name) {
            values[name-argnames] = value;
            continue;
        }
        name = first_kw_arg;
        #if PY_MAJOR_VERSION < 3
        if (likely(PyString_CheckExact(key)) || likely(PyString_Check(key))) {
            while (*name) {
                if ((CYTHON_COMPILING_IN_PYPY || PyString_GET_SIZE(**name) == PyString_GET_SIZE(key))
                        && _PyString_Eq(**name, key)) {
                    values[name-argnames] = value;
                    break;
                }
                name++;
            }
            if (*name) continue;
            else {
                PyObject*** argname = argnames;
                while (argname != first_kw_arg) {
                    if ((**argname == key) || (
                            (CYTHON_COMPILING_IN_PYPY || PyString_GET_SIZE(**argname) == PyString_GET_SIZE(key))
                             && _PyString_Eq(**argname, key))) {
                        goto arg_passed_twice;
                    }
                    argname++;
                }
            }
        } else
        #endif
        if (likely(PyUnicode_Check(key))) {
            while (*name) {
                int cmp = (**name == key) ? 0 :
                #if !CYTHON_COMPILING_IN_PYPY && PY_MAJOR_VERSION >= 3
                    (PyUnicode_GET_SIZE(**name) != PyUnicode_GET_SIZE(key)) ? 1 :
                #endif
                    PyUnicode_Compare(**name, key);
                if (cmp < 0 && unlikely(PyErr_Occurred())) goto bad;
                if (cmp == 0) {
                    values[name-argnames] = value;
                    break;
                }
                name++;
            }
            if (*name) continue;
            else {
                PyObject*** argname = argnames;
                while (argname != first_kw_arg) {
                    int cmp = (**argname == key) ? 0 :
                    #if !CYTHON_COMPILING_IN_PYPY && PY_MAJOR_VERSION >= 3
                        (PyUnicode_GET_SIZE(**argname) != PyUnicode_GET_SIZE(key)) ? 1 :
                    #endif
                        PyUnicode_Compare(**argname, key);
                    if (cmp < 0 && unlikely(PyErr_Occurred())) goto bad;
                    if (cmp == 0) goto arg_passed_twice;
                    argname++;
                }
            }
        } else
            goto invalid_keyword_type;
        if (kwds2) {
            if (unlikely(PyDict_SetItem(kwds2, key, value))) goto bad;
        } else {
            goto invalid_keyword;
        }
    }
    return 0;
arg_passed_twice:
    __Pyx_RaiseDoubleKeywordsError(function_name, key);
    goto bad;
invalid_keyword_type:
    PyErr_Format(PyExc_TypeError,
        "%.200s() keywords must be strings", function_name);
    goto bad;
invalid_keyword:
    PyErr_Format(PyExc_TypeError,
    #if PY_MAJOR_VERSION < 3
        "%.200s() got an unexpected keyword argument '%.200s'",
        function_name, PyString_AsString(key));
    #else
        "%s() got an unexpected keyword argument '%U'",
        function_name, key);
    #endif
bad:
    return -1;
}

/* RaiseArgTupleInvalid */
static void __Pyx_RaiseArgtupleInvalid(
    const char* func_name,
    int exact,
    Py_ssize_t num_min,
    Py_ssize_t num_max,
    Py_ssize_t num_found)
{
    Py_ssize_t num_expected;
    const char *more_or_less;
    if (num_found < num_min) {
        num_expected = num_min;
        more_or_less = "at least";
    } else {
        num_expected = num_max;
        more_or_less = "at most";
    }
    if (exact) {
        more_or_less = "exactly";
    }
    PyErr_Format(PyExc_TypeError,
                 "%.200s() takes %.8s %" CYTHON_FORMAT_SSIZE_T "d positional argument%.1s (%" CYTHON_FORMAT_SSIZE_T "d given)",
                 func_name, more_or_less, num_expected,
                 (num_expected == 1) ? "" : "s", num_found);
}

/* GetVTable */
static void* __Pyx_GetVtable(PyObject *dict) {
    void* ptr;
    PyObject *ob = PyObject_GetItem(dict, __pyx_n_s_pyx_vtable);
    if (!ob)
        goto bad;
#if PY_VERSION_HEX >= 0x02070000
    ptr = PyCapsule_GetPointer(ob, 0);
#else
    ptr = PyCObject_AsVoidPtr(ob);
#endif
    if (!ptr && !PyErr_Occurred())
        PyErr_SetString(PyExc_RuntimeError, "invalid vtable found for imported type");
    Py_DECREF(ob);
    return ptr;
bad:
    Py_XDECREF(ob);
    return NULL;
}

/* CodeObjectCache */
static int __pyx_bisect_code_objects(__Pyx_CodeObjectCacheEntry* entries, int count, int code_line) {
    int start = 0, mid = 0, end = count - 1;
    if (end >= 0 && code_line > entries[end].code_line) {
        return count;
    }
    while (start < end) {
        mid = start + (end - start) / 2;
        if (code_line < entries[mid].code_line) {
            end = mid;
        } else if (code_line > entries[mid].code_line) {
             start = mid + 1;
        } else {
            return mid;
        }
    }
    if (code_line <= entries[mid].code_line) {
        return mid;
    } else {
        return mid + 1;
    }
}
static PyCodeObject *__pyx_find_code_object(int code_line) {
    PyCodeObject* code_object;
    int pos;
    if (unlikely(!code_line) || unlikely(!__pyx_code_cache.entries)) {
        return NULL;
    }
    pos = __pyx_bisect_code_objects(__pyx_code_cache.entries, __pyx_code_cache.count, code_line);
    if (unlikely(pos >= __pyx_code_cache.count) || unlikely(__pyx_code_cache.entries[pos].code_line != code_line)) {
        return NULL;
    }
    code_object = __pyx_code_cache.entries[pos].code_object;
    Py_INCREF(code_object);
    return code_object;
}
static void __pyx_insert_code_object(int code_line, PyCodeObject* code_object) {
    int pos, i;
    __Pyx_CodeObjectCacheEntry* entries = __pyx_code_cache.entries;
    if (unlikely(!code_line)) {
        return;
    }
    if (unlikely(!entries)) {
        entries = (__Pyx_CodeObjectCacheEntry*)PyMem_Malloc(64*sizeof(__Pyx_CodeObjectCacheEntry));
        if (likely(entries)) {
            __pyx_code_cache.entries = entries;
            __pyx_code_cache.max_count = 64;
            __pyx_code_cache.count = 1;
            entries[0].code_line = code_line;
            entries[0].code_object = code_object;
            Py_INCREF(code_object);
        }
        return;
    }
    pos = __pyx_bisect_code_objects(__pyx_code_cache.entries, __pyx_code_cache.count, code_line);
    if ((pos < __pyx_code_cache.count) && unlikely(__pyx_code_cache.entries[pos].code_line == code_line)) {
        PyCodeObject* tmp = entries[pos].code_object;
        entries[pos].code_object = code_object;
        Py_DECREF(tmp);
        return;
    }
    if (__pyx_code_cache.count == __pyx_code_cache.max_count) {
        int new_max = __pyx_code_cache.max_count + 64;
        entries = (__Pyx_CodeObjectCacheEntry*)PyMem_Realloc(
            __pyx_code_cache.entries, (size_t)new_max*sizeof(__Pyx_CodeObjectCacheEntry));
        if (unlikely(!entries)) {
            return;
        }
        __pyx_code_cache.entries = entries;
        __pyx_code_cache.max_count = new_max;
    }
    for (i=__pyx_code_cache.count; i>pos; i--) {
        entries[i] = entries[i-1];
    }
    entries[pos].code_line = code_line;
    entries[pos].code_object = code_object;
    __pyx_code_cache.count++;
    Py_INCREF(code_object);
}

/* AddTraceback */
#include "compile.h"
#include "frameobject.h"
#include "traceback.h"
static PyCodeObject* __Pyx_CreateCodeObjectForTraceback(
            const char *funcname, int c_line,
            int py_line, const char *filename) {
    PyCodeObject *py_code = 0;
    PyObject *py_srcfile = 0;
    PyObject *py_funcname = 0;
    #if PY_MAJOR_VERSION < 3
    py_srcfile = PyString_FromString(filename);
    #else
    py_srcfile = PyUnicode_FromString(filename);
    #endif
    if (!py_srcfile) goto bad;
    if (c_line) {
        #if PY_MAJOR_VERSION < 3
        py_funcname = PyString_FromFormat( "%s (%s:%d)", funcname, __pyx_cfilenm, c_line);
        #else
        py_funcname = PyUnicode_FromFormat( "%s (%s:%d)", funcname, __pyx_cfilenm, c_line);
        #endif
    }
    else {
        #if PY_MAJOR_VERSION < 3
        py_funcname = PyString_FromString(funcname);
        #else
        py_funcname = PyUnicode_FromString(funcname);
        #endif
    }
    if (!py_funcname) goto bad;
    py_code = __Pyx_PyCode_New(
        0,
        0,
        0,
        0,
        0,
        __pyx_empty_bytes, /*PyObject *code,*/
        __pyx_empty_tuple, /*PyObject *consts,*/
        __pyx_empty_tuple, /*PyObject *names,*/
        __pyx_empty_tuple, /*PyObject *varnames,*/
        __pyx_empty_tuple, /*PyObject *freevars,*/
        __pyx_empty_tuple, /*PyObject *cellvars,*/
        py_srcfile,   /*PyObject *filename,*/
        py_funcname,  /*PyObject *name,*/
        py_line,
        __pyx_empty_bytes  /*PyObject *lnotab*/
    );
    Py_DECREF(py_srcfile);
    Py_DECREF(py_funcname);
    return py_code;
bad:
    Py_XDECREF(py_srcfile);
    Py_XDECREF(py_funcname);
    return NULL;
}
static void __Pyx_AddTraceback(const char *funcname, int c_line,
                               int py_line, const char *filename) {
    PyCodeObject *py_code = 0;
    PyFrameObject *py_frame = 0;
    py_code = __pyx_find_code_object(c_line ? c_line : py_line);
    if (!py_code) {
        py_code = __Pyx_CreateCodeObjectForTraceback(
            funcname, c_line, py_line, filename);
        if (!py_code) goto bad;
        __pyx_insert_code_object(c_line ? c_line : py_line, py_code);
    }
    py_frame = PyFrame_New(
        PyThreadState_GET(), /*PyThreadState *tstate,*/
        py_code,             /*PyCodeObject *code,*/
        __pyx_d,      /*PyObject *globals,*/
        0                    /*PyObject *locals*/
    );
    if (!py_frame) goto bad;
    __Pyx_PyFrame_SetLineNumber(py_frame, py_line);
    PyTraceBack_Here(py_frame);
bad:
    Py_XDECREF(py_code);
    Py_XDECREF(py_frame);
}

/* CIntFromPyVerify */
#define __PYX_VERIFY_RETURN_INT(target_type, func_type, func_value)\
    __PYX__VERIFY_RETURN_INT(target_type, func_type, func_value, 0)
#define __PYX_VERIFY_RETURN_INT_EXC(target_type, func_type, func_value)\
    __PYX__VERIFY_RETURN_INT(target_type, func_type, func_value, 1)
#define __PYX__VERIFY_RETURN_INT(target_type, func_type, func_value, exc)\
    {\
        func_type value = func_value;\
        if (sizeof(target_type) < sizeof(func_type)) {\
            if (unlikely(value != (func_type) (target_type) value)) {\
                func_type zero = 0;\
                if (exc && unlikely(value == (func_type)-1 && PyErr_Occurred()))\
                    return (target_type) -1;\
                if (is_unsigned && unlikely(value < zero))\
                    goto raise_neg_overflow;\
                else\
                    goto raise_overflow;\
            }\
        }\
        return (target_type) value;\
    }

/* CIntFromPy */
static CYTHON_INLINE int __Pyx_PyInt_As_int(PyObject *x) {
    const int neg_one = (int) -1, const_zero = (int) 0;
    const int is_unsigned = neg_one > const_zero;
#if PY_MAJOR_VERSION < 3
    if (likely(PyInt_Check(x))) {
        if (sizeof(int) < sizeof(long)) {
            __PYX_VERIFY_RETURN_INT(int, long, PyInt_AS_LONG(x))
        } else {
            long val = PyInt_AS_LONG(x);
            if (is_unsigned && unlikely(val < 0)) {
                goto raise_neg_overflow;
            }
            return (int) val;
        }
    } else
#endif
    if (likely(PyLong_Check(x))) {
        if (is_unsigned) {
#if CYTHON_USE_PYLONG_INTERNALS
            const digit* digits = ((PyLongObject*)x)->ob_digit;
            switch (Py_SIZE(x)) {
                case  0: return (int) 0;
                case  1: __PYX_VERIFY_RETURN_INT(int, digit, digits[0])
                case 2:
                    if (8 * sizeof(int) > 1 * PyLong_SHIFT) {
                        if (8 * sizeof(unsigned long) > 2 * PyLong_SHIFT) {
                            __PYX_VERIFY_RETURN_INT(int, unsigned long, (((((unsigned long)digits[1]) << PyLong_SHIFT) | (unsigned long)digits[0])))
                        } else if (8 * sizeof(int) >= 2 * PyLong_SHIFT) {
                            return (int) (((((int)digits[1]) << PyLong_SHIFT) | (int)digits[0]));
                        }
                    }
                    break;
                case 3:
                    if (8 * sizeof(int) > 2 * PyLong_SHIFT) {
                        if (8 * sizeof(unsigned long) > 3 * PyLong_SHIFT) {
                            __PYX_VERIFY_RETURN_INT(int, unsigned long, (((((((unsigned long)digits[2]) << PyLong_SHIFT) | (unsigned long)digits[1]) << PyLong_SHIFT) | (unsigned long)digits[0])))
                        } else if (8 * sizeof(int) >= 3 * PyLong_SHIFT) {
                            return (int) (((((((int)digits[2]) << PyLong_SHIFT) | (int)digits[1]) << PyLong_SHIFT) | (int)digits[0]));
                        }
                    }
                    break;
                case 4:
                    if (8 * sizeof(int) > 3 * PyLong_SHIFT) {
                        if (8 * sizeof(unsigned long) > 4 * PyLong_SHIFT) {
                            __PYX_VERIFY_RETURN_INT(int, unsigned long, (((((((((unsigned long)digits[3]) << PyLong_SHIFT) | (unsigned long)digits[2]) << PyLong_SHIFT) | (unsigned long)digits[1]) << PyLong_SHIFT) | (unsigned long)digits[0])))
                        } else if (8 * sizeof(int) >= 4 * PyLong_SHIFT) {
                            return (int) (((((((((int)digits[3]) << PyLong_SHIFT) | (int)digits[2]) << PyLong_SHIFT) | (int)digits[1]) << PyLong_SHIFT) | (int)digits[0]));
                        }
                    }
                    break;
            }
#endif
#if CYTHON_COMPILING_IN_CPYTHON
            if (unlikely(Py_SIZE(x) < 0)) {
                goto raise_neg_overflow;
            }
#else
            {
                int result = PyObject_RichCompareBool(x, Py_False, Py_LT);
                if (unlikely(result < 0))
                    return (int) -1;
                if (unlikely(result == 1))
                    goto raise_neg_overflow;
            }
#endif
            if (sizeof(int) <= sizeof(unsigned long)) {
                __PYX_VERIFY_RETURN_INT_EXC(int, unsigned long, PyLong_AsUnsignedLong(x))
#ifdef HAVE_LONG_LONG
            } else if (sizeof(int) <= sizeof(unsigned PY_LONG_LONG)) {
                __PYX_VERIFY_RETURN_INT_EXC(int, unsigned PY_LONG_LONG, PyLong_AsUnsignedLongLong(x))
#endif
            }
        } else {
#if CYTHON_USE_PYLONG_INTERNALS
            const digit* digits = ((PyLongObject*)x)->ob_digit;
            switch (Py_SIZE(x)) {
                case  0: return (int) 0;
                case -1: __PYX_VERIFY_RETURN_INT(int, sdigit, (sdigit) (-(sdigit)digits[0]))
                case  1: __PYX_VERIFY_RETURN_INT(int,  digit, +digits[0])
                case -2:
                    if (8 * sizeof(int) - 1 > 1 * PyLong_SHIFT) {
                        if (8 * sizeof(unsigned long) > 2 * PyLong_SHIFT) {
                            __PYX_VERIFY_RETURN_INT(int, long, -(long) (((((unsigned long)digits[1]) << PyLong_SHIFT) | (unsigned long)digits[0])))
                        } else if (8 * sizeof(int) - 1 > 2 * PyLong_SHIFT) {
                            return (int) (((int)-1)*(((((int)digits[1]) << PyLong_SHIFT) | (int)digits[0])));
                        }
                    }
                    break;
                case 2:
                    if (8 * sizeof(int) > 1 * PyLong_SHIFT) {
                        if (8 * sizeof(unsigned long) > 2 * PyLong_SHIFT) {
                            __PYX_VERIFY_RETURN_INT(int, unsigned long, (((((unsigned long)digits[1]) << PyLong_SHIFT) | (unsigned long)digits[0])))
                        } else if (8 * sizeof(int) - 1 > 2 * PyLong_SHIFT) {
                            return (int) ((((((int)digits[1]) << PyLong_SHIFT) | (int)digits[0])));
                        }
                    }
                    break;
                case -3:
                    if (8 * sizeof(int) - 1 > 2 * PyLong_SHIFT) {
                        if (8 * sizeof(unsigned long) > 3 * PyLong_SHIFT) {
                            __PYX_VERIFY_RETURN_INT(int, long, -(long) (((((((unsigned long)digits[2]) << PyLong_SHIFT) | (unsigned long)digits[1]) << PyLong_SHIFT) | (unsigned long)digits[0])))
                        } else if (8 * sizeof(int) - 1 > 3 * PyLong_SHIFT) {
                            return (int) (((int)-1)*(((((((int)digits[2]) << PyLong_SHIFT) | (int)digits[1]) << PyLong_SHIFT) | (int)digits[0])));
                        }
                    }
                    break;
                case 3:
                    if (8 * sizeof(int) > 2 * PyLong_SHIFT) {
                        if (8 * sizeof(unsigned long) > 3 * PyLong_SHIFT) {
                            __PYX_VERIFY_RETURN_INT(int, unsigned long, (((((((unsigned long)digits[2]) << PyLong_SHIFT) | (unsigned long)digits[1]) << PyLong_SHIFT) | (unsigned long)digits[0])))
                        } else if (8 * sizeof(int) - 1 > 3 * PyLong_SHIFT) {
                            return (int) ((((((((int)digits[2]) << PyLong_SHIFT) | (int)digits[1]) << PyLong_SHIFT) | (int)digits[0])));
                        }
                    }
                    break;
                case -4:
                    if (8 * sizeof(int) - 1 > 3 * PyLong_SHIFT) {
                        if (8 * sizeof(unsigned long) > 4 * PyLong_SHIFT) {
                            __PYX_VERIFY_RETURN_INT(int, long, -(long) (((((((((unsigned long)digits[3]) << PyLong_SHIFT) | (unsigned long)digits[2]) << PyLong_SHIFT) | (unsigned long)digits[1]) << PyLong_SHIFT) | (unsigned long)digits[0])))
                        } else if (8 * sizeof(int) - 1 > 4 * PyLong_SHIFT) {
                            return (int) (((int)-1)*(((((((((int)digits[3]) << PyLong_SHIFT) | (int)digits[2]) << PyLong_SHIFT) | (int)digits[1]) << PyLong_SHIFT) | (int)digits[0])));
                        }
                    }
                    break;
                case 4:
                    if (8 * sizeof(int) > 3 * PyLong_SHIFT) {
                        if (8 * sizeof(unsigned long) > 4 * PyLong_SHIFT) {
                            __PYX_VERIFY_RETURN_INT(int, unsigned long, (((((((((unsigned long)digits[3]) << PyLong_SHIFT) | (unsigned long)digits[2]) << PyLong_SHIFT) | (unsigned long)digits[1]) << PyLong_SHIFT) | (unsigned long)digits[0])))
                        } else if (8 * sizeof(int) - 1 > 4 * PyLong_SHIFT) {
                            return (int) ((((((((((int)digits[3]) << PyLong_SHIFT) | (int)digits[2]) << PyLong_SHIFT) | (int)digits[1]) << PyLong_SHIFT) | (int)digits[0])));
                        }
                    }
                    break;
            }
#endif
            if (sizeof(int) <= sizeof(long)) {
                __PYX_VERIFY_RETURN_INT_EXC(int, long, PyLong_AsLong(x))
#ifdef HAVE_LONG_LONG
            } else if (sizeof(int) <= sizeof(PY_LONG_LONG)) {
                __PYX_VERIFY_RETURN_INT_EXC(int, PY_LONG_LONG, PyLong_AsLongLong(x))
#endif
            }
        }
        {
#if CYTHON_COMPILING_IN_PYPY && !defined(_PyLong_AsByteArray)
            PyErr_SetString(PyExc_RuntimeError,
                            "_PyLong_AsByteArray() not available in PyPy, cannot convert large numbers");
#else
            int val;
            PyObject *v = __Pyx_PyNumber_IntOrLong(x);
 #if PY_MAJOR_VERSION < 3
            if (likely(v) && !PyLong_Check(v)) {
                PyObject *tmp = v;
                v = PyNumber_Long(tmp);
                Py_DECREF(tmp);
            }
 #endif
            if (likely(v)) {
                int one = 1; int is_little = (int)*(unsigned char *)&one;
                unsigned char *bytes = (unsigned char *)&val;
                int ret = _PyLong_AsByteArray((PyLongObject *)v,
                                              bytes, sizeof(val),
                                              is_little, !is_unsigned);
                Py_DECREF(v);
                if (likely(!ret))
                    return val;
            }
#endif
            return (int) -1;
        }
    } else {
        int val;
        PyObject *tmp = __Pyx_PyNumber_IntOrLong(x);
        if (!tmp) return (int) -1;
        val = __Pyx_PyInt_As_int(tmp);
        Py_DECREF(tmp);
        return val;
    }
raise_overflow:
    PyErr_SetString(PyExc_OverflowError,
        "value too large to convert to int");
    return (int) -1;
raise_neg_overflow:
    PyErr_SetString(PyExc_OverflowError,
        "can't convert negative value to int");
    return (int) -1;
}

/* CIntToPy */
static CYTHON_INLINE PyObject* __Pyx_PyInt_From_long(long value) {
    const long neg_one = (long) -1, const_zero = (long) 0;
    const int is_unsigned = neg_one > const_zero;
    if (is_unsigned) {
        if (sizeof(long) < sizeof(long)) {
            return PyInt_FromLong((long) value);
        } else if (sizeof(long) <= sizeof(unsigned long)) {
            return PyLong_FromUnsignedLong((unsigned long) value);
#ifdef HAVE_LONG_LONG
        } else if (sizeof(long) <= sizeof(unsigned PY_LONG_LONG)) {
            return PyLong_FromUnsignedLongLong((unsigned PY_LONG_LONG) value);
#endif
        }
    } else {
        if (sizeof(long) <= sizeof(long)) {
            return PyInt_FromLong((long) value);
#ifdef HAVE_LONG_LONG
        } else if (sizeof(long) <= sizeof(PY_LONG_LONG)) {
            return PyLong_FromLongLong((PY_LONG_LONG) value);
#endif
        }
    }
    {
        int one = 1; int little = (int)*(unsigned char *)&one;
        unsigned char *bytes = (unsigned char *)&value;
        return _PyLong_FromByteArray(bytes, sizeof(long),
                                     little, !is_unsigned);
    }
}

/* CIntFromPy */
static CYTHON_INLINE long __Pyx_PyInt_As_long(PyObject *x) {
    const long neg_one = (long) -1, const_zero = (long) 0;
    const int is_unsigned = neg_one > const_zero;
#if PY_MAJOR_VERSION < 3
    if (likely(PyInt_Check(x))) {
        if (sizeof(long) < sizeof(long)) {
            __PYX_VERIFY_RETURN_INT(long, long, PyInt_AS_LONG(x))
        } else {
            long val = PyInt_AS_LONG(x);
            if (is_unsigned && unlikely(val < 0)) {
                goto raise_neg_overflow;
            }
            return (long) val;
        }
    } else
#endif
    if (likely(PyLong_Check(x))) {
        if (is_unsigned) {
#if CYTHON_USE_PYLONG_INTERNALS
            const digit* digits = ((PyLongObject*)x)->ob_digit;
            switch (Py_SIZE(x)) {
                case  0: return (long) 0;
                case  1: __PYX_VERIFY_RETURN_INT(long, digit, digits[0])
                case 2:
                    if (8 * sizeof(long) > 1 * PyLong_SHIFT) {
                        if (8 * sizeof(unsigned long) > 2 * PyLong_SHIFT) {
                            __PYX_VERIFY_RETURN_INT(long, unsigned long, (((((unsigned long)digits[1]) << PyLong_SHIFT) | (unsigned long)digits[0])))
                        } else if (8 * sizeof(long) >= 2 * PyLong_SHIFT) {
                            return (long) (((((long)digits[1]) << PyLong_SHIFT) | (long)digits[0]));
                        }
                    }
                    break;
                case 3:
                    if (8 * sizeof(long) > 2 * PyLong_SHIFT) {
                        if (8 * sizeof(unsigned long) > 3 * PyLong_SHIFT) {
                            __PYX_VERIFY_RETURN_INT(long, unsigned long, (((((((unsigned long)digits[2]) << PyLong_SHIFT) | (unsigned long)digits[1]) << PyLong_SHIFT) | (unsigned long)digits[0])))
                        } else if (8 * sizeof(long) >= 3 * PyLong_SHIFT) {
                            return (long) (((((((long)digits[2]) << PyLong_SHIFT) | (long)digits[1]) << PyLong_SHIFT) | (long)digits[0]));
                        }
                    }
                    break;
                case 4:
                    if (8 * sizeof(long) > 3 * PyLong_SHIFT) {
                        if (8 * sizeof(unsigned long) > 4 * PyLong_SHIFT) {
                            __PYX_VERIFY_RETURN_INT(long, unsigned long, (((((((((unsigned long)digits[3]) << PyLong_SHIFT) | (unsigned long)digits[2]) << PyLong_SHIFT) | (unsigned long)digits[1]) << PyLong_SHIFT) | (unsigned long)digits[0])))
                        } else if (8 * sizeof(long) >= 4 * PyLong_SHIFT) {
                            return (long) (((((((((long)digits[3]) << PyLong_SHIFT) | (long)digits[2]) << PyLong_SHIFT) | (long)digits[1]) << PyLong_SHIFT) | (long)digits[0]));
                        }
                    }
                    break;
            }
#endif
#if CYTHON_COMPILING_IN_CPYTHON
            if (unlikely(Py_SIZE(x) < 0)) {
                goto raise_neg_overflow;
            }
#else
            {
                int result = PyObject_RichCompareBool(x, Py_False, Py_LT);
                if (unlikely(result < 0))
                    return (long) -1;
                if (unlikely(result == 1))
                    goto raise_neg_overflow;
            }
#endif
            if (sizeof(long) <= sizeof(unsigned long)) {
                __PYX_VERIFY_RETURN_INT_EXC(long, unsigned long, PyLong_AsUnsignedLong(x))
#ifdef HAVE_LONG_LONG
            } else if (sizeof(long) <= sizeof(unsigned PY_LONG_LONG)) {
                __PYX_VERIFY_RETURN_INT_EXC(long, unsigned PY_LONG_LONG, PyLong_AsUnsignedLongLong(x))
#endif
            }
        } else {
#if CYTHON_USE_PYLONG_INTERNALS
            const digit* digits = ((PyLongObject*)x)->ob_digit;
            switch (Py_SIZE(x)) {
                case  0: return (long) 0;
                case -1: __PYX_VERIFY_RETURN_INT(long, sdigit, (sdigit) (-(sdigit)digits[0]))
                case  1: __PYX_VERIFY_RETURN_INT(long,  digit, +digits[0])
                case -2:
                    if (8 * sizeof(long) - 1 > 1 * PyLong_SHIFT) {
                        if (8 * sizeof(unsigned long) > 2 * PyLong_SHIFT) {
                            __PYX_VERIFY_RETURN_INT(long, long, -(long) (((((unsigned long)digits[1]) << PyLong_SHIFT) | (unsigned long)digits[0])))
                        } else if (8 * sizeof(long) - 1 > 2 * PyLong_SHIFT) {
                            return (long) (((long)-1)*(((((long)digits[1]) << PyLong_SHIFT) | (long)digits[0])));
                        }
                    }
                    break;
                case 2:
                    if (8 * sizeof(long) > 1 * PyLong_SHIFT) {
                        if (8 * sizeof(unsigned long) > 2 * PyLong_SHIFT) {
                            __PYX_VERIFY_RETURN_INT(long, unsigned long, (((((unsigned long)digits[1]) << PyLong_SHIFT) | (unsigned long)digits[0])))
                        } else if (8 * sizeof(long) - 1 > 2 * PyLong_SHIFT) {
                            return (long) ((((((long)digits[1]) << PyLong_SHIFT) | (long)digits[0])));
                        }
                    }
                    break;
                case -3:
                    if (8 * sizeof(long) - 1 > 2 * PyLong_SHIFT) {
                        if (8 * sizeof(unsigned long) > 3 * PyLong_SHIFT) {
                            __PYX_VERIFY_RETURN_INT(long, long, -(long) (((((((unsigned long)digits[2]) << PyLong_SHIFT) | (unsigned long)digits[1]) << PyLong_SHIFT) | (unsigned long)digits[0])))
                        } else if (8 * sizeof(long) - 1 > 3 * PyLong_SHIFT) {
                            return (long) (((long)-1)*(((((((long)digits[2]) << PyLong_SHIFT) | (long)digits[1]) << PyLong_SHIFT) | (long)digits[0])));
                        }
                    }
                    break;
                case 3:
                    if (8 * sizeof(long) > 2 * PyLong_SHIFT) {
                        if (8 * sizeof(unsigned long) > 3 * PyLong_SHIFT) {
                            __PYX_VERIFY_RETURN_INT(long, unsigned long, (((((((unsigned long)digits[2]) << PyLong_SHIFT) | (unsigned long)digits[1]) << PyLong_SHIFT) | (unsigned long)digits[0])))
                        } else if (8 * sizeof(long) - 1 > 3 * PyLong_SHIFT) {
                            return (long) ((((((((long)digits[2]) << PyLong_SHIFT) | (long)digits[1]) << PyLong_SHIFT) | (long)digits[0])));
                        }
                    }
                    break;
                case -4:
                    if (8 * sizeof(long) - 1 > 3 * PyLong_SHIFT) {
                        if (8 * sizeof(unsigned long) > 4 * PyLong_SHIFT) {
                            __PYX_VERIFY_RETURN_INT(long, long, -(long) (((((((((unsigned long)digits[3]) << PyLong_SHIFT) | (unsigned long)digits[2]) << PyLong_SHIFT) | (unsigned long)digits[1]) << PyLong_SHIFT) | (unsigned long)digits[0])))
                        } else if (8 * sizeof(long) - 1 > 4 * PyLong_SHIFT) {
                            return (long) (((long)-1)*(((((((((long)digits[3]) << PyLong_SHIFT) | (long)digits[2]) << PyLong_SHIFT) | (long)digits[1]) << PyLong_SHIFT) | (long)digits[0])));
                        }
                    }
                    break;
                case 4:
                    if (8 * sizeof(long) > 3 * PyLong_SHIFT) {
                        if (8 * sizeof(unsigned long) > 4 * PyLong_SHIFT) {
                            __PYX_VERIFY_RETURN_INT(long, unsigned long, (((((((((unsigned long)digits[3]) << PyLong_SHIFT) | (unsigned long)digits[2]) << PyLong_SHIFT) | (unsigned long)digits[1]) << PyLong_SHIFT) | (unsigned long)digits[0])))
                        } else if (8 * sizeof(long) - 1 > 4 * PyLong_SHIFT) {
                            return (long) ((((((((((long)digits[3]) << PyLong_SHIFT) | (long)digits[2]) << PyLong_SHIFT) | (long)digits[1]) << PyLong_SHIFT) | (long)digits[0])));
                        }
                    }
                    break;
            }
#endif
            if (sizeof(long) <= sizeof(long)) {
                __PYX_VERIFY_RETURN_INT_EXC(long, long, PyLong_AsLong(x))
#ifdef HAVE_LONG_LONG
            } else if (sizeof(long) <= sizeof(PY_LONG_LONG)) {
                __PYX_VERIFY_RETURN_INT_EXC(long, PY_LONG_LONG, PyLong_AsLongLong(x))
#endif
            }
        }
        {
#if CYTHON_COMPILING_IN_PYPY && !defined(_PyLong_AsByteArray)
            PyErr_SetString(PyExc_RuntimeError,
                            "_PyLong_AsByteArray() not available in PyPy, cannot convert large numbers");
#else
            long val;
            PyObject *v = __Pyx_PyNumber_IntOrLong(x);
 #if PY_MAJOR_VERSION < 3
            if (likely(v) && !PyLong_Check(v)) {
                PyObject *tmp = v;
                v = PyNumber_Long(tmp);
                Py_DECREF(tmp);
            }
 #endif
            if (likely(v)) {
                int one = 1; int is_little = (int)*(unsigned char *)&one;
                unsigned char *bytes = (unsigned char *)&val;
                int ret = _PyLong_AsByteArray((PyLongObject *)v,
                                              bytes, sizeof(val),
                                              is_little, !is_unsigned);
                Py_DECREF(v);
                if (likely(!ret))
                    return val;
            }
#endif
            return (long) -1;
        }
    } else {
        long val;
        PyObject *tmp = __Pyx_PyNumber_IntOrLong(x);
        if (!tmp) return (long) -1;
        val = __Pyx_PyInt_As_long(tmp);
        Py_DECREF(tmp);
        return val;
    }
raise_overflow:
    PyErr_SetString(PyExc_OverflowError,
        "value too large to convert to long");
    return (long) -1;
raise_neg_overflow:
    PyErr_SetString(PyExc_OverflowError,
        "can't convert negative value to long");
    return (long) -1;
}

/* CheckBinaryVersion */
static int __Pyx_check_binary_version(void) {
    char ctversion[4], rtversion[4];
    PyOS_snprintf(ctversion, 4, "%d.%d", PY_MAJOR_VERSION, PY_MINOR_VERSION);
    PyOS_snprintf(rtversion, 4, "%s", Py_GetVersion());
    if (ctversion[0] != rtversion[0] || ctversion[2] != rtversion[2]) {
        char message[200];
        PyOS_snprintf(message, sizeof(message),
                      "compiletime version %s of module '%.100s' "
                      "does not match runtime version %s",
                      ctversion, __Pyx_MODULE_NAME, rtversion);
        return PyErr_WarnEx(NULL, message, 1);
    }
    return 0;
}

/* ModuleImport */
#ifndef __PYX_HAVE_RT_ImportModule
#define __PYX_HAVE_RT_ImportModule
static PyObject *__Pyx_ImportModule(const char *name) {
    PyObject *py_name = 0;
    PyObject *py_module = 0;
    py_name = __Pyx_PyIdentifier_FromString(name);
    if (!py_name)
        goto bad;
    py_module = PyImport_Import(py_name);
    Py_DECREF(py_name);
    return py_module;
bad:
    Py_XDECREF(py_name);
    return 0;
}
#endif

/* TypeImport */
#ifndef __PYX_HAVE_RT_ImportType
#define __PYX_HAVE_RT_ImportType
static PyTypeObject *__Pyx_ImportType(const char *module_name, const char *class_name,
    size_t size, int strict)
{
    PyObject *py_module = 0;
    PyObject *result = 0;
    PyObject *py_name = 0;
    char warning[200];
    Py_ssize_t basicsize;
#ifdef Py_LIMITED_API
    PyObject *py_basicsize;
#endif
    py_module = __Pyx_ImportModule(module_name);
    if (!py_module)
        goto bad;
    py_name = __Pyx_PyIdentifier_FromString(class_name);
    if (!py_name)
        goto bad;
    result = PyObject_GetAttr(py_module, py_name);
    Py_DECREF(py_name);
    py_name = 0;
    Py_DECREF(py_module);
    py_module = 0;
    if (!result)
        goto bad;
    if (!PyType_Check(result)) {
        PyErr_Format(PyExc_TypeError,
            "%.200s.%.200s is not a type object",
            module_name, class_name);
        goto bad;
    }
#ifndef Py_LIMITED_API
    basicsize = ((PyTypeObject *)result)->tp_basicsize;
#else
    py_basicsize = PyObject_GetAttrString(result, "__basicsize__");
    if (!py_basicsize)
        goto bad;
    basicsize = PyLong_AsSsize_t(py_basicsize);
    Py_DECREF(py_basicsize);
    py_basicsize = 0;
    if (basicsize == (Py_ssize_t)-1 && PyErr_Occurred())
        goto bad;
#endif
    if (!strict && (size_t)basicsize > size) {
        PyOS_snprintf(warning, sizeof(warning),
            "%s.%s size changed, may indicate binary incompatibility. Expected %zd, got %zd",
            module_name, class_name, basicsize, size);
        if (PyErr_WarnEx(NULL, warning, 0) < 0) goto bad;
    }
    else if ((size_t)basicsize != size) {
        PyErr_Format(PyExc_ValueError,
            "%.200s.%.200s has the wrong size, try recompiling. Expected %zd, got %zd",
            module_name, class_name, basicsize, size);
        goto bad;
    }
    return (PyTypeObject *)result;
bad:
    Py_XDECREF(py_module);
    Py_XDECREF(result);
    return NULL;
}
#endif

/* InitStrings */
static int __Pyx_InitStrings(__Pyx_StringTabEntry *t) {
    while (t->p) {
        #if PY_MAJOR_VERSION < 3
        if (t->is_unicode) {
            *t->p = PyUnicode_DecodeUTF8(t->s, t->n - 1, NULL);
        } else if (t->intern) {
            *t->p = PyString_InternFromString(t->s);
        } else {
            *t->p = PyString_FromStringAndSize(t->s, t->n - 1);
        }
        #else
        if (t->is_unicode | t->is_str) {
            if (t->intern) {
                *t->p = PyUnicode_InternFromString(t->s);
            } else if (t->encoding) {
                *t->p = PyUnicode_Decode(t->s, t->n - 1, t->encoding, NULL);
            } else {
                *t->p = PyUnicode_FromStringAndSize(t->s, t->n - 1);
            }
        } else {
            *t->p = PyBytes_FromStringAndSize(t->s, t->n - 1);
        }
        #endif
        if (!*t->p)
            return -1;
        ++t;
    }
    return 0;
}

static CYTHON_INLINE PyObject* __Pyx_PyUnicode_FromString(const char* c_str) {
    return __Pyx_PyUnicode_FromStringAndSize(c_str, (Py_ssize_t)strlen(c_str));
}
static CYTHON_INLINE char* __Pyx_PyObject_AsString(PyObject* o) {
    Py_ssize_t ignore;
    return __Pyx_PyObject_AsStringAndSize(o, &ignore);
}
static CYTHON_INLINE char* __Pyx_PyObject_AsStringAndSize(PyObject* o, Py_ssize_t *length) {
#if CYTHON_COMPILING_IN_CPYTHON && (__PYX_DEFAULT_STRING_ENCODING_IS_ASCII || __PYX_DEFAULT_STRING_ENCODING_IS_DEFAULT)
    if (
#if PY_MAJOR_VERSION < 3 && __PYX_DEFAULT_STRING_ENCODING_IS_ASCII
            __Pyx_sys_getdefaultencoding_not_ascii &&
#endif
            PyUnicode_Check(o)) {
#if PY_VERSION_HEX < 0x03030000
        char* defenc_c;
        PyObject* defenc = _PyUnicode_AsDefaultEncodedString(o, NULL);
        if (!defenc) return NULL;
        defenc_c = PyBytes_AS_STRING(defenc);
#if __PYX_DEFAULT_STRING_ENCODING_IS_ASCII
        {
            char* end = defenc_c + PyBytes_GET_SIZE(defenc);
            char* c;
            for (c = defenc_c; c < end; c++) {
                if ((unsigned char) (*c) >= 128) {
                    PyUnicode_AsASCIIString(o);
                    return NULL;
                }
            }
        }
#endif
        *length = PyBytes_GET_SIZE(defenc);
        return defenc_c;
#else
        if (__Pyx_PyUnicode_READY(o) == -1) return NULL;
#if __PYX_DEFAULT_STRING_ENCODING_IS_ASCII
        if (PyUnicode_IS_ASCII(o)) {
            *length = PyUnicode_GET_LENGTH(o);
            return PyUnicode_AsUTF8(o);
        } else {
            PyUnicode_AsASCIIString(o);
            return NULL;
        }
#else
        return PyUnicode_AsUTF8AndSize(o, length);
#endif
#endif
    } else
#endif
#if (!CYTHON_COMPILING_IN_PYPY) || (defined(PyByteArray_AS_STRING) && defined(PyByteArray_GET_SIZE))
    if (PyByteArray_Check(o)) {
        *length = PyByteArray_GET_SIZE(o);
        return PyByteArray_AS_STRING(o);
    } else
#endif
    {
        char* result;
        int r = PyBytes_AsStringAndSize(o, &result, length);
        if (unlikely(r < 0)) {
            return NULL;
        } else {
            return result;
        }
    }
}
static CYTHON_INLINE int __Pyx_PyObject_IsTrue(PyObject* x) {
   int is_true = x == Py_True;
   if (is_true | (x == Py_False) | (x == Py_None)) return is_true;
   else return PyObject_IsTrue(x);
}
static CYTHON_INLINE PyObject* __Pyx_PyNumber_IntOrLong(PyObject* x) {
#if CYTHON_USE_TYPE_SLOTS
  PyNumberMethods *m;
#endif
  const char *name = NULL;
  PyObject *res = NULL;
#if PY_MAJOR_VERSION < 3
  if (PyInt_Check(x) || PyLong_Check(x))
#else
  if (PyLong_Check(x))
#endif
    return __Pyx_NewRef(x);
#if CYTHON_USE_TYPE_SLOTS
  m = Py_TYPE(x)->tp_as_number;
  #if PY_MAJOR_VERSION < 3
  if (m && m->nb_int) {
    name = "int";
    res = PyNumber_Int(x);
  }
  else if (m && m->nb_long) {
    name = "long";
    res = PyNumber_Long(x);
  }
  #else
  if (m && m->nb_int) {
    name = "int";
    res = PyNumber_Long(x);
  }
  #endif
#else
  res = PyNumber_Int(x);
#endif
  if (res) {
#if PY_MAJOR_VERSION < 3
    if (!PyInt_Check(res) && !PyLong_Check(res)) {
#else
    if (!PyLong_Check(res)) {
#endif
      PyErr_Format(PyExc_TypeError,
                   "__%.4s__ returned non-%.4s (type %.200s)",
                   name, name, Py_TYPE(res)->tp_name);
      Py_DECREF(res);
      return NULL;
    }
  }
  else if (!PyErr_Occurred()) {
    PyErr_SetString(PyExc_TypeError,
                    "an integer is required");
  }
  return res;
}
static CYTHON_INLINE Py_ssize_t __Pyx_PyIndex_AsSsize_t(PyObject* b) {
  Py_ssize_t ival;
  PyObject *x;
#if PY_MAJOR_VERSION < 3
  if (likely(PyInt_CheckExact(b))) {
    if (sizeof(Py_ssize_t) >= sizeof(long))
        return PyInt_AS_LONG(b);
    else
        return PyInt_AsSsize_t(x);
  }
#endif
  if (likely(PyLong_CheckExact(b))) {
    #if CYTHON_USE_PYLONG_INTERNALS
    const digit* digits = ((PyLongObject*)b)->ob_digit;
    const Py_ssize_t size = Py_SIZE(b);
    if (likely(__Pyx_sst_abs(size) <= 1)) {
        ival = likely(size) ? digits[0] : 0;
        if (size == -1) ival = -ival;
        return ival;
    } else {
      switch (size) {
         case 2:
           if (8 * sizeof(Py_ssize_t) > 2 * PyLong_SHIFT) {
             return (Py_ssize_t) (((((size_t)digits[1]) << PyLong_SHIFT) | (size_t)digits[0]));
           }
           break;
         case -2:
           if (8 * sizeof(Py_ssize_t) > 2 * PyLong_SHIFT) {
             return -(Py_ssize_t) (((((size_t)digits[1]) << PyLong_SHIFT) | (size_t)digits[0]));
           }
           break;
         case 3:
           if (8 * sizeof(Py_ssize_t) > 3 * PyLong_SHIFT) {
             return (Py_ssize_t) (((((((size_t)digits[2]) << PyLong_SHIFT) | (size_t)digits[1]) << PyLong_SHIFT) | (size_t)digits[0]));
           }
           break;
         case -3:
           if (8 * sizeof(Py_ssize_t) > 3 * PyLong_SHIFT) {
             return -(Py_ssize_t) (((((((size_t)digits[2]) << PyLong_SHIFT) | (size_t)digits[1]) << PyLong_SHIFT) | (size_t)digits[0]));
           }
           break;
         case 4:
           if (8 * sizeof(Py_ssize_t) > 4 * PyLong_SHIFT) {
             return (Py_ssize_t) (((((((((size_t)digits[3]) << PyLong_SHIFT) | (size_t)digits[2]) << PyLong_SHIFT) | (size_t)digits[1]) << PyLong_SHIFT) | (size_t)digits[0]));
           }
           break;
         case -4:
           if (8 * sizeof(Py_ssize_t) > 4 * PyLong_SHIFT) {
             return -(Py_ssize_t) (((((((((size_t)digits[3]) << PyLong_SHIFT) | (size_t)digits[2]) << PyLong_SHIFT) | (size_t)digits[1]) << PyLong_SHIFT) | (size_t)digits[0]));
           }
           break;
      }
    }
    #endif
    return PyLong_AsSsize_t(b);
  }
  x = PyNumber_Index(b);
  if (!x) return -1;
  ival = PyInt_AsSsize_t(x);
  Py_DECREF(x);
  return ival;
}
static CYTHON_INLINE PyObject * __Pyx_PyInt_FromSize_t(size_t ival) {
    return PyInt_FromSize_t(ival);
}


#endif /* Py_PYTHON_H */
